BU_: XXX

BA_DEF_ BO_  "OvtpPushApplication" ENUM  "FALSE","TRUE";
BA_DEF_ SG_  "ECGUsedRxSignal" ENUM  "No","Yes";
BA_DEF_ SG_  "ECGUsedTxSignal" ENUM  "No","Yes";
BA_DEF_ BO_  "VFrameFormat" ENUM  "StandardCAN","ExtendedCAN","reserved","reserved","reserved","reserved","reserved","reserved","reserved","reserved","reserved","reserved","reserved","reserved","StandardCAN_FD","ExtendedCAN_FD";
BA_DEF_ BO_  "FrameRouting" STRING;
BA_DEF_ BO_  "FrameGatewayNetwork" STRING;
BA_DEF_ BO_  "NetworkInitialization" ENUM  "No","Yes";
BA_DEF_ BO_  "FrameGatewayId" HEX 0 1407;
BA_DEF_ BO_  "EventRateOfChange" INT 10 10000;
BA_DEF_ BO_  "GenMsgStartDelayTime" INT 0 10000;
BA_DEF_ BO_  "GenMsgNrOfRepetition" INT 0 100;
BA_DEF_ BO_  "GenMsgDelayTime" INT 0 1000;
BA_DEF_ BO_  "GenMsgCycleTime" INT 0 100000;
BA_DEF_ BO_  "GenMsgSendType" ENUM  "FixedPeriodic","Event","EnabledPeriodic","NotUsed","NotUsed","EventPeriodic","NotUsed","NotUsed","NoMsgSendType";
BA_DEF_ SG_  "U_T6_MCA_MY2020_Tx" ENUM  "No","Yes";
BA_DEF_ SG_  "U_P702_MY2021_Tx" ENUM  "No","Yes";
BA_DEF_ SG_  "U_CX727_MY2021_Tx" ENUM  "No","Yes";
BA_DEF_ SG_  "U_T6_MCA_MY2020_Rx" ENUM  "No","Yes";
BA_DEF_ SG_  "U_P702_MY2021_Rx" ENUM  "No","Yes";
BA_DEF_ SG_  "U_CX727_MY2021_Rx" ENUM  "No","Yes";
BA_DEF_ SG_  "GenSigStartValue" HEX 0 268435455;
BA_DEF_ SG_  "MetaData" ENUM  "No","Yes";
BA_DEF_ SG_  "ContentDependant" ENUM  "No","Yes";
BA_DEF_ SG_  "GenSigStartValueInteger" INT 0 1000000000;
BA_DEF_ SG_  "UsedOnPgmDBC" ENUM  "No","Yes";
BA_DEF_ SG_  "CrossOver_InfoCAN" ENUM  "No","Yes";
BA_DEF_ SG_  "WakeupSignal" ENUM  "No","Yes";
BA_DEF_ SG_  "GenSigInactiveValue" INT 0 100000;
BA_DEF_ SG_  "GenSigSendType" ENUM  "Cyclic","OnWrite","vector_leerstring","OnChange","vector_leerstring","IfActive","vector_leerstring","NoSigSendType";
BA_DEF_ BO_  "SCP_FreshnessValueLength" INT 0 512;
BA_DEF_ BO_  "AuthFreshnessCounterSyncAttempt" INT 0 512;
BA_DEF_ BO_  "SCP_FreshnessValueTxLength" INT 0 512;
BA_DEF_ BO_  "SCP_AuthInfoTxLength" INT 0 512;
BA_DEF_ BO_  "ProgBWConditional" STRING;
BA_DEF_ BO_  "NmAsrMessage" ENUM  "No","Yes";
BA_DEF_ BO_  "TpApplType" STRING;
BA_DEF_ BO_  "DiagState" ENUM  "No","Yes";
BA_DEF_ BO_  "TpTxIndex" INT 0 536870911;
BA_DEF_ BO_  "DiagRequest" ENUM  "No","Yes";
BA_DEF_ BO_  "DiagResponse" ENUM  "No","Yes";
BA_DEF_ BO_  "GenMsgILSupport" ENUM  "No","Yes";
BA_DEF_DEF_  "OvtpPushApplication" "FALSE";
BA_DEF_DEF_  "ECGUsedRxSignal" "No";
BA_DEF_DEF_  "ECGUsedTxSignal" "No";
BA_DEF_DEF_  "VFrameFormat" "ExtendedCAN_FD";
BA_DEF_DEF_  "FrameRouting" "NONE";
BA_DEF_DEF_  "FrameGatewayNetwork" "NONE";
BA_DEF_DEF_  "NetworkInitialization" "Yes";
BA_DEF_DEF_  "FrameGatewayId" 0;
BA_DEF_DEF_  "EventRateOfChange" 10000;
BA_DEF_DEF_  "GenMsgStartDelayTime" 0;
BA_DEF_DEF_  "GenMsgNrOfRepetition" 1;
BA_DEF_DEF_  "GenMsgDelayTime" 20;
BA_DEF_DEF_  "GenMsgCycleTime" 0;
BA_DEF_DEF_  "GenMsgSendType" "NoMsgSendType";
BA_DEF_DEF_  "U_T6_MCA_MY2020_Tx" "No";
BA_DEF_DEF_  "U_P702_MY2021_Tx" "No";
BA_DEF_DEF_  "U_CX727_MY2021_Tx" "No";
BA_DEF_DEF_  "U_T6_MCA_MY2020_Rx" "No";
BA_DEF_DEF_  "U_P702_MY2021_Rx" "No";
BA_DEF_DEF_  "U_CX727_MY2021_Rx" "No";
BA_DEF_DEF_  "GenSigStartValue" 0;
BA_DEF_DEF_  "MetaData" "No";
BA_DEF_DEF_  "ContentDependant" "No";
BA_DEF_DEF_  "GenSigStartValueInteger" 0;
BA_DEF_DEF_  "UsedOnPgmDBC" "Yes";
BA_DEF_DEF_  "CrossOver_InfoCAN" "No";
BA_DEF_DEF_  "WakeupSignal" "No";
BA_DEF_DEF_  "GenSigInactiveValue" 0;
BA_DEF_DEF_  "GenSigSendType" "NoSigSendType";
BA_DEF_DEF_  "SCP_FreshnessValueLength" 64;
BA_DEF_DEF_  "AuthFreshnessCounterSyncAttempt" 2;
BA_DEF_DEF_  "SCP_FreshnessValueTxLength" 8;
BA_DEF_DEF_  "SCP_AuthInfoTxLength" 56;
BA_DEF_DEF_  "ProgBWConditional" "NONE";
BA_DEF_DEF_  "NmAsrMessage" "No";
BA_DEF_DEF_  "TpApplType" "";
BA_DEF_DEF_  "DiagState" "No";
BA_DEF_DEF_  "TpTxIndex" 0;
BA_DEF_DEF_  "DiagRequest" "No";
BA_DEF_DEF_  "DiagResponse" "No";
BA_DEF_DEF_  "GenMsgILSupport" "Yes";
BA_ "TpTxIndex" BO_ 2612224069 464590040;
BA_ "OvtpPushApplication" BO_ 2612224069 1;
BA_ "FrameRouting" BO_ 2612224069 "";
BA_ "NetworkInitialization" BO_ 2612224069 0;
BA_ "GenMsgDelayTime" BO_ 2612224069 0;
BA_ "GenMsgSendType" BO_ 2612224069 1;
BA_ "TpTxIndex" BO_ 2611175445 463492312;
BA_ "FrameRouting" BO_ 2611175445 "";
BA_ "NetworkInitialization" BO_ 2611175445 0;
BA_ "GenMsgDelayTime" BO_ 2611175445 0;
BA_ "GenMsgSendType" BO_ 2611175445 1;
BA_ "TpTxIndex" BO_ 2612224021 464540888;
BA_ "OvtpPushApplication" BO_ 2612224021 1;
BA_ "FrameRouting" BO_ 2612224021 "";
BA_ "NetworkInitialization" BO_ 2612224021 0;
BA_ "GenMsgDelayTime" BO_ 2612224021 0;
BA_ "GenMsgSendType" BO_ 2612224021 1;
BA_ "TpTxIndex" BO_ 2610126947 462523608;
BA_ "FrameRouting" BO_ 2610126947 "";
BA_ "NetworkInitialization" BO_ 2610126947 0;
BA_ "GenMsgDelayTime" BO_ 2610126947 0;
BA_ "GenMsgSendType" BO_ 2610126947 1;
BA_ "TpTxIndex" BO_ 2610126946 462522584;
BA_ "FrameRouting" BO_ 2610126946 "";
BA_ "NetworkInitialization" BO_ 2610126946 0;
BA_ "GenMsgDelayTime" BO_ 2610126946 0;
BA_ "GenMsgSendType" BO_ 2610126946 1;
BA_ "TpTxIndex" BO_ 2610126918 462493912;
BA_ "FrameRouting" BO_ 2610126918 "";
BA_ "NetworkInitialization" BO_ 2610126918 0;
BA_ "GenMsgDelayTime" BO_ 2610126918 0;
BA_ "GenMsgSendType" BO_ 2610126918 1;
BA_ "TpTxIndex" BO_ 2610126917 462492888;
BA_ "FrameRouting" BO_ 2610126917 "";
BA_ "NetworkInitialization" BO_ 2610126917 0;
BA_ "GenMsgDelayTime" BO_ 2610126917 0;
BA_ "GenMsgSendType" BO_ 2610126917 1;
BA_ "FrameRouting" BO_ 2610126869 "";
BA_ "NetworkInitialization" BO_ 2610126869 0;
BA_ "GenMsgDelayTime" BO_ 2610126869 0;
BA_ "GenMsgSendType" BO_ 2610126869 1;
BA_ "TpTxIndex" BO_ 2610126869 462443736;
BA_ "FrameRouting" BO_ 984 "";
BA_ "GenMsgCycleTime" BO_ 984 1000;
BA_ "GenMsgSendType" BO_ 984 5;
BA_ "VFrameFormat" BO_ 984 14;
BA_ "FrameRouting" BO_ 985 "";
BA_ "GenMsgSendType" BO_ 985 5;
BA_ "GenMsgCycleTime" BO_ 985 1000;
BA_ "VFrameFormat" BO_ 985 14;
BA_ "FrameRouting" BO_ 992 "";
BA_ "FrameGatewayNetwork" BO_ 992 "HS3_CAN";
BA_ "FrameGatewayId" BO_ 992 992;
BA_ "VFrameFormat" BO_ 992 14;
BA_ "OvtpPushApplication" BO_ 2612019416 1;
BA_ "FrameRouting" BO_ 2612019416 "";
BA_ "TpTxIndex" BO_ 2612019416 464535768;
BA_ "NetworkInitialization" BO_ 2612019416 0;
BA_ "GenMsgDelayTime" BO_ 2612019416 0;
BA_ "GenMsgSendType" BO_ 2612019416 1;
BA_ "FrameRouting" BO_ 943 "";
BA_ "GenMsgSendType" BO_ 943 0;
BA_ "GenMsgCycleTime" BO_ 943 20;
BA_ "GenMsgDelayTime" BO_ 943 10;
BA_ "VFrameFormat" BO_ 943 14;
BA_ "FrameRouting" BO_ 515 "";
BA_ "GenMsgSendType" BO_ 515 5;
BA_ "GenMsgCycleTime" BO_ 515 100;
BA_ "VFrameFormat" BO_ 515 14;
BA_ "FrameRouting" BO_ 1111 "";
BA_ "FrameGatewayId" BO_ 1111 1111;
BA_ "FrameGatewayNetwork" BO_ 1111 "HS2_CAN";
BA_ "VFrameFormat" BO_ 1111 14;
BA_ "FrameRouting" BO_ 1106 "";
BA_ "FrameGatewayId" BO_ 1106 1106;
BA_ "FrameGatewayNetwork" BO_ 1106 "HS2_CAN";
BA_ "VFrameFormat" BO_ 1106 14;
BA_ "FrameRouting" BO_ 1985 "";
BA_ "NetworkInitialization" BO_ 1985 0;
BA_ "GenMsgDelayTime" BO_ 1985 0;
BA_ "GenMsgSendType" BO_ 1985 1;
BA_ "DiagRequest" BO_ 1985 1;
BA_ "GenMsgILSupport" BO_ 1985 0;
BA_ "VFrameFormat" BO_ 1985 14;
BA_ "FrameRouting" BO_ 1993 "";
BA_ "NetworkInitialization" BO_ 1993 0;
BA_ "GenMsgDelayTime" BO_ 1993 0;
BA_ "GenMsgSendType" BO_ 1993 1;
BA_ "DiagResponse" BO_ 1993 1;
BA_ "GenMsgILSupport" BO_ 1993 0;
BA_ "VFrameFormat" BO_ 1993 14;
BA_ "FrameRouting" BO_ 1503 "";
BA_ "NetworkInitialization" BO_ 1503 0;
BA_ "GenMsgCycleTime" BO_ 1503 1000;
BA_ "GenMsgSendType" BO_ 1503 0;
BA_ "NmAsrMessage" BO_ 1503 1;
BA_ "GenMsgILSupport" BO_ 1503 0;
BA_ "VFrameFormat" BO_ 1503 14;
BA_ "TpTxIndex" BO_ 2610995416 463511768;
BA_ "FrameRouting" BO_ 2610995416 "";
BA_ "NetworkInitialization" BO_ 2610995416 0;
BA_ "GenMsgDelayTime" BO_ 2610995416 0;
BA_ "GenMsgSendType" BO_ 2610995416 1;
BA_ "TpTxIndex" BO_ 2612043992 464560344;
BA_ "OvtpPushApplication" BO_ 2612043992 1;
BA_ "FrameRouting" BO_ 2612043992 "";
BA_ "NetworkInitialization" BO_ 2612043992 0;
BA_ "GenMsgDelayTime" BO_ 2612043992 0;
BA_ "GenMsgSendType" BO_ 2612043992 1;
BA_ "FrameRouting" BO_ 2609946840 "";
BA_ "NetworkInitialization" BO_ 2609946840 0;
BA_ "GenMsgDelayTime" BO_ 2609946840 0;
BA_ "GenMsgSendType" BO_ 2609946840 1;
BA_ "TpTxIndex" BO_ 2609946840 462463192;
BA_ "TpTxIndex" BO_ 2611175464 463511768;
BA_ "FrameRouting" BO_ 2611175464 "";
BA_ "NetworkInitialization" BO_ 2611175464 0;
BA_ "GenMsgDelayTime" BO_ 2611175464 0;
BA_ "GenMsgSendType" BO_ 2611175464 1;
BA_ "TpTxIndex" BO_ 2612224040 464560344;
BA_ "OvtpPushApplication" BO_ 2612224040 1;
BA_ "FrameRouting" BO_ 2612224040 "";
BA_ "NetworkInitialization" BO_ 2612224040 0;
BA_ "GenMsgDelayTime" BO_ 2612224040 0;
BA_ "GenMsgSendType" BO_ 2612224040 1;
BA_ "TpTxIndex" BO_ 2610126888 462463192;
BA_ "FrameRouting" BO_ 2610126888 "";
BA_ "NetworkInitialization" BO_ 2610126888 0;
BA_ "GenMsgDelayTime" BO_ 2610126888 0;
BA_ "GenMsgSendType" BO_ 2610126888 1;
BA_ "TpTxIndex" BO_ 2610988248 463504600;
BA_ "FrameRouting" BO_ 2610988248 "";
BA_ "NetworkInitialization" BO_ 2610988248 0;
BA_ "GenMsgDelayTime" BO_ 2610988248 0;
BA_ "GenMsgSendType" BO_ 2610988248 1;
BA_ "FrameRouting" BO_ 2609939672 "";
BA_ "NetworkInitialization" BO_ 2609939672 0;
BA_ "GenMsgDelayTime" BO_ 2609939672 0;
BA_ "GenMsgSendType" BO_ 2609939672 1;
BA_ "TpTxIndex" BO_ 2609939672 462456024;
BA_ "FrameRouting" BO_ 1114 "";
BA_ "FrameGatewayNetwork" BO_ 1114 "HS3_CAN";
BA_ "FrameGatewayId" BO_ 1114 1114;
BA_ "VFrameFormat" BO_ 1114 14;
BA_ "FrameRouting" BO_ 1116 "";
BA_ "FrameGatewayNetwork" BO_ 1116 "HS3_CAN";
BA_ "FrameGatewayId" BO_ 1116 1116;
BA_ "VFrameFormat" BO_ 1116 14;
BA_ "TpTxIndex" BO_ 2611175457 463504600;
BA_ "FrameRouting" BO_ 2611175457 "";
BA_ "NetworkInitialization" BO_ 2611175457 0;
BA_ "GenMsgDelayTime" BO_ 2611175457 0;
BA_ "GenMsgSendType" BO_ 2611175457 1;
BA_ "TpTxIndex" BO_ 2612224033 464553176;
BA_ "OvtpPushApplication" BO_ 2612224033 1;
BA_ "FrameRouting" BO_ 2612224033 "";
BA_ "NetworkInitialization" BO_ 2612224033 0;
BA_ "GenMsgDelayTime" BO_ 2612224033 0;
BA_ "GenMsgSendType" BO_ 2612224033 1;
BA_ "TpTxIndex" BO_ 2610126881 462456024;
BA_ "FrameRouting" BO_ 2610126881 "";
BA_ "NetworkInitialization" BO_ 2610126881 0;
BA_ "GenMsgDelayTime" BO_ 2610126881 0;
BA_ "GenMsgSendType" BO_ 2610126881 1;
BA_ "FrameRouting" BO_ 981 "";
BA_ "GenMsgSendType" BO_ 981 0;
BA_ "GenMsgCycleTime" BO_ 981 30;
BA_ "VFrameFormat" BO_ 981 14;
BA_ "FrameRouting" BO_ 791 "";
BA_ "FrameGatewayId" BO_ 791 791;
BA_ "FrameGatewayNetwork" BO_ 791 "HS3_CAN";
BA_ "VFrameFormat" BO_ 791 14;
BA_ "TpTxIndex" BO_ 2610970840 463487192;
BA_ "FrameRouting" BO_ 2610970840 "";
BA_ "NetworkInitialization" BO_ 2610970840 0;
BA_ "GenMsgDelayTime" BO_ 2610970840 0;
BA_ "GenMsgSendType" BO_ 2610970840 1;
BA_ "TpTxIndex" BO_ 2609922264 462438616;
BA_ "FrameRouting" BO_ 2609922264 "";
BA_ "NetworkInitialization" BO_ 2609922264 0;
BA_ "GenMsgDelayTime" BO_ 2609922264 0;
BA_ "GenMsgSendType" BO_ 2609922264 1;
BA_ "FrameRouting" BO_ 868 "";
BA_ "FrameGatewayNetwork" BO_ 868 "HS1_CAN";
BA_ "FrameGatewayId" BO_ 868 868;
BA_ "VFrameFormat" BO_ 868 14;
BA_ "FrameRouting" BO_ 867 "";
BA_ "FrameGatewayNetwork" BO_ 867 "HS1_CAN";
BA_ "FrameGatewayId" BO_ 867 867;
BA_ "VFrameFormat" BO_ 867 14;
BA_ "FrameRouting" BO_ 866 "";
BA_ "FrameGatewayNetwork" BO_ 866 "HS1_CAN";
BA_ "FrameGatewayId" BO_ 866 866;
BA_ "VFrameFormat" BO_ 866 14;
BA_ "FrameRouting" BO_ 865 "";
BA_ "FrameGatewayNetwork" BO_ 865 "HS1_CAN";
BA_ "FrameGatewayId" BO_ 865 865;
BA_ "VFrameFormat" BO_ 865 14;
BA_ "TpTxIndex" BO_ 2611175440 463487192;
BA_ "FrameRouting" BO_ 2611175440 "";
BA_ "NetworkInitialization" BO_ 2611175440 0;
BA_ "GenMsgDelayTime" BO_ 2611175440 0;
BA_ "GenMsgSendType" BO_ 2611175440 1;
BA_ "TpTxIndex" BO_ 2610126864 462438616;
BA_ "FrameRouting" BO_ 2610126864 "";
BA_ "NetworkInitialization" BO_ 2610126864 0;
BA_ "GenMsgDelayTime" BO_ 2610126864 0;
BA_ "GenMsgSendType" BO_ 2610126864 1;
BA_ "TpTxIndex" BO_ 2611175441 463488216;
BA_ "FrameRouting" BO_ 2611175441 "";
BA_ "NetworkInitialization" BO_ 2611175441 0;
BA_ "GenMsgDelayTime" BO_ 2611175441 0;
BA_ "GenMsgSendType" BO_ 2611175441 1;
BA_ "TpTxIndex" BO_ 2612224017 463488216;
BA_ "OvtpPushApplication" BO_ 2612224017 1;
BA_ "FrameRouting" BO_ 2612224017 "";
BA_ "NetworkInitialization" BO_ 2612224017 0;
BA_ "GenMsgDelayTime" BO_ 2612224017 0;
BA_ "GenMsgSendType" BO_ 2612224017 1;
BA_ "FrameRouting" BO_ 2610126865 "";
BA_ "NetworkInitialization" BO_ 2610126865 0;
BA_ "GenMsgDelayTime" BO_ 2610126865 0;
BA_ "GenMsgSendType" BO_ 2610126865 1;
BA_ "TpTxIndex" BO_ 2610126865 462439640;
BA_ "FrameRouting" BO_ 1679 "";
BA_ "GenMsgSendType" BO_ 1679 1;
BA_ "TpApplType" BO_ 1679 "DiagUUDTResponse";
BA_ "GenMsgILSupport" BO_ 1679 0;
BA_ "VFrameFormat" BO_ 1679 14;
BA_ "FrameRouting" BO_ 1678 "";
BA_ "GenMsgSendType" BO_ 1678 1;
BA_ "TpApplType" BO_ 1678 "DiagUUDTResponse";
BA_ "GenMsgILSupport" BO_ 1678 0;
BA_ "VFrameFormat" BO_ 1678 14;
BA_ "FrameRouting" BO_ 1677 "";
BA_ "GenMsgSendType" BO_ 1677 1;
BA_ "TpApplType" BO_ 1677 "DiagUUDTResponse";
BA_ "GenMsgILSupport" BO_ 1677 0;
BA_ "VFrameFormat" BO_ 1677 14;
BA_ "FrameRouting" BO_ 1676 "";
BA_ "GenMsgSendType" BO_ 1676 1;
BA_ "TpApplType" BO_ 1676 "DiagUUDTResponse";
BA_ "GenMsgILSupport" BO_ 1676 0;
BA_ "VFrameFormat" BO_ 1676 14;
BA_ "FrameRouting" BO_ 1144 "";
BA_ "GenMsgSendType" BO_ 1144 5;
BA_ "GenMsgCycleTime" BO_ 1144 1000;
BA_ "VFrameFormat" BO_ 1144 14;
BA_ "FrameRouting" BO_ 1141 "";
BA_ "GenMsgSendType" BO_ 1141 0;
BA_ "GenMsgCycleTime" BO_ 1141 500;
BA_ "VFrameFormat" BO_ 1141 14;
BA_ "FrameRouting" BO_ 1140 "";
BA_ "GenMsgSendType" BO_ 1140 0;
BA_ "GenMsgCycleTime" BO_ 1140 1000;
BA_ "VFrameFormat" BO_ 1140 14;
BA_ "FrameRouting" BO_ 1139 "";
BA_ "GenMsgCycleTime" BO_ 1139 1500;
BA_ "GenMsgSendType" BO_ 1139 0;
BA_ "VFrameFormat" BO_ 1139 14;
BA_ "FrameRouting" BO_ 1138 "";
BA_ "GenMsgCycleTime" BO_ 1138 1500;
BA_ "GenMsgSendType" BO_ 1138 0;
BA_ "VFrameFormat" BO_ 1138 14;
BA_ "FrameRouting" BO_ 1089 "";
BA_ "GenMsgCycleTime" BO_ 1089 1000;
BA_ "GenMsgSendType" BO_ 1089 0;
BA_ "VFrameFormat" BO_ 1089 14;
BA_ "FrameRouting" BO_ 1040 "";
BA_ "GenMsgCycleTime" BO_ 1040 100;
BA_ "GenMsgSendType" BO_ 1040 0;
BA_ "VFrameFormat" BO_ 1040 14;
BA_ "FrameRouting" BO_ 1016 "";
BA_ "GenMsgCycleTime" BO_ 1016 1000;
BA_ "GenMsgSendType" BO_ 1016 5;
BA_ "VFrameFormat" BO_ 1016 14;
BA_ "FrameRouting" BO_ 1013 "";
BA_ "GenMsgCycleTime" BO_ 1013 1000;
BA_ "GenMsgSendType" BO_ 1013 5;
BA_ "VFrameFormat" BO_ 1013 14;
BA_ "FrameRouting" BO_ 1012 "";
BA_ "GenMsgCycleTime" BO_ 1012 1000;
BA_ "GenMsgSendType" BO_ 1012 5;
BA_ "VFrameFormat" BO_ 1012 14;
BA_ "FrameRouting" BO_ 1011 "";
BA_ "GenMsgCycleTime" BO_ 1011 1000;
BA_ "GenMsgSendType" BO_ 1011 5;
BA_ "VFrameFormat" BO_ 1011 14;
BA_ "FrameRouting" BO_ 871 "";
BA_ "GenMsgCycleTime" BO_ 871 100;
BA_ "GenMsgSendType" BO_ 871 0;
BA_ "VFrameFormat" BO_ 871 14;
BA_ "FrameRouting" BO_ 72 "";
BA_ "GenMsgDelayTime" BO_ 72 10;
BA_ "GenMsgCycleTime" BO_ 72 20;
BA_ "GenMsgSendType" BO_ 72 0;
BA_ "VFrameFormat" BO_ 72 14;
BA_ "FrameRouting" BO_ 912 "";
BA_ "FrameGatewayNetwork" BO_ 912 "HS1_CAN";
BA_ "FrameGatewayId" BO_ 912 912;
BA_ "VFrameFormat" BO_ 912 14;
BA_ "FrameRouting" BO_ 874 "";
BA_ "FrameGatewayNetwork" BO_ 874 "HS1_CAN";
BA_ "FrameGatewayId" BO_ 874 874;
BA_ "VFrameFormat" BO_ 874 14;
BA_ "FrameRouting" BO_ 651 "";
BA_ "FrameGatewayNetwork" BO_ 651 "HS4_CAN";
BA_ "FrameGatewayId" BO_ 651 651;
BA_ "VFrameFormat" BO_ 651 14;
BA_ "FrameRouting" BO_ 529 "";
BA_ "FrameGatewayNetwork" BO_ 529 "HS3_CAN";
BA_ "FrameGatewayId" BO_ 529 529;
BA_ "VFrameFormat" BO_ 529 14;
BA_ "TpTxIndex" BO_ 2610971864 463488216;
BA_ "FrameRouting" BO_ 2610971864 "";
BA_ "NetworkInitialization" BO_ 2610971864 0;
BA_ "GenMsgDelayTime" BO_ 2610971864 0;
BA_ "GenMsgSendType" BO_ 2610971864 1;
BA_ "TpTxIndex" BO_ 2612002008 464518360;
BA_ "FrameRouting" BO_ 2612002008 "";
BA_ "NetworkInitialization" BO_ 2612002008 0;
BA_ "GenMsgDelayTime" BO_ 2612002008 0;
BA_ "GenMsgSendType" BO_ 2612002008 1;
BA_ "FrameRouting" BO_ 2609923288 "";
BA_ "NetworkInitialization" BO_ 2609923288 0;
BA_ "GenMsgDelayTime" BO_ 2609923288 0;
BA_ "GenMsgSendType" BO_ 2609923288 1;
BA_ "TpTxIndex" BO_ 2609923288 462439640;
BA_ "TpTxIndex" BO_ 2610953432 463469784;
BA_ "FrameRouting" BO_ 2610953432 "";
BA_ "NetworkInitialization" BO_ 2610953432 0;
BA_ "GenMsgDelayTime" BO_ 2610953432 0;
BA_ "GenMsgSendType" BO_ 2610953432 1;
BA_ "FrameRouting" BO_ 2022 "";
BA_ "GenMsgILSupport" BO_ 2022 0;
BA_ "DiagRequest" BO_ 2022 1;
BA_ "GenMsgSendType" BO_ 2022 1;
BA_ "GenMsgDelayTime" BO_ 2022 0;
BA_ "VFrameFormat" BO_ 2022 14;
BA_ "FrameRouting" BO_ 1124 "";
BA_ "FrameGatewayId" BO_ 1124 1124;
BA_ "FrameGatewayNetwork" BO_ 1124 "HS3_CAN";
BA_ "VFrameFormat" BO_ 1124 14;
BA_ "FrameRouting" BO_ 1119 "";
BA_ "FrameGatewayId" BO_ 1119 1119;
BA_ "FrameGatewayNetwork" BO_ 1119 "HS1_CAN";
BA_ "VFrameFormat" BO_ 1119 14;
BA_ "FrameRouting" BO_ 132 "";
BA_ "FrameGatewayNetwork" BO_ 132 "HS1_CAN";
BA_ "FrameGatewayId" BO_ 132 132;
BA_ "VFrameFormat" BO_ 132 14;
BA_ "FrameRouting" BO_ 1990 "";
BA_ "NetworkInitialization" BO_ 1990 0;
BA_ "GenMsgDelayTime" BO_ 1990 0;
BA_ "GenMsgSendType" BO_ 1990 1;
BA_ "DiagRequest" BO_ 1990 1;
BA_ "GenMsgILSupport" BO_ 1990 0;
BA_ "VFrameFormat" BO_ 1990 14;
BA_ "FrameRouting" BO_ 1892 "";
BA_ "NetworkInitialization" BO_ 1892 0;
BA_ "GenMsgDelayTime" BO_ 1892 0;
BA_ "GenMsgSendType" BO_ 1892 1;
BA_ "DiagRequest" BO_ 1892 1;
BA_ "GenMsgILSupport" BO_ 1892 0;
BA_ "VFrameFormat" BO_ 1892 14;
BA_ "FrameRouting" BO_ 1798 "";
BA_ "NetworkInitialization" BO_ 1798 0;
BA_ "GenMsgDelayTime" BO_ 1798 0;
BA_ "GenMsgSendType" BO_ 1798 1;
BA_ "DiagRequest" BO_ 1798 1;
BA_ "GenMsgILSupport" BO_ 1798 0;
BA_ "VFrameFormat" BO_ 1798 14;
BA_ "FrameRouting" BO_ 1123 "";
BA_ "FrameGatewayNetwork" BO_ 1123 "HS3_CAN";
BA_ "FrameGatewayId" BO_ 1123 1123;
BA_ "VFrameFormat" BO_ 1123 14;
BA_ "FrameRouting" BO_ 1122 "";
BA_ "FrameGatewayNetwork" BO_ 1122 "HS3_CAN";
BA_ "FrameGatewayId" BO_ 1122 1122;
BA_ "VFrameFormat" BO_ 1122 14;
BA_ "FrameRouting" BO_ 1003 "";
BA_ "FrameGatewayNetwork" BO_ 1003 "HS1_CAN";
BA_ "FrameGatewayId" BO_ 1003 1003;
BA_ "VFrameFormat" BO_ 1003 14;
BA_ "FrameRouting" BO_ 994 "";
BA_ "FrameGatewayNetwork" BO_ 994 "HS3_CAN";
BA_ "FrameGatewayId" BO_ 994 994;
BA_ "VFrameFormat" BO_ 994 14;
BA_ "FrameRouting" BO_ 778 "";
BA_ "FrameGatewayId" BO_ 778 778;
BA_ "FrameGatewayNetwork" BO_ 778 "HS3_CAN";
BA_ "VFrameFormat" BO_ 778 14;
BA_ "FrameRouting" BO_ 551 "";
BA_ "FrameGatewayId" BO_ 551 551;
BA_ "FrameGatewayNetwork" BO_ 551 "HS3_CAN";
BA_ "VFrameFormat" BO_ 551 14;
BA_ "FrameRouting" BO_ 1010 "";
BA_ "GenMsgCycleTime" BO_ 1010 50;
BA_ "GenMsgSendType" BO_ 1010 0;
BA_ "VFrameFormat" BO_ 1010 14;
BA_ "FrameRouting" BO_ 1070 "";
BA_ "FrameGatewayNetwork" BO_ 1070 "HS1_CAN";
BA_ "FrameGatewayId" BO_ 1070 1070;
BA_ "VFrameFormat" BO_ 1070 14;
BA_ "FrameRouting" BO_ 1186 "";
BA_ "GenMsgSendType" BO_ 1186 0;
BA_ "GenMsgCycleTime" BO_ 1186 100;
BA_ "VFrameFormat" BO_ 1186 14;
BA_ "FrameRouting" BO_ 1461 "";
BA_ "GenMsgILSupport" BO_ 1461 0;
BA_ "NmAsrMessage" BO_ 1461 1;
BA_ "GenMsgSendType" BO_ 1461 0;
BA_ "GenMsgCycleTime" BO_ 1461 1000;
BA_ "NetworkInitialization" BO_ 1461 0;
BA_ "VFrameFormat" BO_ 1461 14;
BA_ "FrameRouting" BO_ 1047 "";
BA_ "GenMsgSendType" BO_ 1047 5;
BA_ "GenMsgCycleTime" BO_ 1047 1000;
BA_ "VFrameFormat" BO_ 1047 14;
BA_ "FrameRouting" BO_ 972 "";
BA_ "GenMsgSendType" BO_ 972 0;
BA_ "GenMsgCycleTime" BO_ 972 30;
BA_ "GenMsgDelayTime" BO_ 972 10;
BA_ "VFrameFormat" BO_ 972 14;
BA_ "FrameRouting" BO_ 1430 "";
BA_ "GenMsgILSupport" BO_ 1430 0;
BA_ "NmAsrMessage" BO_ 1430 1;
BA_ "GenMsgSendType" BO_ 1430 0;
BA_ "GenMsgCycleTime" BO_ 1430 1000;
BA_ "NetworkInitialization" BO_ 1430 0;
BA_ "VFrameFormat" BO_ 1430 14;
BA_ "FrameRouting" BO_ 1102 "";
BA_ "GenMsgSendType" BO_ 1102 5;
BA_ "GenMsgCycleTime" BO_ 1102 100000;
BA_ "GenMsgStartDelayTime" BO_ 1102 1130;
BA_ "VFrameFormat" BO_ 1102 14;
BA_ "FrameRouting" BO_ 1056 "";
BA_ "GenMsgSendType" BO_ 1056 5;
BA_ "GenMsgCycleTime" BO_ 1056 1000;
BA_ "VFrameFormat" BO_ 1056 14;
BA_ "FrameRouting" BO_ 1054 "";
BA_ "GenMsgSendType" BO_ 1054 5;
BA_ "GenMsgCycleTime" BO_ 1054 1000;
BA_ "VFrameFormat" BO_ 1054 14;
BA_ "FrameRouting" BO_ 1045 "";
BA_ "GenMsgSendType" BO_ 1045 0;
BA_ "GenMsgCycleTime" BO_ 1045 20;
BA_ "GenMsgDelayTime" BO_ 1045 10;
BA_ "VFrameFormat" BO_ 1045 14;
BA_ "FrameRouting" BO_ 1042 "";
BA_ "GenMsgSendType" BO_ 1042 0;
BA_ "GenMsgCycleTime" BO_ 1042 50;
BA_ "VFrameFormat" BO_ 1042 14;
BA_ "FrameRouting" BO_ 535 "";
BA_ "GenMsgSendType" BO_ 535 0;
BA_ "GenMsgCycleTime" BO_ 535 10;
BA_ "GenMsgDelayTime" BO_ 535 0;
BA_ "VFrameFormat" BO_ 535 14;
BA_ "FrameRouting" BO_ 532 "";
BA_ "GenMsgSendType" BO_ 532 0;
BA_ "GenMsgCycleTime" BO_ 532 20;
BA_ "GenMsgDelayTime" BO_ 532 10;
BA_ "VFrameFormat" BO_ 532 14;
BA_ "FrameRouting" BO_ 136 "";
BA_ "GenMsgSendType" BO_ 136 0;
BA_ "GenMsgCycleTime" BO_ 136 10;
BA_ "GenMsgDelayTime" BO_ 136 0;
BA_ "VFrameFormat" BO_ 136 14;
BA_ "FrameRouting" BO_ 125 "";
BA_ "GenMsgSendType" BO_ 125 0;
BA_ "GenMsgCycleTime" BO_ 125 20;
BA_ "GenMsgDelayTime" BO_ 125 10;
BA_ "VFrameFormat" BO_ 125 14;
BA_ "FrameRouting" BO_ 119 "";
BA_ "GenMsgSendType" BO_ 119 0;
BA_ "GenMsgCycleTime" BO_ 119 20;
BA_ "GenMsgDelayTime" BO_ 119 10;
BA_ "VFrameFormat" BO_ 119 14;
BA_ "FrameRouting" BO_ 118 "";
BA_ "GenMsgSendType" BO_ 118 5;
BA_ "GenMsgCycleTime" BO_ 118 500;
BA_ "VFrameFormat" BO_ 118 14;
BA_ "FrameRouting" BO_ 73 "";
BA_ "GenMsgSendType" BO_ 73 0;
BA_ "GenMsgCycleTime" BO_ 73 20;
BA_ "GenMsgDelayTime" BO_ 73 10;
BA_ "VFrameFormat" BO_ 73 14;
BA_ "FrameRouting" BO_ 1440 "";
BA_ "GenMsgILSupport" BO_ 1440 0;
BA_ "NmAsrMessage" BO_ 1440 1;
BA_ "GenMsgSendType" BO_ 1440 0;
BA_ "GenMsgCycleTime" BO_ 1440 1000;
BA_ "NetworkInitialization" BO_ 1440 0;
BA_ "VFrameFormat" BO_ 1440 14;
BA_ "FrameRouting" BO_ 561 "";
BA_ "GenMsgSendType" BO_ 561 0;
BA_ "GenMsgCycleTime" BO_ 561 100;
BA_ "VFrameFormat" BO_ 561 14;
BA_ "FrameRouting" BO_ 870 "";
BA_ "GenMsgSendType" BO_ 870 0;
BA_ "GenMsgCycleTime" BO_ 870 100;
BA_ "VFrameFormat" BO_ 870 14;
BA_ "FrameRouting" BO_ 869 "";
BA_ "GenMsgSendType" BO_ 869 0;
BA_ "GenMsgCycleTime" BO_ 869 100;
BA_ "VFrameFormat" BO_ 869 14;
BA_ "FrameRouting" BO_ 606 "";
BA_ "GenMsgSendType" BO_ 606 5;
BA_ "GenMsgCycleTime" BO_ 606 1000;
BA_ "VFrameFormat" BO_ 606 14;
BA_ "FrameRouting" BO_ 602 "";
BA_ "GenMsgSendType" BO_ 602 0;
BA_ "GenMsgCycleTime" BO_ 602 100;
BA_ "VFrameFormat" BO_ 602 14;
BA_ "FrameRouting" BO_ 1152 "";
BA_ "GenMsgSendType" BO_ 1152 5;
BA_ "GenMsgCycleTime" BO_ 1152 1000;
BA_ "VFrameFormat" BO_ 1152 14;
BA_ "FrameRouting" BO_ 2030 "";
BA_ "GenMsgILSupport" BO_ 2030 0;
BA_ "DiagResponse" BO_ 2030 1;
BA_ "GenMsgSendType" BO_ 2030 1;
BA_ "GenMsgDelayTime" BO_ 2030 0;
BA_ "NetworkInitialization" BO_ 2030 0;
BA_ "VFrameFormat" BO_ 2030 14;
BA_ "FrameRouting" BO_ 332 "";
BA_ "GenMsgSendType" BO_ 332 0;
BA_ "GenMsgCycleTime" BO_ 332 200;
BA_ "VFrameFormat" BO_ 332 14;
BA_ "FrameRouting" BO_ 1896 "";
BA_ "GenMsgILSupport" BO_ 1896 0;
BA_ "DiagResponse" BO_ 1896 1;
BA_ "GenMsgSendType" BO_ 1896 1;
BA_ "GenMsgDelayTime" BO_ 1896 0;
BA_ "NetworkInitialization" BO_ 1896 0;
BA_ "VFrameFormat" BO_ 1896 14;
BA_ "FrameRouting" BO_ 1889 "";
BA_ "GenMsgILSupport" BO_ 1889 0;
BA_ "DiagRequest" BO_ 1889 1;
BA_ "GenMsgSendType" BO_ 1889 1;
BA_ "GenMsgDelayTime" BO_ 1889 0;
BA_ "NetworkInitialization" BO_ 1889 0;
BA_ "VFrameFormat" BO_ 1889 14;
BA_ "FrameRouting" BO_ 1888 "";
BA_ "GenMsgILSupport" BO_ 1888 0;
BA_ "DiagRequest" BO_ 1888 1;
BA_ "GenMsgSendType" BO_ 1888 1;
BA_ "GenMsgDelayTime" BO_ 1888 0;
BA_ "NetworkInitialization" BO_ 1888 0;
BA_ "VFrameFormat" BO_ 1888 14;
BA_ "FrameRouting" BO_ 1848 "";
BA_ "GenMsgILSupport" BO_ 1848 0;
BA_ "DiagResponse" BO_ 1848 1;
BA_ "GenMsgSendType" BO_ 1848 1;
BA_ "GenMsgDelayTime" BO_ 1848 0;
BA_ "NetworkInitialization" BO_ 1848 0;
BA_ "VFrameFormat" BO_ 1848 14;
BA_ "FrameRouting" BO_ 1840 "";
BA_ "GenMsgILSupport" BO_ 1840 0;
BA_ "DiagRequest" BO_ 1840 1;
BA_ "GenMsgSendType" BO_ 1840 1;
BA_ "GenMsgDelayTime" BO_ 1840 0;
BA_ "NetworkInitialization" BO_ 1840 0;
BA_ "VFrameFormat" BO_ 1840 14;
BA_ "FrameRouting" BO_ 1713 "";
BA_ "GenMsgILSupport" BO_ 1713 0;
BA_ "TpApplType" BO_ 1713 "DiagUUDTResponse";
BA_ "GenMsgSendType" BO_ 1713 1;
BA_ "NetworkInitialization" BO_ 1713 0;
BA_ "VFrameFormat" BO_ 1713 14;
BA_ "FrameRouting" BO_ 1712 "";
BA_ "GenMsgILSupport" BO_ 1712 0;
BA_ "TpApplType" BO_ 1712 "DiagUUDTResponse";
BA_ "GenMsgSendType" BO_ 1712 1;
BA_ "NetworkInitialization" BO_ 1712 0;
BA_ "VFrameFormat" BO_ 1712 14;
BA_ "FrameRouting" BO_ 2025 "";
BA_ "GenMsgILSupport" BO_ 2025 0;
BA_ "DiagResponse" BO_ 2025 1;
BA_ "GenMsgSendType" BO_ 2025 1;
BA_ "GenMsgDelayTime" BO_ 2025 0;
BA_ "NetworkInitialization" BO_ 2025 0;
BA_ "VFrameFormat" BO_ 2025 14;
BA_ "FrameRouting" BO_ 2024 "";
BA_ "GenMsgILSupport" BO_ 2024 0;
BA_ "DiagResponse" BO_ 2024 1;
BA_ "GenMsgSendType" BO_ 2024 1;
BA_ "GenMsgDelayTime" BO_ 2024 0;
BA_ "NetworkInitialization" BO_ 2024 0;
BA_ "VFrameFormat" BO_ 2024 14;
BA_ "FrameRouting" BO_ 2017 "";
BA_ "GenMsgILSupport" BO_ 2017 0;
BA_ "DiagRequest" BO_ 2017 1;
BA_ "GenMsgSendType" BO_ 2017 1;
BA_ "GenMsgDelayTime" BO_ 2017 0;
BA_ "NetworkInitialization" BO_ 2017 0;
BA_ "VFrameFormat" BO_ 2017 14;
BA_ "FrameRouting" BO_ 2016 "";
BA_ "GenMsgILSupport" BO_ 2016 0;
BA_ "DiagRequest" BO_ 2016 1;
BA_ "GenMsgSendType" BO_ 2016 1;
BA_ "GenMsgDelayTime" BO_ 2016 0;
BA_ "NetworkInitialization" BO_ 2016 0;
BA_ "VFrameFormat" BO_ 2016 14;
BA_ "FrameRouting" BO_ 2015 "";
BA_ "GenMsgILSupport" BO_ 2015 0;
BA_ "DiagState" BO_ 2015 1;
BA_ "GenMsgSendType" BO_ 2015 1;
BA_ "GenMsgDelayTime" BO_ 2015 0;
BA_ "NetworkInitialization" BO_ 2015 0;
BA_ "VFrameFormat" BO_ 2015 14;
BA_ "FrameRouting" BO_ 1897 "";
BA_ "GenMsgILSupport" BO_ 1897 0;
BA_ "DiagResponse" BO_ 1897 1;
BA_ "GenMsgSendType" BO_ 1897 1;
BA_ "GenMsgDelayTime" BO_ 1897 0;
BA_ "NetworkInitialization" BO_ 1897 0;
BA_ "VFrameFormat" BO_ 1897 14;
BA_ "FrameRouting" BO_ 1814 "";
BA_ "GenMsgILSupport" BO_ 1814 0;
BA_ "DiagRequest" BO_ 1814 1;
BA_ "GenMsgSendType" BO_ 1814 1;
BA_ "GenMsgDelayTime" BO_ 1814 0;
BA_ "NetworkInitialization" BO_ 1814 0;
BA_ "VFrameFormat" BO_ 1814 14;
BA_ "FrameRouting" BO_ 1701 "";
BA_ "GenMsgILSupport" BO_ 1701 0;
BA_ "TpApplType" BO_ 1701 "DiagUUDTResponse";
BA_ "GenMsgSendType" BO_ 1701 1;
BA_ "NetworkInitialization" BO_ 1701 0;
BA_ "VFrameFormat" BO_ 1701 14;
BA_ "FrameRouting" BO_ 1700 "";
BA_ "GenMsgILSupport" BO_ 1700 0;
BA_ "TpApplType" BO_ 1700 "DiagUUDTResponse";
BA_ "GenMsgSendType" BO_ 1700 1;
BA_ "NetworkInitialization" BO_ 1700 0;
BA_ "VFrameFormat" BO_ 1700 14;
BA_ "FrameRouting" BO_ 1697 "";
BA_ "GenMsgILSupport" BO_ 1697 0;
BA_ "TpApplType" BO_ 1697 "DiagUUDTResponse";
BA_ "GenMsgSendType" BO_ 1697 1;
BA_ "NetworkInitialization" BO_ 1697 0;
BA_ "VFrameFormat" BO_ 1697 14;
BA_ "FrameRouting" BO_ 1696 "";
BA_ "GenMsgILSupport" BO_ 1696 0;
BA_ "TpApplType" BO_ 1696 "DiagUUDTResponse";
BA_ "GenMsgSendType" BO_ 1696 1;
BA_ "NetworkInitialization" BO_ 1696 0;
BA_ "VFrameFormat" BO_ 1696 14;
BA_ "FrameRouting" BO_ 1429 "";
BA_ "GenMsgILSupport" BO_ 1429 0;
BA_ "NmAsrMessage" BO_ 1429 1;
BA_ "GenMsgSendType" BO_ 1429 0;
BA_ "GenMsgCycleTime" BO_ 1429 1000;
BA_ "NetworkInitialization" BO_ 1429 0;
BA_ "VFrameFormat" BO_ 1429 14;
BA_ "FrameRouting" BO_ 1098 "";
BA_ "GenMsgSendType" BO_ 1098 5;
BA_ "GenMsgCycleTime" BO_ 1098 500;
BA_ "VFrameFormat" BO_ 1098 14;
BA_ "FrameRouting" BO_ 1055 "";
BA_ "GenMsgSendType" BO_ 1055 0;
BA_ "GenMsgCycleTime" BO_ 1055 100;
BA_ "VFrameFormat" BO_ 1055 14;
BA_ "FrameRouting" BO_ 523 "";
BA_ "GenMsgSendType" BO_ 523 0;
BA_ "GenMsgCycleTime" BO_ 523 1000;
BA_ "VFrameFormat" BO_ 523 14;
BA_ "FrameRouting" BO_ 517 "";
BA_ "GenMsgSendType" BO_ 517 0;
BA_ "GenMsgCycleTime" BO_ 517 20;
BA_ "GenMsgDelayTime" BO_ 517 10;
BA_ "VFrameFormat" BO_ 517 14;
BA_ "FrameRouting" BO_ 381 "";
BA_ "GenMsgSendType" BO_ 381 0;
BA_ "GenMsgCycleTime" BO_ 381 100;
BA_ "VFrameFormat" BO_ 381 14;
BA_ "FrameRouting" BO_ 373 "";
BA_ "GenMsgSendType" BO_ 373 0;
BA_ "GenMsgCycleTime" BO_ 373 20;
BA_ "GenMsgDelayTime" BO_ 373 10;
BA_ "VFrameFormat" BO_ 373 14;
BA_ "FrameRouting" BO_ 355 "";
BA_ "GenMsgSendType" BO_ 355 0;
BA_ "GenMsgCycleTime" BO_ 355 100;
BA_ "VFrameFormat" BO_ 355 14;
BA_ "FrameRouting" BO_ 71 "";
BA_ "GenMsgSendType" BO_ 71 0;
BA_ "GenMsgCycleTime" BO_ 71 20;
BA_ "GenMsgDelayTime" BO_ 71 10;
BA_ "VFrameFormat" BO_ 71 14;
BA_ "FrameRouting" BO_ 1822 "";
BA_ "GenMsgILSupport" BO_ 1822 0;
BA_ "DiagResponse" BO_ 1822 1;
BA_ "GenMsgSendType" BO_ 1822 1;
BA_ "GenMsgDelayTime" BO_ 1822 0;
BA_ "NetworkInitialization" BO_ 1822 0;
BA_ "VFrameFormat" BO_ 1822 14;
BA_ "FrameRouting" BO_ 1438 "";
BA_ "GenMsgILSupport" BO_ 1438 0;
BA_ "NmAsrMessage" BO_ 1438 1;
BA_ "GenMsgSendType" BO_ 1438 0;
BA_ "GenMsgCycleTime" BO_ 1438 1000;
BA_ "NetworkInitialization" BO_ 1438 0;
BA_ "VFrameFormat" BO_ 1438 14;
BA_ "FrameRouting" BO_ 1006 "";
BA_ "GenMsgSendType" BO_ 1006 5;
BA_ "GenMsgCycleTime" BO_ 1006 1000;
BA_ "VFrameFormat" BO_ 1006 14;
BA_ "FrameRouting" BO_ 820 "";
BA_ "FrameGatewayNetwork" BO_ 820 "HS2_CAN";
BA_ "FrameGatewayId" BO_ 820 820;
BA_ "VFrameFormat" BO_ 820 14;
BA_ "FrameRouting" BO_ 137 "";
BA_ "FrameGatewayId" BO_ 137 137;
BA_ "FrameGatewayNetwork" BO_ 137 "HS2_CAN";
BA_ "VFrameFormat" BO_ 137 14;
BA_ "FrameRouting" BO_ 129 "";
BA_ "FrameGatewayId" BO_ 129 129;
BA_ "FrameGatewayNetwork" BO_ 129 "HS2_CAN";
BA_ "VFrameFormat" BO_ 129 14;
BA_ "FrameRouting" BO_ 1108 "";
BA_ "FrameGatewayId" BO_ 1108 1108;
BA_ "FrameGatewayNetwork" BO_ 1108 "HS2_CAN";
BA_ "VFrameFormat" BO_ 1108 14;
BA_ "FrameRouting" BO_ 261 "";
BA_ "FrameGatewayId" BO_ 261 261;
BA_ "FrameGatewayNetwork" BO_ 261 "HS3_CAN";
BA_ "VFrameFormat" BO_ 261 14;
BA_ "FrameRouting" BO_ 1146 "";
BA_ "FrameGatewayId" BO_ 1146 1146;
BA_ "FrameGatewayNetwork" BO_ 1146 "HS3_CAN";
BA_ "VFrameFormat" BO_ 1146 14;
BA_ "FrameRouting" BO_ 533 "";
BA_ "FrameGatewayId" BO_ 533 533;
BA_ "FrameGatewayNetwork" BO_ 533 "HS3_CAN";
BA_ "VFrameFormat" BO_ 533 14;
BA_ "FrameRouting" BO_ 1041 "";
BA_ "FrameGatewayId" BO_ 1041 1041;
BA_ "FrameGatewayNetwork" BO_ 1041 "HS1_CAN";
BA_ "VFrameFormat" BO_ 1041 14;
BA_ "FrameRouting" BO_ 1067 "";
BA_ "FrameGatewayId" BO_ 1067 1067;
BA_ "FrameGatewayNetwork" BO_ 1067 "HS1_CAN";
BA_ "VFrameFormat" BO_ 1067 14;
BA_ "FrameRouting" BO_ 139 "";
BA_ "FrameGatewayId" BO_ 139 139;
BA_ "FrameGatewayNetwork" BO_ 139 "HS2_CAN";
BA_ "VFrameFormat" BO_ 139 14;
BA_ "FrameRouting" BO_ 1121 "";
BA_ "FrameGatewayId" BO_ 1121 1121;
BA_ "FrameGatewayNetwork" BO_ 1121 "HS2_CAN";
BA_ "VFrameFormat" BO_ 1121 14;
BA_ "FrameRouting" BO_ 1120 "";
BA_ "FrameGatewayId" BO_ 1120 1120;
BA_ "FrameGatewayNetwork" BO_ 1120 "HS2_CAN";
BA_ "VFrameFormat" BO_ 1120 14;
BA_ "FrameRouting" BO_ 1137 "";
BA_ "GenMsgSendType" BO_ 1137 0;
BA_ "GenMsgCycleTime" BO_ 1137 1000;
BA_ "VFrameFormat" BO_ 1137 14;
BA_ "FrameRouting" BO_ 1255 "";
BA_ "GenMsgSendType" BO_ 1255 0;
BA_ "GenMsgCycleTime" BO_ 1255 1000;
BA_ "VFrameFormat" BO_ 1255 14;
BA_ "FrameRouting" BO_ 1254 "";
BA_ "GenMsgSendType" BO_ 1254 0;
BA_ "GenMsgCycleTime" BO_ 1254 1000;
BA_ "VFrameFormat" BO_ 1254 14;
BA_ "FrameRouting" BO_ 1253 "";
BA_ "GenMsgSendType" BO_ 1253 0;
BA_ "GenMsgCycleTime" BO_ 1253 1000;
BA_ "VFrameFormat" BO_ 1253 14;
BA_ "FrameRouting" BO_ 1252 "";
BA_ "GenMsgSendType" BO_ 1252 0;
BA_ "GenMsgCycleTime" BO_ 1252 1000;
BA_ "VFrameFormat" BO_ 1252 14;
BA_ "FrameRouting" BO_ 1251 "";
BA_ "GenMsgSendType" BO_ 1251 0;
BA_ "GenMsgCycleTime" BO_ 1251 1000;
BA_ "VFrameFormat" BO_ 1251 14;
BA_ "FrameRouting" BO_ 1250 "";
BA_ "GenMsgSendType" BO_ 1250 0;
BA_ "GenMsgCycleTime" BO_ 1250 1000;
BA_ "VFrameFormat" BO_ 1250 14;
BA_ "FrameRouting" BO_ 1249 "";
BA_ "GenMsgSendType" BO_ 1249 0;
BA_ "GenMsgCycleTime" BO_ 1249 1000;
BA_ "VFrameFormat" BO_ 1249 14;
BA_ "FrameRouting" BO_ 1248 "";
BA_ "GenMsgSendType" BO_ 1248 0;
BA_ "GenMsgCycleTime" BO_ 1248 1000;
BA_ "VFrameFormat" BO_ 1248 14;
BA_ "FrameRouting" BO_ 1113 "";
BA_ "GenMsgSendType" BO_ 1113 0;
BA_ "GenMsgCycleTime" BO_ 1113 50;
BA_ "VFrameFormat" BO_ 1113 14;
BA_ "FrameRouting" BO_ 1105 "";
BA_ "GenMsgSendType" BO_ 1105 5;
BA_ "GenMsgCycleTime" BO_ 1105 1000;
BA_ "VFrameFormat" BO_ 1105 14;
BA_ "FrameRouting" BO_ 938 "";
BA_ "GenMsgSendType" BO_ 938 5;
BA_ "GenMsgCycleTime" BO_ 938 200;
BA_ "VFrameFormat" BO_ 938 14;
BA_ "FrameRouting" BO_ 939 "";
BA_ "GenMsgSendType" BO_ 939 5;
BA_ "GenMsgCycleTime" BO_ 939 200;
BA_ "VFrameFormat" BO_ 939 14;
BA_ "FrameRouting" BO_ 937 "";
BA_ "GenMsgSendType" BO_ 937 0;
BA_ "GenMsgCycleTime" BO_ 937 20;
BA_ "GenMsgDelayTime" BO_ 937 10;
BA_ "VFrameFormat" BO_ 937 14;
BA_ "FrameRouting" BO_ 936 "";
BA_ "GenMsgSendType" BO_ 936 0;
BA_ "GenMsgCycleTime" BO_ 936 20;
BA_ "GenMsgDelayTime" BO_ 936 10;
BA_ "VFrameFormat" BO_ 936 14;
BA_ "FrameRouting" BO_ 877 "";
BA_ "GenMsgSendType" BO_ 877 5;
BA_ "GenMsgCycleTime" BO_ 877 1000;
BA_ "VFrameFormat" BO_ 877 14;
BA_ "FrameRouting" BO_ 589 "";
BA_ "FrameGatewayId" BO_ 589 589;
BA_ "FrameGatewayNetwork" BO_ 589 "HS1_CAN";
BA_ "VFrameFormat" BO_ 589 14;
BA_ "FrameRouting" BO_ 588 "";
BA_ "FrameGatewayId" BO_ 588 588;
BA_ "FrameGatewayNetwork" BO_ 588 "HS1_CAN";
BA_ "VFrameFormat" BO_ 588 14;
BA_ "FrameRouting" BO_ 587 "";
BA_ "FrameGatewayId" BO_ 587 587;
BA_ "FrameGatewayNetwork" BO_ 587 "HS1_CAN";
BA_ "VFrameFormat" BO_ 587 14;
BA_ "FrameRouting" BO_ 389 "";
BA_ "GenMsgSendType" BO_ 389 0;
BA_ "GenMsgCycleTime" BO_ 389 100;
BA_ "VFrameFormat" BO_ 389 14;
BA_ "FrameRouting" BO_ 122 "";
BA_ "FrameGatewayId" BO_ 122 122;
BA_ "FrameGatewayNetwork" BO_ 122 "HS1_CAN";
BA_ "VFrameFormat" BO_ 122 14;
BA_ "FrameRouting" BO_ 1091 "";
BA_ "FrameGatewayId" BO_ 1091 1091;
BA_ "FrameGatewayNetwork" BO_ 1091 "HS3_CAN";
BA_ "VFrameFormat" BO_ 1091 14;
BA_ "FrameRouting" BO_ 131 "";
BA_ "FrameGatewayId" BO_ 131 131;
BA_ "FrameGatewayNetwork" BO_ 131 "HS2_CAN";
BA_ "VFrameFormat" BO_ 131 14;
BA_ "FrameRouting" BO_ 787 "";
BA_ "FrameGatewayId" BO_ 787 787;
BA_ "FrameGatewayNetwork" BO_ 787 "MS2_CAN";
BA_ "VFrameFormat" BO_ 787 14;
BA_ "FrameRouting" BO_ 953 "";
BA_ "FrameGatewayId" BO_ 953 953;
BA_ "FrameGatewayNetwork" BO_ 953 "HS1_CAN";
BA_ "VFrameFormat" BO_ 953 14;
BA_ "FrameRouting" BO_ 968 "";
BA_ "FrameGatewayId" BO_ 968 968;
BA_ "FrameGatewayNetwork" BO_ 968 "HS3_CAN";
BA_ "VFrameFormat" BO_ 968 14;
BA_ "FrameRouting" BO_ 819 "";
BA_ "FrameGatewayId" BO_ 819 819;
BA_ "FrameGatewayNetwork" BO_ 819 "MS1_CAN";
BA_ "VFrameFormat" BO_ 819 14;
BA_ "FrameRouting" BO_ 818 "";
BA_ "FrameGatewayId" BO_ 818 818;
BA_ "FrameGatewayNetwork" BO_ 818 "MS1_CAN";
BA_ "VFrameFormat" BO_ 818 14;
BA_ "FrameRouting" BO_ 559 "";
BA_ "FrameGatewayId" BO_ 559 559;
BA_ "FrameGatewayNetwork" BO_ 559 "HS3_CAN";
BA_ "VFrameFormat" BO_ 559 14;
BA_ "FrameRouting" BO_ 558 "";
BA_ "FrameGatewayId" BO_ 558 558;
BA_ "FrameGatewayNetwork" BO_ 558 "HS3_CAN";
BA_ "VFrameFormat" BO_ 558 14;
BA_ "FrameRouting" BO_ 909 "";
BA_ "FrameGatewayId" BO_ 909 909;
BA_ "FrameGatewayNetwork" BO_ 909 "HS1_CAN";
BA_ "VFrameFormat" BO_ 909 14;
BA_ "FrameRouting" BO_ 963 "";
BA_ "FrameGatewayId" BO_ 963 963;
BA_ "FrameGatewayNetwork" BO_ 963 "HS1_CAN";
BA_ "VFrameFormat" BO_ 963 14;
BA_ "FrameRouting" BO_ 76 "";
BA_ "FrameGatewayId" BO_ 76 76;
BA_ "FrameGatewayNetwork" BO_ 76 "HS2_CAN";
BA_ "VFrameFormat" BO_ 76 14;
BA_ "FrameRouting" BO_ 65 "";
BA_ "FrameGatewayId" BO_ 65 65;
BA_ "FrameGatewayNetwork" BO_ 65 "HS1_CAN";
BA_ "VFrameFormat" BO_ 65 14;
BA_ "FrameRouting" BO_ 1076 "";
BA_ "FrameGatewayId" BO_ 1076 1076;
BA_ "FrameGatewayNetwork" BO_ 1076 "HS3_CAN";
BA_ "VFrameFormat" BO_ 1076 14;
BA_ "FrameRouting" BO_ 578 "";
BA_ "FrameGatewayId" BO_ 578 578;
BA_ "FrameGatewayNetwork" BO_ 578 "HS1_CAN";
BA_ "VFrameFormat" BO_ 578 14;
BA_ "FrameRouting" BO_ 1084 "";
BA_ "FrameGatewayId" BO_ 1084 1084;
BA_ "FrameGatewayNetwork" BO_ 1084 "HS1_CAN";
BA_ "VFrameFormat" BO_ 1084 14;
BA_ "FrameRouting" BO_ 1068 "";
BA_ "FrameGatewayId" BO_ 1068 1068;
BA_ "FrameGatewayNetwork" BO_ 1068 "HS1_CAN";
BA_ "VFrameFormat" BO_ 1068 14;
BA_ "FrameRouting" BO_ 146 "";
BA_ "FrameGatewayId" BO_ 146 146;
BA_ "FrameGatewayNetwork" BO_ 146 "HS2_CAN";
BA_ "VFrameFormat" BO_ 146 14;
BA_ "FrameRouting" BO_ 1900 "";
BA_ "GenMsgILSupport" BO_ 1900 0;
BA_ "DiagResponse" BO_ 1900 1;
BA_ "GenMsgSendType" BO_ 1900 1;
BA_ "GenMsgDelayTime" BO_ 1900 0;
BA_ "NetworkInitialization" BO_ 1900 0;
BA_ "VFrameFormat" BO_ 1900 14;
BA_ "FrameRouting" BO_ 1806 "";
BA_ "GenMsgILSupport" BO_ 1806 0;
BA_ "DiagResponse" BO_ 1806 1;
BA_ "GenMsgSendType" BO_ 1806 1;
BA_ "GenMsgDelayTime" BO_ 1806 0;
BA_ "NetworkInitialization" BO_ 1806 0;
BA_ "VFrameFormat" BO_ 1806 14;
BA_ "FrameRouting" BO_ 997 "";
BA_ "GenMsgSendType" BO_ 997 5;
BA_ "GenMsgCycleTime" BO_ 997 1000;
BA_ "VFrameFormat" BO_ 997 14;
BA_ "FrameRouting" BO_ 983 "";
BA_ "GenMsgSendType" BO_ 983 0;
BA_ "GenMsgCycleTime" BO_ 983 50;
BA_ "VFrameFormat" BO_ 983 14;
BA_ "FrameRouting" BO_ 980 "";
BA_ "GenMsgSendType" BO_ 980 0;
BA_ "GenMsgCycleTime" BO_ 980 30;
BA_ "GenMsgDelayTime" BO_ 980 10;
BA_ "VFrameFormat" BO_ 980 14;
BA_ "FrameRouting" BO_ 979 "";
BA_ "GenMsgSendType" BO_ 979 0;
BA_ "GenMsgCycleTime" BO_ 979 50;
BA_ "VFrameFormat" BO_ 979 14;
BA_ "FrameRouting" BO_ 976 "";
BA_ "GenMsgSendType" BO_ 976 0;
BA_ "GenMsgCycleTime" BO_ 976 100;
BA_ "VFrameFormat" BO_ 976 14;
BA_ "FrameRouting" BO_ 973 "";
BA_ "GenMsgSendType" BO_ 973 5;
BA_ "GenMsgCycleTime" BO_ 973 1000;
BA_ "VFrameFormat" BO_ 973 14;
BA_ "FrameRouting" BO_ 970 "";
BA_ "GenMsgSendType" BO_ 970 0;
BA_ "GenMsgCycleTime" BO_ 970 30;
BA_ "GenMsgDelayTime" BO_ 970 10;
BA_ "VFrameFormat" BO_ 970 14;
BA_ "FrameRouting" BO_ 962 "";
BA_ "GenMsgSendType" BO_ 962 5;
BA_ "GenMsgCycleTime" BO_ 962 1000;
BA_ "VFrameFormat" BO_ 962 14;
BA_ "FrameRouting" BO_ 961 "";
BA_ "GenMsgSendType" BO_ 961 5;
BA_ "GenMsgCycleTime" BO_ 961 1000;
BA_ "VFrameFormat" BO_ 961 14;
BA_ "FrameRouting" BO_ 1441 "";
BA_ "GenMsgILSupport" BO_ 1441 0;
BA_ "NmAsrMessage" BO_ 1441 1;
BA_ "GenMsgSendType" BO_ 1441 0;
BA_ "GenMsgCycleTime" BO_ 1441 1000;
BA_ "NetworkInitialization" BO_ 1441 0;
BA_ "VFrameFormat" BO_ 1441 14;
BA_ "FrameRouting" BO_ 1787 "";
BA_ "GenMsgILSupport" BO_ 1787 0;
BA_ "DiagResponse" BO_ 1787 1;
BA_ "GenMsgSendType" BO_ 1787 1;
BA_ "GenMsgDelayTime" BO_ 1787 0;
BA_ "VFrameFormat" BO_ 1787 14;
BA_ "FrameRouting" BO_ 1779 "";
BA_ "GenMsgILSupport" BO_ 1779 0;
BA_ "DiagRequest" BO_ 1779 1;
BA_ "GenMsgSendType" BO_ 1779 1;
BA_ "GenMsgDelayTime" BO_ 1779 0;
BA_ "VFrameFormat" BO_ 1779 14;
BA_ "FrameRouting" BO_ 1786 "";
BA_ "GenMsgILSupport" BO_ 1786 0;
BA_ "DiagResponse" BO_ 1786 1;
BA_ "GenMsgSendType" BO_ 1786 1;
BA_ "GenMsgDelayTime" BO_ 1786 0;
BA_ "VFrameFormat" BO_ 1786 14;
BA_ "FrameRouting" BO_ 1778 "";
BA_ "GenMsgILSupport" BO_ 1778 0;
BA_ "DiagRequest" BO_ 1778 1;
BA_ "GenMsgSendType" BO_ 1778 1;
BA_ "GenMsgDelayTime" BO_ 1778 0;
BA_ "VFrameFormat" BO_ 1778 14;
BA_ "FrameRouting" BO_ 1153 "";
BA_ "FrameGatewayId" BO_ 1153 1152;
BA_ "FrameGatewayNetwork" BO_ 1153 "HS2_CAN";
BA_ "VFrameFormat" BO_ 1153 14;
BA_ "FrameRouting" BO_ 930 "";
BA_ "GenMsgSendType" BO_ 930 5;
BA_ "GenMsgCycleTime" BO_ 930 1000;
BA_ "VFrameFormat" BO_ 930 14;
BA_ "FrameRouting" BO_ 929 "";
BA_ "GenMsgSendType" BO_ 929 5;
BA_ "GenMsgCycleTime" BO_ 929 1000;
BA_ "VFrameFormat" BO_ 929 14;
BA_ "FrameRouting" BO_ 402 "";
BA_ "FrameGatewayId" BO_ 402 402;
BA_ "FrameGatewayNetwork" BO_ 402 "HS3_CAN";
BA_ "VFrameFormat" BO_ 402 14;
BA_ "FrameRouting" BO_ 924 "";
BA_ "FrameGatewayId" BO_ 924 924;
BA_ "FrameGatewayNetwork" BO_ 924 "HS1_CAN";
BA_ "VFrameFormat" BO_ 924 14;
BA_ "FrameRouting" BO_ 923 "";
BA_ "FrameGatewayId" BO_ 923 923;
BA_ "FrameGatewayNetwork" BO_ 923 "HS1_CAN";
BA_ "VFrameFormat" BO_ 923 14;
BA_ "FrameRouting" BO_ 1998 "";
BA_ "GenMsgILSupport" BO_ 1998 0;
BA_ "DiagResponse" BO_ 1998 1;
BA_ "GenMsgSendType" BO_ 1998 1;
BA_ "GenMsgDelayTime" BO_ 1998 0;
BA_ "NetworkInitialization" BO_ 1998 0;
BA_ "VFrameFormat" BO_ 1998 14;
BA_ "FrameRouting" BO_ 1996 "";
BA_ "GenMsgILSupport" BO_ 1996 0;
BA_ "DiagResponse" BO_ 1996 1;
BA_ "GenMsgSendType" BO_ 1996 1;
BA_ "GenMsgDelayTime" BO_ 1996 0;
BA_ "NetworkInitialization" BO_ 1996 0;
BA_ "VFrameFormat" BO_ 1996 14;
BA_ "FrameRouting" BO_ 1988 "";
BA_ "GenMsgILSupport" BO_ 1988 0;
BA_ "DiagRequest" BO_ 1988 1;
BA_ "GenMsgSendType" BO_ 1988 1;
BA_ "GenMsgDelayTime" BO_ 1988 0;
BA_ "NetworkInitialization" BO_ 1988 0;
BA_ "VFrameFormat" BO_ 1988 14;
BA_ "FrameRouting" BO_ 922 "";
BA_ "FrameGatewayId" BO_ 922 922;
BA_ "FrameGatewayNetwork" BO_ 922 "HS1_CAN";
BA_ "VFrameFormat" BO_ 922 14;
BA_ "ECGUsedRxSignal" SG_ 2612224069 PARSEDPhysSODCMC2toGWM_ECG 1;
BA_ "GenSigSendType" SG_ 2612224069 PARSEDPhysSODCMC2toGWM_ECG 3;
BA_ "ECGUsedRxSignal" SG_ 2611175445 PARSEDPhysCCMtoGWM_ECG 1;
BA_ "GenSigSendType" SG_ 2611175445 PARSEDPhysCCMtoGWM_ECG 3;
BA_ "ECGUsedRxSignal" SG_ 2612224021 PARSEDPhysCCM2toGWM_ECG 1;
BA_ "GenSigSendType" SG_ 2612224021 PARSEDPhysCCM2toGWM_ECG 3;
BA_ "ECGUsedRxSignal" SG_ 2610126947 OTAPhysSODRtoGWM_ECG 1;
BA_ "GenSigSendType" SG_ 2610126947 OTAPhysSODRtoGWM_ECG 3;
BA_ "ECGUsedRxSignal" SG_ 2610126946 OTAPhysSODLtoGWM_ECG 1;
BA_ "GenSigSendType" SG_ 2610126946 OTAPhysSODLtoGWM_ECG 3;
BA_ "ECGUsedRxSignal" SG_ 2610126918 OTAPhysSODCMDtoGWM_ECG 1;
BA_ "GenSigSendType" SG_ 2610126918 OTAPhysSODCMDtoGWM_ECG 3;
BA_ "ECGUsedRxSignal" SG_ 2610126917 OTAPhysSODCMCtoGWM_ECG 1;
BA_ "GenSigSendType" SG_ 2610126917 OTAPhysSODCMCtoGWM_ECG 3;
BA_ "ECGUsedRxSignal" SG_ 2610126869 OTAPhysCCMtoGWM_ECG 1;
BA_ "GenSigSendType" SG_ 2610126869 OTAPhysCCMtoGWM_ECG 3;
BA_ "CrossOver_InfoCAN" SG_ 984 FeatConfigIpmaActl 1;
BA_ "CrossOver_InfoCAN" SG_ 984 FeatNoIpmaActl 1;
BA_ "GenSigStartValue" SG_ 984 PersIndexIpma_D_Actl 4;
BA_ "GenSigStartValueInteger" SG_ 984 PersIndexIpma_D_Actl 4;
BA_ "CrossOver_InfoCAN" SG_ 984 PersIndexIpma_D_Actl 1;
BA_ "GenSigSendType" SG_ 984 PersIndexIpma_D_Actl 3;
BA_ "U_P702_MY2021_Rx" SG_ 984 AhbcRampingV_D_Rq 1;
BA_ "GenSigSendType" SG_ 984 AhbcRampingV_D_Rq 3;
BA_ "CrossOver_InfoCAN" SG_ 984 LaActvStats_D_Dsply 1;
BA_ "GenSigSendType" SG_ 984 LaActvStats_D_Dsply 3;
BA_ "CrossOver_InfoCAN" SG_ 984 LaDenyStats_B_Dsply 1;
BA_ "GenSigSendType" SG_ 984 LaDenyStats_B_Dsply 3;
BA_ "CrossOver_InfoCAN" SG_ 984 LaHandsOff_D_Dsply 1;
BA_ "GenSigSendType" SG_ 984 LaHandsOff_D_Dsply 3;
BA_ "CrossOver_InfoCAN" SG_ 984 CamraDefog_B_Req 1;
BA_ "GenSigSendType" SG_ 984 CamraDefog_B_Req 3;
BA_ "CrossOver_InfoCAN" SG_ 984 CamraStats_D_Dsply 1;
BA_ "GenSigSendType" SG_ 984 CamraStats_D_Dsply 3;
BA_ "CrossOver_InfoCAN" SG_ 984 DasAlrtLvl_D_Dsply 1;
BA_ "GenSigSendType" SG_ 984 DasAlrtLvl_D_Dsply 3;
BA_ "CrossOver_InfoCAN" SG_ 984 DasStats_D_Dsply 1;
BA_ "GenSigSendType" SG_ 984 DasStats_D_Dsply 3;
BA_ "CrossOver_InfoCAN" SG_ 984 DasWarn_D_Dsply 1;
BA_ "GenSigSendType" SG_ 984 DasWarn_D_Dsply 3;
BA_ "GenSigSendType" SG_ 984 AhbHiBeam_D_Rq 3;
BA_ "GenSigSendType" SG_ 985 LdwChime_B_Rq 3;
BA_ "GenSigSendType" SG_ 985 TsrRegionTxt_D_Stat 3;
BA_ "GenSigSendType" SG_ 985 SblmPedCrossScnr_B_Stat 3;
BA_ "GenSigSendType" SG_ 985 LongCtrlEnbl_D_Rq 3;
BA_ "GenSigSendType" SG_ 985 SblmRndAbtScnr_B_Stat 3;
BA_ "GenSigSendType" SG_ 985 DasAlrtInfo_D_Dsply 3;
BA_ "U_T6_MCA_MY2020_Rx" SG_ 985 IaccVLim_D_Rq 1;
BA_ "U_P702_MY2021_Rx" SG_ 985 IaccVLim_D_Rq 1;
BA_ "GenSigStartValue" SG_ 985 IaccVLim_D_Rq 254;
BA_ "GenSigStartValueInteger" SG_ 985 IaccVLim_D_Rq 254;
BA_ "GenSigSendType" SG_ 985 IaccVLim_D_Rq 3;
BA_ "U_T6_MCA_MY2020_Rx" SG_ 985 IaccVLimUnit_D_Rq 1;
BA_ "U_P702_MY2021_Rx" SG_ 985 IaccVLimUnit_D_Rq 1;
BA_ "GenSigStartValue" SG_ 985 IaccVLimUnit_D_Rq 3;
BA_ "GenSigStartValueInteger" SG_ 985 IaccVLimUnit_D_Rq 3;
BA_ "GenSigSendType" SG_ 985 IaccVLimUnit_D_Rq 3;
BA_ "U_T6_MCA_MY2020_Rx" SG_ 985 IsaVLim_D_Rq 1;
BA_ "U_P702_MY2021_Rx" SG_ 985 IsaVLim_D_Rq 1;
BA_ "GenSigStartValue" SG_ 985 IsaVLim_D_Rq 254;
BA_ "GenSigStartValueInteger" SG_ 985 IsaVLim_D_Rq 254;
BA_ "GenSigSendType" SG_ 985 IsaVLim_D_Rq 3;
BA_ "GenSigSendType" SG_ 985 SblmStopScnr_B_Stat 3;
BA_ "GenSigSendType" SG_ 985 SblmYieldScnr_B_Stat 3;
BA_ "U_T6_MCA_MY2020_Rx" SG_ 985 IsaVLimUnit_D_Rq 1;
BA_ "U_P702_MY2021_Rx" SG_ 985 IsaVLimUnit_D_Rq 1;
BA_ "GenSigSendType" SG_ 985 IsaVLimUnit_D_Rq 3;
BA_ "GenSigSendType" SG_ 985 AdbDividedRoad_B_Stat 3;
BA_ "GenSigSendType" SG_ 985 LcwaMsgTxt_D_Stat 3;
BA_ "GenSigSendType" SG_ 985 AdbDrvSide_B_Stat 3;
BA_ "U_P702_MY2021_Rx" SG_ 992 MsgCntrDsplyOp_D_Rq 1;
BA_ "CrossOver_InfoCAN" SG_ 992 MsgCntrDsplyOp_D_Rq 1;
BA_ "U_P702_MY2021_Rx" SG_ 992 MsgCntrFeatNoRq 1;
BA_ "CrossOver_InfoCAN" SG_ 992 MsgCntrFeatNoRq 1;
BA_ "U_P702_MY2021_Rx" SG_ 992 MsgCntrFeatConfigRq 1;
BA_ "CrossOver_InfoCAN" SG_ 992 MsgCntrFeatConfigRq 1;
BA_ "U_P702_MY2021_Rx" SG_ 992 MsgCntrPersIndex_D_Rq 1;
BA_ "GenSigStartValue" SG_ 992 MsgCntrPersIndex_D_Rq 4;
BA_ "GenSigStartValueInteger" SG_ 992 MsgCntrPersIndex_D_Rq 4;
BA_ "CrossOver_InfoCAN" SG_ 992 MsgCntrPersIndex_D_Rq 1;
BA_ "GenSigSendType" SG_ 2612019416 PARSEDPhysGWM_ECG2toPCM 3;
BA_ "ECGUsedTxSignal" SG_ 2612019416 PARSEDPhysGWM_ECG2toPCM 1;
BA_ "MetaData" SG_ 943 VehVActlAdas_D_Qf 1;
BA_ "GenSigStartValue" SG_ 943 VehVActlAdas_D_Qf 1;
BA_ "GenSigStartValue" SG_ 943 AdasLcDistToObj_L_Actl 4094;
BA_ "MetaData" SG_ 515 PtIgnSwtch_No_Cs 1;
BA_ "MetaData" SG_ 515 PtIgnSwtch_No_Cnt 1;
BA_ "GenSigSendType" SG_ 515 PtIgnSwtch_D_Stat 3;
BA_ "GenSigStartValue" SG_ 515 PtIgnSwtch_D_Stat 2;
BA_ "GenSigStartValueInteger" SG_ 1111 TrlrYawWActl_D_Qf 1;
BA_ "GenSigStartValue" SG_ 1111 TrlrYawWActl_D_Qf 1;
BA_ "U_P702_MY2021_Rx" SG_ 1111 TrlrYawWActl_D_Qf 1;
BA_ "U_T6_MCA_MY2020_Rx" SG_ 1111 TrlrYawWActl_D_Qf 1;
BA_ "GenSigStartValueInteger" SG_ 1111 TrlrYaw_W_Actl 65534;
BA_ "GenSigStartValue" SG_ 1111 TrlrYaw_W_Actl 65534;
BA_ "U_P702_MY2021_Rx" SG_ 1111 TrlrYaw_W_Actl 1;
BA_ "U_T6_MCA_MY2020_Rx" SG_ 1111 TrlrYaw_W_Actl 1;
BA_ "GenSigStartValueInteger" SG_ 1111 TrlrHitYaw_AnRate_Actl 4094;
BA_ "GenSigStartValue" SG_ 1111 TrlrHitYaw_AnRate_Actl 4093;
BA_ "U_P702_MY2021_Rx" SG_ 1111 TrlrHitYaw_AnRate_Actl 1;
BA_ "U_T6_MCA_MY2020_Rx" SG_ 1111 TrlrHitYaw_AnRate_Actl 1;
BA_ "U_P702_MY2021_Rx" SG_ 1111 TrlrHitchYaw_D_Stat 1;
BA_ "U_T6_MCA_MY2020_Rx" SG_ 1111 TrlrHitchYaw_D_Stat 1;
BA_ "GenSigStartValueInteger" SG_ 1111 TrlrHitchYaw_An_Actl 4094;
BA_ "GenSigStartValue" SG_ 1111 TrlrHitchYaw_An_Actl 4093;
BA_ "U_P702_MY2021_Rx" SG_ 1111 TrlrHitchYaw_An_Actl 1;
BA_ "U_T6_MCA_MY2020_Rx" SG_ 1111 TrlrHitchYaw_An_Actl 1;
BA_ "U_P702_MY2021_Rx" SG_ 1106 TrlrSnsId_No_Actl 1;
BA_ "U_T6_MCA_MY2020_Rx" SG_ 1106 TrlrSnsId_No_Actl 1;
BA_ "GenSigSendType" SG_ 1985 TesterPhysicalReqCMR_DSMC 3;
BA_ "GenSigSendType" SG_ 1993 TesterPhysicalResCMR_DSMC 3;
BA_ "GenSigStartValue" SG_ 1503 CMR_DSMC_GWOnBoardTester 255;
BA_ "ContentDependant" SG_ 1503 CMR_DSMC_GWOnBoardTester 1;
BA_ "GenSigStartValueInteger" SG_ 1503 CMR_DSMC_GWOnBoardTester 255;
BA_ "GenSigStartValue" SG_ 1503 CMR_DSMC_GWNMProxY 255;
BA_ "ContentDependant" SG_ 1503 CMR_DSMC_GWNMProxY 1;
BA_ "GenSigStartValueInteger" SG_ 1503 CMR_DSMC_GWNMProxY 255;
BA_ "GenSigStartValue" SG_ 1503 CMR_DSMC_AutoSarNMReserved 255;
BA_ "ContentDependant" SG_ 1503 CMR_DSMC_AutoSarNMReserved 1;
BA_ "GenSigStartValueInteger" SG_ 1503 CMR_DSMC_AutoSarNMReserved 255;
BA_ "GenSigStartValue" SG_ 1503 CMR_DSMC_AutoSarNMReserve4 255;
BA_ "ContentDependant" SG_ 1503 CMR_DSMC_AutoSarNMReserve4 1;
BA_ "GenSigStartValueInteger" SG_ 1503 CMR_DSMC_AutoSarNMReserve4 255;
BA_ "GenSigStartValue" SG_ 1503 CMR_DSMC_AutoSarNMReserve3 255;
BA_ "ContentDependant" SG_ 1503 CMR_DSMC_AutoSarNMReserve3 1;
BA_ "GenSigStartValueInteger" SG_ 1503 CMR_DSMC_AutoSarNMReserve3 255;
BA_ "GenSigStartValue" SG_ 1503 CMR_DSMC_AutoSarNMReserve2 255;
BA_ "ContentDependant" SG_ 1503 CMR_DSMC_AutoSarNMReserve2 1;
BA_ "GenSigStartValueInteger" SG_ 1503 CMR_DSMC_AutoSarNMReserve2 255;
BA_ "GenSigStartValue" SG_ 1503 CMR_DSMC_AutoSarNMNodeId 223;
BA_ "ContentDependant" SG_ 1503 CMR_DSMC_AutoSarNMNodeId 1;
BA_ "GenSigStartValueInteger" SG_ 1503 CMR_DSMC_AutoSarNMNodeId 222;
BA_ "ContentDependant" SG_ 1503 CMR_DSMC_AutoSarNMControl 1;
BA_ "ECGUsedTxSignal" SG_ 2610995416 PARSEDPhysGWM_ECGtoABS 1;
BA_ "GenSigSendType" SG_ 2610995416 PARSEDPhysGWM_ECGtoABS 3;
BA_ "ECGUsedTxSignal" SG_ 2612043992 PARSEDPhysGWM_ECG2toABS 1;
BA_ "GenSigSendType" SG_ 2612043992 PARSEDPhysGWM_ECG2toABS 3;
BA_ "ECGUsedTxSignal" SG_ 2609946840 OTAPhysGWM_ECGtoABS 1;
BA_ "GenSigSendType" SG_ 2609946840 OTAPhysGWM_ECGtoABS 3;
BA_ "ECGUsedRxSignal" SG_ 2611175464 PARSEDPhysABStoGWM_ECG 1;
BA_ "GenSigSendType" SG_ 2611175464 PARSEDPhysABStoGWM_ECG 3;
BA_ "ECGUsedRxSignal" SG_ 2612224040 PARSEDPhysABS2toGWM_ECG 1;
BA_ "GenSigSendType" SG_ 2612224040 PARSEDPhysABS2toGWM_ECG 3;
BA_ "ECGUsedRxSignal" SG_ 2610126888 OTAPhysABStoGWM_ECG 1;
BA_ "GenSigSendType" SG_ 2610126888 OTAPhysABStoGWM_ECG 3;
BA_ "ECGUsedTxSignal" SG_ 2610988248 PARSEDPhysGWM_ECGtoIPMA 1;
BA_ "ECGUsedTxSignal" SG_ 2609939672 OTAPhysGWM_ECGtoIPMA 1;
BA_ "GenSigSendType" SG_ 2609939672 OTAPhysGWM_ECGtoIPMA 3;
BA_ "U_T6_MCA_MY2020_Rx" SG_ 1114 TrailCtlSwtch_B_Stat2 1;
BA_ "U_P702_MY2021_Rx" SG_ 1114 TrailCtlSwtch_B_Stat2 1;
BA_ "U_T6_MCA_MY2020_Rx" SG_ 1116 TrlrAidSetup_D2_Rq 1;
BA_ "U_P702_MY2021_Rx" SG_ 1116 TrlrAidSetup_D2_Rq 1;
BA_ "U_T6_MCA_MY2020_Rx" SG_ 1116 TrlrAidEnbl_D2_Rq 1;
BA_ "U_P702_MY2021_Rx" SG_ 1116 TrlrAidEnbl_D2_Rq 1;
BA_ "U_P702_MY2021_Rx" SG_ 1116 TrlrIdType_D_Stat 1;
BA_ "U_T6_MCA_MY2020_Rx" SG_ 1116 TrlrIdType_D_Stat 1;
BA_ "ECGUsedRxSignal" SG_ 2611175457 PARSEDPhysIPMAtoGWM_ECG 1;
BA_ "GenSigSendType" SG_ 2611175457 PARSEDPhysIPMAtoGWM_ECG 3;
BA_ "ECGUsedRxSignal" SG_ 2612224033 PARSEDPhysIPMA2toGWM_ECG 1;
BA_ "GenSigSendType" SG_ 2612224033 PARSEDPhysIPMA2toGWM_ECG 3;
BA_ "ECGUsedRxSignal" SG_ 2610126881 OTAPhysIPMAtoGWM_ECG 1;
BA_ "GenSigSendType" SG_ 2610126881 OTAPhysIPMAtoGWM_ECG 3;
BA_ "GenSigStartValue" SG_ 981 AdbBrdrTop_An_Rq 254;
BA_ "GenSigStartValue" SG_ 981 AdbBrdrRight_L_Stat 510;
BA_ "GenSigStartValue" SG_ 981 AdbBrdrRight_An_Rq 1022;
BA_ "GenSigStartValue" SG_ 981 AdbBrdrLeft_L_Stat 510;
BA_ "GenSigStartValue" SG_ 981 AdbBrdrLeft_An_Rq 1022;
BA_ "GenSigStartValue" SG_ 981 AdbBrdrBottom_An_Rq 62;
BA_ "U_P702_MY2021_Rx" SG_ 791 EngAirFilt_B_RqReset 1;
BA_ "CrossOver_InfoCAN" SG_ 791 GpsElMdeSel_B_Rq 1;
BA_ "CrossOver_InfoCAN" SG_ 791 LongTermReset_B_Rq 1;
BA_ "CrossOver_InfoCAN" SG_ 791 DrvEffLvl_No_Stat 1;
BA_ "ECGUsedTxSignal" SG_ 2610970840 PARSEDPhysGWM_ECGtoPCM 1;
BA_ "U_T6_MCA_MY2020_Rx" SG_ 2610970840 PARSEDPhysGWM_ECGtoPCM 1;
BA_ "U_P702_MY2021_Rx" SG_ 2610970840 PARSEDPhysGWM_ECGtoPCM 1;
BA_ "GenSigSendType" SG_ 2610970840 PARSEDPhysGWM_ECGtoPCM 3;
BA_ "ECGUsedTxSignal" SG_ 2609922264 OTAPhysGWM_ECGtoPCM 1;
BA_ "U_T6_MCA_MY2020_Rx" SG_ 2609922264 OTAPhysGWM_ECGtoPCM 1;
BA_ "U_P702_MY2021_Rx" SG_ 2609922264 OTAPhysGWM_ECGtoPCM 1;
BA_ "GenSigSendType" SG_ 2609922264 OTAPhysGWM_ECGtoPCM 3;
BA_ "U_P702_MY2021_Rx" SG_ 868 BattRgenLoStat_D_Qlty 1;
BA_ "GenSigStartValue" SG_ 868 BattRgenLoStat_D_Qlty 1;
BA_ "U_P702_MY2021_Rx" SG_ 868 BattRgenLoSoc_Pc_Actl 1;
BA_ "GenSigStartValue" SG_ 868 BattRgenLoSoc_Pc_Actl 50;
BA_ "U_P702_MY2021_Rx" SG_ 868 BattRgenLoPulse_U_Pred 1;
BA_ "GenSigStartValue" SG_ 868 BattRgenLoPulse_U_Pred 216;
BA_ "U_P702_MY2021_Rx" SG_ 868 BattRgenLoPrtct_B_Stat 1;
BA_ "U_P702_MY2021_Rx" SG_ 868 BattRgenLoDChrg_D_Stat 1;
BA_ "U_P702_MY2021_Rx" SG_ 868 BattRgenLoDchrg_B_Rq 1;
BA_ "U_P702_MY2021_Rx" SG_ 868 BattRgenLoChrg_D_Stat 1;
BA_ "U_P702_MY2021_Rx" SG_ 868 BattRgenLoChrg_B_Rq 1;
BA_ "U_P702_MY2021_Rx" SG_ 868 BattRgenLo_T_Est 1;
BA_ "U_P702_MY2021_Rx" SG_ 868 BattRgenLo_B_Falt 1;
BA_ "U_P702_MY2021_Rx" SG_ 867 BattRgenLoBalnc_B_Rq 1;
BA_ "U_P702_MY2021_Rx" SG_ 867 BattRgenLo_Te_Hi 1;
BA_ "GenSigStartValue" SG_ 867 BattRgenLo_Te_Hi 45;
BA_ "U_P702_MY2021_Rx" SG_ 867 BattRgenLo_Te_Actl 1;
BA_ "GenSigStartValue" SG_ 867 BattRgenLo_Te_Actl 85;
BA_ "U_P702_MY2021_Rx" SG_ 867 BattRgenLo_R_Actl 1;
BA_ "U_P702_MY2021_Rx" SG_ 867 BattRgenLo_AhRide_Actl 1;
BA_ "GenSigStartValue" SG_ 867 BattRgenLo_AhRide_Actl 12800;
BA_ "U_P702_MY2021_Rx" SG_ 867 BattRgenLo_Ah_Actl 1;
BA_ "GenSigStartValue" SG_ 867 BattRgenLo_Ah_Actl 50;
BA_ "U_P702_MY2021_Rx" SG_ 866 BattRgenLoOpen_U_Actl 1;
BA_ "GenSigStartValue" SG_ 866 BattRgenLoOpen_U_Actl 180;
BA_ "U_P702_MY2021_Rx" SG_ 866 BattRgenLoDchrg_U_Mn 1;
BA_ "GenSigStartValue" SG_ 866 BattRgenLoDchrg_U_Mn 280;
BA_ "U_P702_MY2021_Rx" SG_ 866 BattRgenLoDchrg_I_Mx 1;
BA_ "U_P702_MY2021_Rx" SG_ 866 BattRgenLoChrg_U_Mx 1;
BA_ "GenSigStartValue" SG_ 866 BattRgenLoChrg_U_Mx 96;
BA_ "U_P702_MY2021_Rx" SG_ 866 BattRgenLoChrg_I_Mx 1;
BA_ "U_P702_MY2021_Rx" SG_ 865 BattRgenLo_U_Actl 1;
BA_ "GenSigStartValue" SG_ 865 BattRgenLo_U_Actl 768;
BA_ "U_P702_MY2021_Rx" SG_ 865 BattRgenLo_I_Actl 1;
BA_ "GenSigStartValue" SG_ 865 BattRgenLo_I_Actl 32768;
BA_ "U_T6_MCA_MY2020_Tx" SG_ 2611175440 PARSEDPhysPCMtoGWM_ECG 1;
BA_ "U_P702_MY2021_Tx" SG_ 2611175440 PARSEDPhysPCMtoGWM_ECG 1;
BA_ "ECGUsedRxSignal" SG_ 2611175440 PARSEDPhysPCMtoGWM_ECG 1;
BA_ "GenSigSendType" SG_ 2611175440 PARSEDPhysPCMtoGWM_ECG 3;
BA_ "U_T6_MCA_MY2020_Tx" SG_ 2610126864 OTAPhysPCMtoGWM_ECG 1;
BA_ "U_P702_MY2021_Tx" SG_ 2610126864 OTAPhysPCMtoGWM_ECG 1;
BA_ "ECGUsedRxSignal" SG_ 2610126864 OTAPhysPCMtoGWM_ECG 1;
BA_ "GenSigSendType" SG_ 2610126864 OTAPhysPCMtoGWM_ECG 3;
BA_ "GenSigSendType" SG_ 2611175441 PARSEDPhysHPCMtoGWM_ECG 3;
BA_ "GenSigSendType" SG_ 2612224017 PARSEDPhysHPCM2toGWM_ECG 3;
BA_ "U_P702_MY2021_Tx" SG_ 2610126865 OTAPhysHPCMtoGWM_ECG 1;
BA_ "GenSigSendType" SG_ 2610126865 OTAPhysHPCMtoGWM_ECG 3;
BA_ "U_P702_MY2021_Tx" SG_ 1679 UUDTSOBDMCResponse4 1;
BA_ "GenSigSendType" SG_ 1679 UUDTSOBDMCResponse4 3;
BA_ "U_P702_MY2021_Tx" SG_ 1678 UUDTSOBDMCResponse3 1;
BA_ "GenSigSendType" SG_ 1678 UUDTSOBDMCResponse3 3;
BA_ "U_P702_MY2021_Tx" SG_ 1677 UUDTSOBDMCResponse2 1;
BA_ "GenSigSendType" SG_ 1677 UUDTSOBDMCResponse2 3;
BA_ "U_P702_MY2021_Tx" SG_ 1676 UUDTSOBDMCResponse1 1;
BA_ "GenSigSendType" SG_ 1676 UUDTSOBDMCResponse1 3;
BA_ "U_CX727_MY2021_Tx" SG_ 1144 WakeAlarm0_T_Rq 1;
BA_ "GenSigStartValue" SG_ 1144 WakeAlarm0_T_Rq 32767;
BA_ "GenSigStartValueInteger" SG_ 1144 WakeAlarm0_T_Rq 32767;
BA_ "U_CX727_MY2021_Tx" SG_ 1144 WakeAlarm0_B_Typ 1;
BA_ "GenSigSendType" SG_ 1144 WakeAlarm0_B_Typ 3;
BA_ "U_CX727_MY2021_Tx" SG_ 1144 PreCondBatt_B_Actl 1;
BA_ "GenSigSendType" SG_ 1144 PreCondBatt_B_Actl 3;
BA_ "U_CX727_MY2021_Tx" SG_ 1144 HtrnDcdcDis_B_Rq 1;
BA_ "U_CX727_MY2021_Rx" SG_ 1144 HtrnDcdcDis_B_Rq 1;
BA_ "GenSigSendType" SG_ 1144 HtrnDcdcDis_B_Rq 3;
BA_ "U_CX727_MY2021_Tx" SG_ 1144 ChrgNowEvnt_B_Stat 1;
BA_ "GenSigSendType" SG_ 1144 ChrgNowEvnt_B_Stat 3;
BA_ "U_CX727_MY2021_Tx" SG_ 1144 CabinDrvSustn_B_Rq 1;
BA_ "U_CX727_MY2021_Rx" SG_ 1144 CabinDrvSustn_B_Rq 1;
BA_ "GenSigSendType" SG_ 1144 CabinDrvSustn_B_Rq 3;
BA_ "U_P702_MY2021_Tx" SG_ 1144 BattChrgTrgtSoC_D_Rq 1;
BA_ "GenSigSendType" SG_ 1144 CabnEvapSovFront_B_Rq 3;
BA_ "WakeupSignal" SG_ 1144 CabnEvapSovFront_B_Rq 1;
BA_ "U_P702_MY2021_Tx" SG_ 1144 CabnEvapSovFront_B_Rq 1;
BA_ "GenSigSendType" SG_ 1144 HeatCoreSovRear_B_Rq 3;
BA_ "WakeupSignal" SG_ 1144 HeatCoreSovRear_B_Rq 1;
BA_ "U_P702_MY2021_Tx" SG_ 1144 HeatCoreSovRear_B_Rq 1;
BA_ "GenSigSendType" SG_ 1144 BattChlrSov_B_Rq 3;
BA_ "WakeupSignal" SG_ 1144 BattChlrSov_B_Rq 1;
BA_ "U_P702_MY2021_Tx" SG_ 1144 BattChlrSov_B_Rq 1;
BA_ "GenSigSendType" SG_ 1144 CabnEvapSovRear_B_Rq 3;
BA_ "WakeupSignal" SG_ 1144 CabnEvapSovRear_B_Rq 1;
BA_ "U_P702_MY2021_Tx" SG_ 1144 CabnEvapSovRear_B_Rq 1;
BA_ "GenSigSendType" SG_ 1144 BrkAppl_D_RqPt 3;
BA_ "U_CX727_MY2021_Rx" SG_ 1144 BrkAppl_D_RqPt 1;
BA_ "U_T6_MCA_MY2020_Rx" SG_ 1144 BrkAppl_D_RqPt 1;
BA_ "U_P702_MY2021_Tx" SG_ 1144 BrkAppl_D_RqPt 1;
BA_ "GenSigSendType" SG_ 1144 HtrnCnnctPwr_B_Stat 3;
BA_ "U_P702_MY2021_Tx" SG_ 1144 HtrnCnnctPwr_B_Stat 1;
BA_ "GenSigSendType" SG_ 1144 PtcHtr_D_Stat 3;
BA_ "U_CX727_MY2021_Rx" SG_ 1144 PtcHtr_D_Stat 1;
BA_ "U_P702_MY2021_Rx" SG_ 1144 PtcHtr_D_Stat 1;
BA_ "U_P702_MY2021_Tx" SG_ 1144 PtcHtr_D_Stat 1;
BA_ "GenSigSendType" SG_ 1144 HtrnClntFlw_D_Rq 3;
BA_ "U_P702_MY2021_Tx" SG_ 1144 HtrnClntFlw_D_Rq 1;
BA_ "GenSigSendType" SG_ 1144 BattTracDrvSustn_B_Rq 3;
BA_ "U_CX727_MY2021_Rx" SG_ 1144 BattTracDrvSustn_B_Rq 1;
BA_ "U_P702_MY2021_Tx" SG_ 1144 BattTracDrvSustn_B_Rq 1;
BA_ "GenSigSendType" SG_ 1144 BattTracClntVlv_B_Rq 3;
BA_ "U_P702_MY2021_Tx" SG_ 1144 BattTracClntVlv_B_Rq 1;
BA_ "U_CX727_MY2021_Tx" SG_ 1141 OfbChrgSetSync_D_Stat 1;
BA_ "ECGUsedRxSignal" SG_ 1141 OfbChrgSetSync_D_Stat 1;
BA_ "U_CX727_MY2021_Tx" SG_ 1141 PtRmtRprt_D_Rq 1;
BA_ "ECGUsedRxSignal" SG_ 1141 PtRmtRprt_D_Rq 1;
BA_ "WakeupSignal" SG_ 1141 PtRmtRprt_D_Rq 1;
BA_ "GenSigStartValueInteger" SG_ 1141 MtrTrac2_Tq_Actl 4095;
BA_ "GenSigStartValue" SG_ 1141 MtrTrac2_Tq_Actl 4095;
BA_ "U_P702_MY2021_Tx" SG_ 1141 MtrTrac2_Tq_Actl 1;
BA_ "ECGUsedRxSignal" SG_ 1141 MtrTrac2_Tq_Actl 1;
BA_ "ECGUsedRxSignal" SG_ 1141 NtfctnConflict1_D_Rq 1;
BA_ "U_P702_MY2021_Tx" SG_ 1141 NtfctnConflict1_D_Rq 1;
BA_ "U_CX727_MY2021_Tx" SG_ 1140 RgenEvntLvl_Pc_Dsply 1;
BA_ "GenSigStartValue" SG_ 1140 RgenEvntLvl_Pc_Dsply 1022;
BA_ "GenSigStartValueInteger" SG_ 1140 RgenEvntLvl_Pc_Dsply 1023;
BA_ "U_CX727_MY2021_Tx" SG_ 1140 BrkEvntComplt_B_Dsply 1;
BA_ "U_P702_MY2021_Tx" SG_ 1140 PreCondStat_D_Dsply 1;
BA_ "ECGUsedRxSignal" SG_ 1140 PreCondStat_D_Dsply 1;
BA_ "U_CX727_MY2021_Tx" SG_ 1139 ActChrgStrtYr_No2_Actl 1;
BA_ "ECGUsedRxSignal" SG_ 1139 ActChrgStrtYr_No2_Actl 1;
BA_ "U_P702_MY2021_Tx" SG_ 1139 BattChrgTrgtLMax_T_Est 1;
BA_ "U_P702_MY2021_Tx" SG_ 1139 ActChrgStrtYr_No_Actl 1;
BA_ "ECGUsedRxSignal" SG_ 1139 ActChrgStrtYr_No_Actl 1;
BA_ "U_P702_MY2021_Tx" SG_ 1139 ActChrgStrtMin_No_Actl 1;
BA_ "ECGUsedRxSignal" SG_ 1139 ActChrgStrtMin_No_Actl 1;
BA_ "U_P702_MY2021_Tx" SG_ 1139 ActChrgStrtHr_No_Actl 1;
BA_ "ECGUsedRxSignal" SG_ 1139 ActChrgStrtHr_No_Actl 1;
BA_ "U_P702_MY2021_Tx" SG_ 1139 ActChrgStrtDay_No_Actl 1;
BA_ "GenSigStartValue" SG_ 1139 ActChrgStrtDay_No_Actl 1;
BA_ "GenSigStartValueInteger" SG_ 1139 ActChrgStrtDay_No_Actl 1;
BA_ "ECGUsedRxSignal" SG_ 1139 ActChrgStrtDay_No_Actl 1;
BA_ "U_P702_MY2021_Tx" SG_ 1139 ActChrgStrMnth_No_Actl 1;
BA_ "GenSigStartValue" SG_ 1139 ActChrgStrMnth_No_Actl 1;
BA_ "GenSigStartValueInteger" SG_ 1139 ActChrgStrMnth_No_Actl 1;
BA_ "ECGUsedRxSignal" SG_ 1139 ActChrgStrMnth_No_Actl 1;
BA_ "ECGUsedRxSignal" SG_ 1138 ActChrgEndYr_No2_Actl 1;
BA_ "U_CX727_MY2021_Tx" SG_ 1138 ActChrgEndYr_No2_Actl 1;
BA_ "U_P702_MY2021_Tx" SG_ 1138 BattChrgTrgtLMin_T_Est 1;
BA_ "U_P702_MY2021_Tx" SG_ 1138 ActChrgEndYr_No_Actl 1;
BA_ "ECGUsedRxSignal" SG_ 1138 ActChrgEndYr_No_Actl 1;
BA_ "U_P702_MY2021_Tx" SG_ 1138 ActChrgEndMnth_No_Actl 1;
BA_ "GenSigStartValue" SG_ 1138 ActChrgEndMnth_No_Actl 1;
BA_ "GenSigStartValueInteger" SG_ 1138 ActChrgEndMnth_No_Actl 1;
BA_ "ECGUsedRxSignal" SG_ 1138 ActChrgEndMnth_No_Actl 1;
BA_ "U_P702_MY2021_Tx" SG_ 1138 ActChrgEndMin_No_Actl 1;
BA_ "ECGUsedRxSignal" SG_ 1138 ActChrgEndMin_No_Actl 1;
BA_ "U_P702_MY2021_Tx" SG_ 1138 ActChrgEndHr_No_Actl 1;
BA_ "ECGUsedRxSignal" SG_ 1138 ActChrgEndHr_No_Actl 1;
BA_ "U_P702_MY2021_Tx" SG_ 1138 ActChrgEndDay_No_Actl 1;
BA_ "GenSigStartValue" SG_ 1138 ActChrgEndDay_No_Actl 1;
BA_ "GenSigStartValueInteger" SG_ 1138 ActChrgEndDay_No_Actl 1;
BA_ "ECGUsedRxSignal" SG_ 1138 ActChrgEndDay_No_Actl 1;
BA_ "U_P702_MY2021_Tx" SG_ 1089 Mtr2Aout_W_ActlMntr 1;
BA_ "GenSigStartValue" SG_ 1089 Mtr2Aout_W_ActlMntr 1023;
BA_ "GenSigStartValueInteger" SG_ 1089 Mtr2Aout_W_ActlMntr 1023;
BA_ "ECGUsedRxSignal" SG_ 1089 Mtr2Aout_W_ActlMntr 1;
BA_ "U_P702_MY2021_Tx" SG_ 1089 Inv1_Te_Actl 1;
BA_ "GenSigStartValue" SG_ 1089 Inv1_Te_Actl 254;
BA_ "GenSigStartValueInteger" SG_ 1089 Inv1_Te_Actl 254;
BA_ "U_P702_MY2021_Tx" SG_ 1089 MtrTrac2Coil_Te_Actl 1;
BA_ "GenSigStartValue" SG_ 1089 MtrTrac2Coil_Te_Actl 254;
BA_ "GenSigStartValueInteger" SG_ 1089 MtrTrac2Coil_Te_Actl 254;
BA_ "ECGUsedRxSignal" SG_ 1089 MtrTrac2Coil_Te_Actl 1;
BA_ "U_P702_MY2021_Tx" SG_ 1089 MtrTrac2_U_Actl 1;
BA_ "GenSigStartValue" SG_ 1089 MtrTrac2_U_Actl 1023;
BA_ "GenSigStartValueInteger" SG_ 1089 MtrTrac2_U_Actl 1023;
BA_ "U_P702_MY2021_Tx" SG_ 1089 MtrTrac2Falt_B_Stat 1;
BA_ "U_P702_MY2021_Tx" SG_ 1089 MtrTrac2TeAlrm_B_Stat 1;
BA_ "ECGUsedRxSignal" SG_ 1089 MtrTrac2TeAlrm_B_Stat 1;
BA_ "U_P702_MY2021_Tx" SG_ 1089 Mtr2CntlTeAlrm_B_Stat 1;
BA_ "ECGUsedRxSignal" SG_ 1089 Mtr2CntlTeAlrm_B_Stat 1;
BA_ "U_P702_MY2021_Tx" SG_ 1089 MtrTrac2Inv_Te_Actl 1;
BA_ "GenSigStartValue" SG_ 1089 MtrTrac2Inv_Te_Actl 214;
BA_ "GenSigStartValueInteger" SG_ 1089 MtrTrac2Inv_Te_Actl 214;
BA_ "ECGUsedRxSignal" SG_ 1089 MtrTrac2Inv_Te_Actl 1;
BA_ "U_P702_MY2021_Tx" SG_ 1089 MtrTrac2_I_Actl 1;
BA_ "GenSigStartValueInteger" SG_ 1089 MtrTrac2_I_Actl 10000;
BA_ "U_P702_MY2021_Tx" SG_ 1040 ElCmprEnbl_B_Rq 1;
BA_ "U_P702_MY2021_Rx" SG_ 1040 ElCmprEnbl_B_Rq 1;
BA_ "U_CX727_MY2021_Rx" SG_ 1040 ElCmprEnbl_B_Rq 1;
BA_ "U_P702_MY2021_Tx" SG_ 1040 ElCmpr_N_Rq 1;
BA_ "GenSigSendType" SG_ 1016 ChrgGoTElement_B_Dsply 3;
BA_ "ECGUsedRxSignal" SG_ 1016 ChrgGoTElement_B_Dsply 1;
BA_ "U_CX727_MY2021_Tx" SG_ 1016 ChrgGoTElement_B_Dsply 1;
BA_ "U_P702_MY2021_Tx" SG_ 1016 ChrgLocIdCurnt_D_Uns 1;
BA_ "GenSigSendType" SG_ 1016 ChrgLocIdCurnt_D_Uns 3;
BA_ "ECGUsedRxSignal" SG_ 1016 ChrgLocIdCurnt_D_Uns 1;
BA_ "U_P702_MY2021_Tx" SG_ 1016 ChrgGoTTouchEnbl_B_Rq 1;
BA_ "GenSigSendType" SG_ 1016 ChrgGoTTouchEnbl_B_Rq 3;
BA_ "U_P702_MY2021_Tx" SG_ 1016 ChrgGoTTouch_B_Stat 1;
BA_ "GenSigSendType" SG_ 1016 ChrgGoTTouch_B_Stat 3;
BA_ "ECGUsedRxSignal" SG_ 1016 ChrgGoTTouch_B_Stat 1;
BA_ "U_P702_MY2021_Tx" SG_ 1016 ChrgGoTPrcond_D_Stat 1;
BA_ "ECGUsedRxSignal" SG_ 1016 ChrgGoTPrcond_D_Stat 1;
BA_ "U_P702_MY2021_Tx" SG_ 1016 ChrgGoTNext_D_Stat 1;
BA_ "MetaData" SG_ 1016 ChrgGoTNext_D_Stat 1;
BA_ "CrossOver_InfoCAN" SG_ 1016 ChrgGoTNext_D_Stat 1;
BA_ "GenSigSendType" SG_ 1016 ChrgGoTNext_D_Stat 3;
BA_ "ECGUsedRxSignal" SG_ 1016 ChrgGoTNext_D_Stat 1;
BA_ "U_P702_MY2021_Tx" SG_ 1016 ChrgGoTMnte_D_Stat 1;
BA_ "MetaData" SG_ 1016 ChrgGoTMnte_D_Stat 1;
BA_ "CrossOver_InfoCAN" SG_ 1016 ChrgGoTMnte_D_Stat 1;
BA_ "ECGUsedRxSignal" SG_ 1016 ChrgGoTMnte_D_Stat 1;
BA_ "U_P702_MY2021_Tx" SG_ 1016 ChrgGoTHr_T_Stat 1;
BA_ "GenSigStartValue" SG_ 1016 ChrgGoTHr_T_Stat 30;
BA_ "GenSigStartValueInteger" SG_ 1016 ChrgGoTHr_T_Stat 30;
BA_ "ECGUsedRxSignal" SG_ 1016 ChrgGoTHr_T_Stat 1;
BA_ "U_P702_MY2021_Tx" SG_ 1016 ChrgGoTExtHtrEnbl_B_Rq 1;
BA_ "GenSigSendType" SG_ 1016 ChrgGoTExtHtrEnbl_B_Rq 3;
BA_ "U_P702_MY2021_Tx" SG_ 1016 ChrgGoTExtHtr_B_Stat 1;
BA_ "GenSigSendType" SG_ 1016 ChrgGoTExtHtr_B_Stat 3;
BA_ "ECGUsedRxSignal" SG_ 1016 ChrgGoTExtHtr_B_Stat 1;
BA_ "U_P702_MY2021_Tx" SG_ 1016 ChrgGoTElement_D_Stat 1;
BA_ "MetaData" SG_ 1016 ChrgGoTElement_D_Stat 1;
BA_ "CrossOver_InfoCAN" SG_ 1016 ChrgGoTElement_D_Stat 1;
BA_ "GenSigSendType" SG_ 1016 ChrgGoTElement_D_Stat 3;
BA_ "ECGUsedRxSignal" SG_ 1016 ChrgGoTElement_D_Stat 1;
BA_ "U_P702_MY2021_Tx" SG_ 1016 ChrgGoTAllOn_B_Stat 1;
BA_ "GenSigSendType" SG_ 1016 ChrgGoTAllOn_B_Stat 3;
BA_ "ECGUsedRxSignal" SG_ 1016 ChrgGoTAllOn_B_Stat 1;
BA_ "U_P702_MY2021_Tx" SG_ 1013 ChrgToPcWkndSav_D_Stat 1;
BA_ "CrossOver_InfoCAN" SG_ 1013 ChrgToPcWkndSav_D_Stat 1;
BA_ "ECGUsedRxSignal" SG_ 1013 ChrgToPcWkndSav_D_Stat 1;
BA_ "U_P702_MY2021_Tx" SG_ 1013 ChrgToPcWkdySav_D_Stat 1;
BA_ "CrossOver_InfoCAN" SG_ 1013 ChrgToPcWkdySav_D_Stat 1;
BA_ "ECGUsedRxSignal" SG_ 1013 ChrgToPcWkdySav_D_Stat 1;
BA_ "U_P702_MY2021_Tx" SG_ 1013 ChrgProgIdSaved_D_Stat 1;
BA_ "MetaData" SG_ 1013 ChrgProgIdSaved_D_Stat 1;
BA_ "GenSigSendType" SG_ 1013 ChrgProgIdSaved_D_Stat 3;
BA_ "ECGUsedRxSignal" SG_ 1013 ChrgProgIdSaved_D_Stat 1;
BA_ "U_P702_MY2021_Tx" SG_ 1013 ChrgNowEnbl_B_Saved 1;
BA_ "ECGUsedRxSignal" SG_ 1013 ChrgNowEnbl_B_Saved 1;
BA_ "U_P702_MY2021_Tx" SG_ 1013 ChrgLocIdUnsAck_B_Stat 1;
BA_ "GenSigSendType" SG_ 1013 ChrgLocIdUnsAck_B_Stat 3;
BA_ "ECGUsedRxSignal" SG_ 1013 ChrgLocIdUnsAck_B_Stat 1;
BA_ "U_P702_MY2021_Tx" SG_ 1013 ChrgLocIdCurnt_D_Sav 1;
BA_ "MetaData" SG_ 1013 ChrgLocIdCurnt_D_Sav 1;
BA_ "GenSigSendType" SG_ 1013 ChrgLocIdCurnt_D_Sav 3;
BA_ "ECGUsedRxSignal" SG_ 1013 ChrgLocIdCurnt_D_Sav 1;
BA_ "U_P702_MY2021_Tx" SG_ 1013 ChrgPrflWknd_No_Actl 1;
BA_ "ECGUsedRxSignal" SG_ 1013 ChrgPrflWknd_No_Actl 1;
BA_ "U_P702_MY2021_Tx" SG_ 1013 ChrgPrflWkdy_No_Actl 1;
BA_ "ECGUsedRxSignal" SG_ 1013 ChrgPrflWkdy_No_Actl 1;
BA_ "GenSigSendType" SG_ 1012 ChrgNowCurnt_B_Dsply 3;
BA_ "ECGUsedRxSignal" SG_ 1012 ChrgNowCurnt_B_Dsply 1;
BA_ "U_CX727_MY2021_Tx" SG_ 1012 ChrgNowCurnt_B_Dsply 1;
BA_ "U_P702_MY2021_Tx" SG_ 1012 ChrgNowCurnt_B_Dsply 1;
BA_ "GenSigSendType" SG_ 1012 ChrgLocSaved_B_Dsply 3;
BA_ "ECGUsedRxSignal" SG_ 1012 ChrgLocSaved_B_Dsply 1;
BA_ "U_CX727_MY2021_Tx" SG_ 1012 ChrgLocSaved_B_Dsply 1;
BA_ "U_P702_MY2021_Tx" SG_ 1012 ChrgLocSaved_B_Dsply 1;
BA_ "U_P702_MY2021_Tx" SG_ 1012 ChrgLocLongPostv_B_Sav 1;
BA_ "CrossOver_InfoCAN" SG_ 1012 ChrgLocLongPostv_B_Sav 1;
BA_ "ECGUsedRxSignal" SG_ 1012 ChrgLocLongPostv_B_Sav 1;
BA_ "U_P702_MY2021_Tx" SG_ 1012 ChrgLocLongFrct_An_Sav 1;
BA_ "GenSigStartValue" SG_ 1012 ChrgLocLongFrct_An_Sav 1048575;
BA_ "GenSigStartValueInteger" SG_ 1012 ChrgLocLongFrct_An_Sav 1048575;
BA_ "ECGUsedRxSignal" SG_ 1012 ChrgLocLongFrct_An_Sav 1;
BA_ "U_P702_MY2021_Tx" SG_ 1012 ChrgLocLongDeg_An_Sav 1;
BA_ "ECGUsedRxSignal" SG_ 1012 ChrgLocLongDeg_An_Sav 1;
BA_ "U_P702_MY2021_Tx" SG_ 1012 ChrgLocLattPostv_B_Sav 1;
BA_ "CrossOver_InfoCAN" SG_ 1012 ChrgLocLattPostv_B_Sav 1;
BA_ "ECGUsedRxSignal" SG_ 1012 ChrgLocLattPostv_B_Sav 1;
BA_ "U_P702_MY2021_Tx" SG_ 1012 ChrgLocLattFrct_An_Sav 1;
BA_ "GenSigStartValue" SG_ 1012 ChrgLocLattFrct_An_Sav 1048575;
BA_ "GenSigStartValueInteger" SG_ 1012 ChrgLocLattFrct_An_Sav 1048575;
BA_ "ECGUsedRxSignal" SG_ 1012 ChrgLocLattFrct_An_Sav 1;
BA_ "U_P702_MY2021_Tx" SG_ 1012 ChrgLocLattDeg_An_Sav 1;
BA_ "ECGUsedRxSignal" SG_ 1012 ChrgLocLattDeg_An_Sav 1;
BA_ "U_P702_MY2021_Tx" SG_ 1012 ChrgLocId_D_Sav 1;
BA_ "GenSigSendType" SG_ 1012 ChrgLocId_D_Sav 3;
BA_ "ECGUsedRxSignal" SG_ 1012 ChrgLocId_D_Sav 1;
BA_ "U_P702_MY2021_Tx" SG_ 1011 ChrgLocLongPostv_B_Uns 1;
BA_ "CrossOver_InfoCAN" SG_ 1011 ChrgLocLongPostv_B_Uns 1;
BA_ "ECGUsedRxSignal" SG_ 1011 ChrgLocLongPostv_B_Uns 1;
BA_ "U_P702_MY2021_Tx" SG_ 1011 ChrgLocLongFrct_An_Uns 1;
BA_ "GenSigStartValue" SG_ 1011 ChrgLocLongFrct_An_Uns 1048575;
BA_ "GenSigStartValueInteger" SG_ 1011 ChrgLocLongFrct_An_Uns 1048575;
BA_ "ECGUsedRxSignal" SG_ 1011 ChrgLocLongFrct_An_Uns 1;
BA_ "U_P702_MY2021_Tx" SG_ 1011 ChrgLocLongDeg_An_Uns 1;
BA_ "ECGUsedRxSignal" SG_ 1011 ChrgLocLongDeg_An_Uns 1;
BA_ "U_P702_MY2021_Tx" SG_ 1011 ChrgLocLattPostv_B_Uns 1;
BA_ "CrossOver_InfoCAN" SG_ 1011 ChrgLocLattPostv_B_Uns 1;
BA_ "ECGUsedRxSignal" SG_ 1011 ChrgLocLattPostv_B_Uns 1;
BA_ "U_P702_MY2021_Tx" SG_ 1011 ChrgLocLattFrct_An_Uns 1;
BA_ "GenSigStartValue" SG_ 1011 ChrgLocLattFrct_An_Uns 1048575;
BA_ "GenSigStartValueInteger" SG_ 1011 ChrgLocLattFrct_An_Uns 1048575;
BA_ "ECGUsedRxSignal" SG_ 1011 ChrgLocLattFrct_An_Uns 1;
BA_ "U_P702_MY2021_Tx" SG_ 1011 ChrgLocLattDeg_An_Uns 1;
BA_ "ECGUsedRxSignal" SG_ 1011 ChrgLocLattDeg_An_Uns 1;
BA_ "U_P702_MY2021_Tx" SG_ 1011 ChrgLocId_D_Uns 1;
BA_ "GenSigSendType" SG_ 1011 ChrgLocId_D_Uns 3;
BA_ "ECGUsedRxSignal" SG_ 1011 ChrgLocId_D_Uns 1;
BA_ "U_P702_MY2021_Tx" SG_ 871 BattElecPerf_D_Actl 1;
BA_ "ECGUsedRxSignal" SG_ 871 BattElecPerf_D_Actl 1;
BA_ "U_P702_MY2021_Tx" SG_ 871 BattChrgTrgtLPt_T_Est 1;
BA_ "ECGUsedRxSignal" SG_ 871 BattChrgTrgtLPt_T_Est 1;
BA_ "U_P702_MY2021_Tx" SG_ 871 BattChrgTrgSocPt_T_Est 1;
BA_ "ECGUsedRxSignal" SG_ 871 BattChrgTrgSocPt_T_Est 1;
BA_ "U_P702_MY2021_Tx" SG_ 871 BattChrgCmpltPt_T_Est 1;
BA_ "ECGUsedRxSignal" SG_ 871 BattChrgCmpltPt_T_Est 1;
BA_ "U_P702_MY2021_Rx" SG_ 912 CabnEvapSovFront_D_Stat 1;
BA_ "U_P702_MY2021_Rx" SG_ 912 BattChlrSov_D_Stat 1;
BA_ "U_P702_MY2021_Rx" SG_ 912 BattTracClntVlv_D_Stat 1;
BA_ "U_P702_MY2021_Rx" SG_ 874 BattTracShrtGrnd_D_Falt 1;
BA_ "U_P702_MY2021_Rx" SG_ 874 BattTracShrtBatt_D_Falt 1;
BA_ "U_P702_MY2021_Rx" SG_ 874 BattTracOpnCirct_D_Falt 1;
BA_ "U_P702_MY2021_Rx" SG_ 874 BattChlrShrtGrnd_D_Falt 1;
BA_ "U_P702_MY2021_Rx" SG_ 874 BattChlrShrtBatt_D_Falt 1;
BA_ "U_P702_MY2021_Rx" SG_ 874 BattChlrOpnCirct_D_Falt 1;
BA_ "U_P702_MY2021_Rx" SG_ 651 TelematicsSrvc_D_St 1;
BA_ "ECGUsedTxSignal" SG_ 651 OfbChrgSetSync_D_Rq 1;
BA_ "U_P702_MY2021_Rx" SG_ 529 OnbChrgToPcWknd_D_Actl 1;
BA_ "CrossOver_InfoCAN" SG_ 529 OnbChrgToPcWknd_D_Actl 1;
BA_ "ECGUsedTxSignal" SG_ 529 OnbChrgToPcWknd_D_Actl 1;
BA_ "U_P702_MY2021_Rx" SG_ 529 OnbChrgToPcWkdy_D_Actl 1;
BA_ "CrossOver_InfoCAN" SG_ 529 OnbChrgToPcWkdy_D_Actl 1;
BA_ "ECGUsedTxSignal" SG_ 529 OnbChrgToPcWkdy_D_Actl 1;
BA_ "U_P702_MY2021_Rx" SG_ 529 OnbChrgSetNow_D_Rq 1;
BA_ "U_P702_MY2021_Rx" SG_ 529 OnbChrgSetDelete_B_Rq 1;
BA_ "CrossOver_InfoCAN" SG_ 529 OnbChrgSetDelete_B_Rq 1;
BA_ "U_P702_MY2021_Rx" SG_ 529 OnbChrgPrflWknd_No_Rq 1;
BA_ "U_P702_MY2021_Rx" SG_ 529 OnbChrgPrflWkdy_No_Rq 1;
BA_ "U_P702_MY2021_Rx" SG_ 529 OnbChrgPrflUpdate_B_Rq 1;
BA_ "CrossOver_InfoCAN" SG_ 529 OnbChrgPrflUpdate_B_Rq 1;
BA_ "U_P702_MY2021_Rx" SG_ 529 OnbChrgLocIdUns_B_Rq 1;
BA_ "CrossOver_InfoCAN" SG_ 529 OnbChrgLocIdUns_B_Rq 1;
BA_ "U_P702_MY2021_Rx" SG_ 529 OnbChrgLocIdTrgt_No_Rq 1;
BA_ "MetaData" SG_ 529 OnbChrgLocIdTrgt_No_Rq 1;
BA_ "CrossOver_InfoCAN" SG_ 529 OnbChrgLocIdTrgt_No_Rq 1;
BA_ "U_P702_MY2021_Rx" SG_ 2610971864 PARSEDPhysGWM_ECGtoHPCM 1;
BA_ "GenSigSendType" SG_ 2610971864 PARSEDPhysGWM_ECGtoHPCM 3;
BA_ "ECGUsedTxSignal" SG_ 2610971864 PARSEDPhysGWM_ECGtoHPCM 1;
BA_ "ECGUsedTxSignal" SG_ 2612002008 PARSEDFuncGWM_ECG 1;
BA_ "U_T6_MCA_MY2020_Rx" SG_ 2612002008 PARSEDFuncGWM_ECG 1;
BA_ "U_P702_MY2021_Rx" SG_ 2612002008 PARSEDFuncGWM_ECG 1;
BA_ "GenSigSendType" SG_ 2612002008 PARSEDFuncGWM_ECG 3;
BA_ "U_P702_MY2021_Rx" SG_ 2609923288 OTAPhysGWM_ECGtoHPCM 1;
BA_ "GenSigSendType" SG_ 2609923288 OTAPhysGWM_ECGtoHPCM 3;
BA_ "ECGUsedTxSignal" SG_ 2609923288 OTAPhysGWM_ECGtoHPCM 1;
BA_ "ECGUsedTxSignal" SG_ 2610953432 OTAFuncGWM_ECG 1;
BA_ "U_T6_MCA_MY2020_Rx" SG_ 2610953432 OTAFuncGWM_ECG 1;
BA_ "U_P702_MY2021_Rx" SG_ 2610953432 OTAFuncGWM_ECG 1;
BA_ "GenSigSendType" SG_ 2610953432 OTAFuncGWM_ECG 3;
BA_ "GenSigSendType" SG_ 2022 TesterPhysicalReqSOBDMC 3;
BA_ "U_P702_MY2021_Rx" SG_ 2022 TesterPhysicalReqSOBDMC 1;
BA_ "CrossOver_InfoCAN" SG_ 1124 GPS_Vdop 1;
BA_ "CrossOver_InfoCAN" SG_ 1124 GPS_Speed 1;
BA_ "CrossOver_InfoCAN" SG_ 1124 GPS_Sat_num_in_view 1;
BA_ "U_P702_MY2021_Rx" SG_ 1124 GPS_Sat_num_in_view 1;
BA_ "CrossOver_InfoCAN" SG_ 1124 GPS_MSL_altitude 1;
BA_ "CrossOver_InfoCAN" SG_ 1124 GPS_Heading 1;
BA_ "CrossOver_InfoCAN" SG_ 1124 GPS_Hdop 1;
BA_ "CrossOver_InfoCAN" SG_ 1124 GPS_dimension 1;
BA_ "U_P702_MY2021_Rx" SG_ 1124 GPS_dimension 1;
BA_ "U_P702_MY2021_Rx" SG_ 1119 CoolFanDcdc_D_Rq 1;
BA_ "U_P702_MY2021_Rx" SG_ 1119 DcdcClntFlw_D_Rq 1;
BA_ "CrossOver_InfoCAN" SG_ 132 GlblClkYr_No_Actl 1;
BA_ "CrossOver_InfoCAN" SG_ 132 GlblClkScnd_No_Actl 1;
BA_ "CrossOver_InfoCAN" SG_ 132 GlblClkMnte_No_Actl 1;
BA_ "CrossOver_InfoCAN" SG_ 132 GlblClkHr_No_Actl 1;
BA_ "CrossOver_InfoCAN" SG_ 132 GlblClkDay_No_Actl 1;
BA_ "GenSigSendType" SG_ 1990 TesterPhysicalReqSODR 3;
BA_ "GenSigSendType" SG_ 1892 TesterPhysicalReqCCM 3;
BA_ "GenSigSendType" SG_ 1798 TesterPhysicalReqIPMA 3;
BA_ "CrossOver_InfoCAN" SG_ 1123 GpsUtcYr_No_Actl 1;
BA_ "GenSigStartValue" SG_ 1123 GpsUtcMnth_No_Actl 1;
BA_ "GenSigStartValueInteger" SG_ 1123 GpsUtcMnth_No_Actl 1;
BA_ "CrossOver_InfoCAN" SG_ 1123 GpsUtcMnth_No_Actl 1;
BA_ "GenSigStartValue" SG_ 1123 GpsUtcDay_No_Actl 1;
BA_ "GenSigStartValueInteger" SG_ 1123 GpsUtcDay_No_Actl 1;
BA_ "CrossOver_InfoCAN" SG_ 1123 GpsUtcDay_No_Actl 1;
BA_ "CrossOver_InfoCAN" SG_ 1123 GPS_UTC_seconds 1;
BA_ "CrossOver_InfoCAN" SG_ 1123 GPS_UTC_minutes 1;
BA_ "CrossOver_InfoCAN" SG_ 1123 GPS_UTC_hours 1;
BA_ "CrossOver_InfoCAN" SG_ 1123 GPS_Pdop 1;
BA_ "CrossOver_InfoCAN" SG_ 1123 GPS_Compass_direction 1;
BA_ "CrossOver_InfoCAN" SG_ 1123 GPS_Actual_vs_Infer_pos 1;
BA_ "CrossOver_InfoCAN" SG_ 1123 Gps_B_Falt 1;
BA_ "CrossOver_InfoCAN" SG_ 1122 GpsHsphLongEast_D_Actl 1;
BA_ "CrossOver_InfoCAN" SG_ 1122 GpsHsphLattSth_D_Actl 1;
BA_ "CrossOver_InfoCAN" SG_ 1122 GPS_Longitude_Minutes 1;
BA_ "CrossOver_InfoCAN" SG_ 1122 GPS_Longitude_Min_dec 1;
BA_ "GenSigStartValueInteger" SG_ 1122 GPS_Longitude_Degrees 179;
BA_ "CrossOver_InfoCAN" SG_ 1122 GPS_Longitude_Degrees 1;
BA_ "CrossOver_InfoCAN" SG_ 1122 GPS_Latitude_Minutes 1;
BA_ "CrossOver_InfoCAN" SG_ 1122 GPS_Latitude_Min_dec 1;
BA_ "CrossOver_InfoCAN" SG_ 1122 GPS_Latitude_Degrees 1;
BA_ "GenSigStartValue" SG_ 1003 PersNoPos_D_Actl 4;
BA_ "GenSigStartValueInteger" SG_ 1003 PersNoPos_D_Actl 4;
BA_ "CrossOver_InfoCAN" SG_ 1003 PersNoPos_D_Actl 1;
BA_ "CrossOver_InfoCAN" SG_ 1003 PersSetupRestr_D_Actl 1;
BA_ "CrossOver_InfoCAN" SG_ 1003 PersSetupAccessCtrl 1;
BA_ "CrossOver_InfoCAN" SG_ 1003 PersSetup_No_Actl 1;
BA_ "GenSigStartValue" SG_ 1003 PersConflict_D_Actl 1;
BA_ "GenSigStartValueInteger" SG_ 1003 PersConflict_D_Actl 1;
BA_ "CrossOver_InfoCAN" SG_ 1003 PersConflict_D_Actl 1;
BA_ "CrossOver_InfoCAN" SG_ 1003 AssocConfirm_D_Actl 1;
BA_ "MetaData" SG_ 1003 RecallEvent_No_Cnt 1;
BA_ "CrossOver_InfoCAN" SG_ 1003 RecallEvent_No_Cnt 1;
BA_ "GenSigStartValue" SG_ 1003 PersNo_D_Actl 4;
BA_ "GenSigStartValueInteger" SG_ 1003 PersNo_D_Actl 4;
BA_ "CrossOver_InfoCAN" SG_ 1003 PersNo_D_Actl 1;
BA_ "CrossOver_InfoCAN" SG_ 994 PersStore_D_Rq 1;
BA_ "CrossOver_InfoCAN" SG_ 994 Pers4OptIn_B_Stats 1;
BA_ "WakeupSignal" SG_ 994 Pers4OptIn_B_Stats 1;
BA_ "CrossOver_InfoCAN" SG_ 994 Pers3OptIn_B_Stats 1;
BA_ "WakeupSignal" SG_ 994 Pers3OptIn_B_Stats 1;
BA_ "CrossOver_InfoCAN" SG_ 994 Pers2OptIn_B_Stats 1;
BA_ "WakeupSignal" SG_ 994 Pers2OptIn_B_Stats 1;
BA_ "CrossOver_InfoCAN" SG_ 994 Pers1OptIn_B_Stats 1;
BA_ "WakeupSignal" SG_ 994 Pers1OptIn_B_Stats 1;
BA_ "GenSigStartValue" SG_ 994 CtrStkPersIndex_D_Actl 4;
BA_ "GenSigStartValueInteger" SG_ 994 CtrStkPersIndex_D_Actl 4;
BA_ "CrossOver_InfoCAN" SG_ 994 CtrStkPersIndex_D_Actl 1;
BA_ "CrossOver_InfoCAN" SG_ 994 CtrStkFeatNoActl 1;
BA_ "CrossOver_InfoCAN" SG_ 994 CtrStkFeatConfigActl 1;
BA_ "CrossOver_InfoCAN" SG_ 994 CtrStkDsplyOp_D_Rq 1;
BA_ "CrossOver_InfoCAN" SG_ 778 PrkAidFront_D_RqDrv 1;
BA_ "CrossOver_InfoCAN" SG_ 778 Cta_D_Rq 1;
BA_ "GenSigStartValueInteger" SG_ 778 Cta_D_Rq 1;
BA_ "GenSigStartValue" SG_ 778 Cta_D_Rq 1;
BA_ "CrossOver_InfoCAN" SG_ 778 PrkAidRear_D_RqDrv 1;
BA_ "CrossOver_InfoCAN" SG_ 778 Sod_D_Rq 1;
BA_ "GenSigStartValueInteger" SG_ 778 Sod_D_Rq 2;
BA_ "GenSigStartValue" SG_ 778 Sod_D_Rq 2;
BA_ "WakeupSignal" SG_ 551 Cntr_Plg_Mode_Cmd 1;
BA_ "GenSigStartValue" SG_ 551 Btt_L_Actl2 30;
BA_ "GenSigStartValueInteger" SG_ 551 Btt_L_Actl2 126;
BA_ "WakeupSignal" SG_ 551 Em_D_Stat 1;
BA_ "CrossOver_InfoCAN" SG_ 1010 CbdblActv_B_RqAdas 1;
BA_ "U_P702_MY2021_Rx" SG_ 1010 LightRng_L_Max 1;
BA_ "U_P702_MY2021_Rx" SG_ 1010 LightPathOffst_L_Actl 1;
BA_ "GenSigStartValueInteger" SG_ 1010 LightPathOffst_L_Actl 512;
BA_ "U_P702_MY2021_Rx" SG_ 1010 LightPath_An_Actl 1;
BA_ "GenSigStartValueInteger" SG_ 1010 LightPath_An_Actl 1000;
BA_ "U_P702_MY2021_Rx" SG_ 1010 LightCurv_NoRate_Actl 1;
BA_ "GenSigStartValueInteger" SG_ 1010 LightCurv_NoRate_Actl 4096;
BA_ "U_P702_MY2021_Rx" SG_ 1010 LightCurv_No_Actl 1;
BA_ "GenSigStartValueInteger" SG_ 1010 LightCurv_No_Actl 1000;
BA_ "GenSigStartValue" SG_ 1070 BattULo24_Te_Actl 127;
BA_ "GenSigStartValueInteger" SG_ 1070 BattULo24_Te_Actl 127;
BA_ "U_P702_MY2021_Rx" SG_ 1070 BattULo24State_D_Qlty 1;
BA_ "GenSigStartValue" SG_ 1070 BattULo24State_D_Qlty 1;
BA_ "U_P702_MY2021_Rx" SG_ 1070 BattULo24Soc_Pc_Actl 1;
BA_ "U_CX727_MY2021_Rx" SG_ 1070 BattULo24Soc_Pc_Actl 1;
BA_ "U_P702_MY2021_Rx" SG_ 1070 BattULo24_I_Actl 1;
BA_ "GenSigStartValue" SG_ 1070 BattULo24_I_Actl 8192;
BA_ "U_P702_MY2021_Rx" SG_ 1070 BattULo24_B_Falt 1;
BA_ "U_P702_MY2021_Rx" SG_ 1070 BattULo24_Ah_DeltaRide 1;
BA_ "GenSigStartValue" SG_ 1070 BattULo24_Ah_DeltaRide 12800;
BA_ "GenSigStartValueInteger" SG_ 1186 SelDrvMdeAwd2_D_Stat 31;
BA_ "GenSigStartValue" SG_ 1186 SelDrvMdeAwd2_D_Stat 31;
BA_ "U_CX727_MY2021_Rx" SG_ 1186 SelDrvMdeAwd2_D_Stat 1;
BA_ "U_P702_MY2021_Rx" SG_ 1186 SelDrvMdeAwd2_D_Stat 1;
BA_ "U_P702_MY2021_Tx" SG_ 1186 SelDrvMdeAwd2_D_Stat 1;
BA_ "U_P702_MY2021_Tx" SG_ 1186 RearDiffLckMsg_D_Rq 1;
BA_ "U_P702_MY2021_Rx" SG_ 1186 RearDiffLckLamp_D_Rq 1;
BA_ "U_P702_MY2021_Tx" SG_ 1186 RearDiffLckLamp_D_Rq 1;
BA_ "U_P702_MY2021_Rx" SG_ 1186 RearDiffLck_Tq_Actl 1;
BA_ "U_T6_MCA_MY2020_Rx" SG_ 1186 RearDiffLck_Tq_Actl 1;
BA_ "U_P702_MY2021_Tx" SG_ 1186 RearDiffLck_Tq_Actl 1;
BA_ "U_P702_MY2021_Rx" SG_ 1186 RearDiffFalt_D_Stat 1;
BA_ "U_P702_MY2021_Tx" SG_ 1186 RearDiffFalt_D_Stat 1;
BA_ "CrossOver_InfoCAN" SG_ 1186 LsdSrvcRqd_B_Rq 1;
BA_ "U_P702_MY2021_Tx" SG_ 1186 LsdSrvcRqd_B_Rq 1;
BA_ "GenSigStartValueInteger" SG_ 1461 PSCM_GWOnBoardTester 255;
BA_ "ContentDependant" SG_ 1461 PSCM_GWOnBoardTester 1;
BA_ "GenSigStartValue" SG_ 1461 PSCM_GWOnBoardTester 255;
BA_ "U_P702_MY2021_Rx" SG_ 1461 PSCM_GWOnBoardTester 1;
BA_ "U_CX727_MY2021_Tx" SG_ 1461 PSCM_GWOnBoardTester 1;
BA_ "U_P702_MY2021_Tx" SG_ 1461 PSCM_GWOnBoardTester 1;
BA_ "GenSigStartValueInteger" SG_ 1461 PSCM_GWNMProxy 255;
BA_ "ContentDependant" SG_ 1461 PSCM_GWNMProxy 1;
BA_ "GenSigStartValue" SG_ 1461 PSCM_GWNMProxy 255;
BA_ "U_P702_MY2021_Rx" SG_ 1461 PSCM_GWNMProxy 1;
BA_ "U_CX727_MY2021_Tx" SG_ 1461 PSCM_GWNMProxy 1;
BA_ "U_P702_MY2021_Tx" SG_ 1461 PSCM_GWNMProxy 1;
BA_ "GenSigStartValueInteger" SG_ 1461 PSCM_AutoSarNMReserved4 255;
BA_ "ContentDependant" SG_ 1461 PSCM_AutoSarNMReserved4 1;
BA_ "GenSigStartValue" SG_ 1461 PSCM_AutoSarNMReserved4 255;
BA_ "U_P702_MY2021_Rx" SG_ 1461 PSCM_AutoSarNMReserved4 1;
BA_ "U_CX727_MY2021_Tx" SG_ 1461 PSCM_AutoSarNMReserved4 1;
BA_ "U_P702_MY2021_Tx" SG_ 1461 PSCM_AutoSarNMReserved4 1;
BA_ "GenSigStartValueInteger" SG_ 1461 PSCM_AutoSarNMReserved3 255;
BA_ "ContentDependant" SG_ 1461 PSCM_AutoSarNMReserved3 1;
BA_ "GenSigStartValue" SG_ 1461 PSCM_AutoSarNMReserved3 255;
BA_ "U_P702_MY2021_Rx" SG_ 1461 PSCM_AutoSarNMReserved3 1;
BA_ "U_CX727_MY2021_Tx" SG_ 1461 PSCM_AutoSarNMReserved3 1;
BA_ "U_P702_MY2021_Tx" SG_ 1461 PSCM_AutoSarNMReserved3 1;
BA_ "GenSigStartValueInteger" SG_ 1461 PSCM_AutoSarNMReserved2 255;
BA_ "ContentDependant" SG_ 1461 PSCM_AutoSarNMReserved2 1;
BA_ "GenSigStartValue" SG_ 1461 PSCM_AutoSarNMReserved2 255;
BA_ "U_CX727_MY2021_Tx" SG_ 1461 PSCM_AutoSarNMReserved2 1;
BA_ "U_P702_MY2021_Tx" SG_ 1461 PSCM_AutoSarNMReserved2 1;
BA_ "GenSigStartValueInteger" SG_ 1461 PSCM_AutoSarNMReserved1 255;
BA_ "ContentDependant" SG_ 1461 PSCM_AutoSarNMReserved1 1;
BA_ "GenSigStartValue" SG_ 1461 PSCM_AutoSarNMReserved1 255;
BA_ "U_CX727_MY2021_Tx" SG_ 1461 PSCM_AutoSarNMReserved1 1;
BA_ "U_P702_MY2021_Tx" SG_ 1461 PSCM_AutoSarNMReserved1 1;
BA_ "GenSigStartValueInteger" SG_ 1461 PSCM_AutoSarNMNodeId 181;
BA_ "ContentDependant" SG_ 1461 PSCM_AutoSarNMNodeId 1;
BA_ "GenSigStartValue" SG_ 1461 PSCM_AutoSarNMNodeId 181;
BA_ "U_CX727_MY2021_Tx" SG_ 1461 PSCM_AutoSarNMNodeId 1;
BA_ "U_P702_MY2021_Tx" SG_ 1461 PSCM_AutoSarNMNodeId 1;
BA_ "ContentDependant" SG_ 1461 PSCM_AutoSarNMControl 1;
BA_ "U_CX727_MY2021_Tx" SG_ 1461 PSCM_AutoSarNMControl 1;
BA_ "U_P702_MY2021_Tx" SG_ 1461 PSCM_AutoSarNMControl 1;
BA_ "GenSigStartValueInteger" SG_ 1047 TrlrAnOffst_An2_Calc 128;
BA_ "U_P702_MY2021_Tx" SG_ 1047 TrlrAnOffst_An2_Calc 1;
BA_ "U_P702_MY2021_Tx" SG_ 1047 TrlrAn_An_WarnCalc 1;
BA_ "U_P702_MY2021_Tx" SG_ 1047 TrlrAn_An_MxCalc 1;
BA_ "U_P702_MY2021_Tx" SG_ 1047 TrlrAidTrlrId_No_Rq 1;
BA_ "U_P702_MY2021_Tx" SG_ 1047 TrlrAidTrgtId_No_Rq 1;
BA_ "U_P702_MY2021_Tx" SG_ 1047 TrlrAidSetup_D2_Stat 1;
BA_ "GenSigSendType" SG_ 1047 TrlrAidEnbl_D2_Stat 3;
BA_ "U_P702_MY2021_Rx" SG_ 1047 TrlrAidEnbl_D2_Stat 1;
BA_ "U_T6_MCA_MY2020_Rx" SG_ 1047 TrlrAidEnbl_D2_Stat 1;
BA_ "U_P702_MY2021_Tx" SG_ 1047 TrlrAidEnbl_D2_Stat 1;
BA_ "GenSigSendType" SG_ 1047 TrlrAidMsgTxt_D2_Rq 3;
BA_ "U_P702_MY2021_Rx" SG_ 1047 TrlrAidMsgTxt_D2_Rq 1;
BA_ "U_P702_MY2021_Tx" SG_ 1047 TrlrAidMsgTxt_D2_Rq 1;
BA_ "GenSigStartValueInteger" SG_ 1047 EsaOn_B_Stat 1;
BA_ "GenSigStartValue" SG_ 1047 EsaOn_B_Stat 1;
BA_ "GenSigSendType" SG_ 1047 EsaOn_B_Stat 3;
BA_ "U_CX727_MY2021_Tx" SG_ 1047 EsaOn_B_Stat 1;
BA_ "U_P702_MY2021_Tx" SG_ 1047 EsaOn_B_Stat 1;
BA_ "U_P702_MY2021_Tx" SG_ 1047 HitchToTrlrAxle_L_Calc 1;
BA_ "GenSigSendType" SG_ 1047 SelDrvMdeSte_D_Stat 3;
BA_ "U_CX727_MY2021_Rx" SG_ 1047 SelDrvMdeSte_D_Stat 1;
BA_ "U_P702_MY2021_Rx" SG_ 1047 SelDrvMdeSte_D_Stat 1;
BA_ "U_CX727_MY2021_Tx" SG_ 1047 SelDrvMdeSte_D_Stat 1;
BA_ "U_P702_MY2021_Tx" SG_ 1047 SelDrvMdeSte_D_Stat 1;
BA_ "GenSigSendType" SG_ 972 LatCtlSte_D_Stat 3;
BA_ "U_CX727_MY2021_Tx" SG_ 972 LatCtlSte_D_Stat 1;
BA_ "U_P702_MY2021_Tx" SG_ 972 LatCtlSte_D_Stat 1;
BA_ "GenSigSendType" SG_ 972 LatCtlLim_D_Stat 3;
BA_ "U_CX727_MY2021_Tx" SG_ 972 LatCtlLim_D_Stat 1;
BA_ "U_P702_MY2021_Tx" SG_ 972 LatCtlLim_D_Stat 1;
BA_ "MetaData" SG_ 972 LatCtlCpbltyDStat_No_Cnt 1;
BA_ "MetaData" SG_ 972 LatCtlCpbltyDStat_No_Cs 1;
BA_ "GenSigStartValueInteger" SG_ 972 TrlrAn_An_TrgtCalc 128;
BA_ "U_P702_MY2021_Tx" SG_ 972 TrlrAn_An_TrgtCalc 1;
BA_ "U_P702_MY2021_Rx" SG_ 972 LsmcBrkDecelEnbl_D_Rq 1;
BA_ "U_P702_MY2021_Tx" SG_ 972 LsmcBrkDecelEnbl_D_Rq 1;
BA_ "GenSigStartValueInteger" SG_ 972 TjaHandsOnCnfdnc_B_Est 1;
BA_ "GenSigStartValue" SG_ 972 TjaHandsOnCnfdnc_B_Est 1;
BA_ "U_CX727_MY2021_Tx" SG_ 972 TjaHandsOnCnfdnc_B_Est 1;
BA_ "U_P702_MY2021_Tx" SG_ 972 TjaHandsOnCnfdnc_B_Est 1;
BA_ "CrossOver_InfoCAN" SG_ 972 LaHandsOff_B_Actl 1;
BA_ "GenSigStartValueInteger" SG_ 972 LaHandsOff_B_Actl 1;
BA_ "GenSigStartValue" SG_ 972 LaHandsOff_B_Actl 1;
BA_ "U_CX727_MY2021_Tx" SG_ 972 LaHandsOff_B_Actl 1;
BA_ "U_P702_MY2021_Tx" SG_ 972 LaHandsOff_B_Actl 1;
BA_ "CrossOver_InfoCAN" SG_ 972 LaActDeny_B_Actl 1;
BA_ "U_CX727_MY2021_Tx" SG_ 972 LaActDeny_B_Actl 1;
BA_ "U_P702_MY2021_Tx" SG_ 972 LaActDeny_B_Actl 1;
BA_ "CrossOver_InfoCAN" SG_ 972 LaActAvail_D_Actl 1;
BA_ "U_CX727_MY2021_Tx" SG_ 972 LaActAvail_D_Actl 1;
BA_ "U_P702_MY2021_Tx" SG_ 972 LaActAvail_D_Actl 1;
BA_ "U_P702_MY2021_Rx" SG_ 972 LsmcBrk_Tq_Rq 1;
BA_ "U_P702_MY2021_Tx" SG_ 972 LsmcBrk_Tq_Rq 1;
BA_ "GenSigStartValueInteger" SG_ 1430 ABS_GWOnBoardTester 255;
BA_ "ContentDependant" SG_ 1430 ABS_GWOnBoardTester 1;
BA_ "GenSigStartValue" SG_ 1430 ABS_GWOnBoardTester 255;
BA_ "U_CX727_MY2021_Tx" SG_ 1430 ABS_GWOnBoardTester 1;
BA_ "U_P702_MY2021_Tx" SG_ 1430 ABS_GWOnBoardTester 1;
BA_ "GenSigStartValueInteger" SG_ 1430 ABS_GWNMProxy 255;
BA_ "ContentDependant" SG_ 1430 ABS_GWNMProxy 1;
BA_ "GenSigStartValue" SG_ 1430 ABS_GWNMProxy 255;
BA_ "U_CX727_MY2021_Tx" SG_ 1430 ABS_GWNMProxy 1;
BA_ "U_P702_MY2021_Tx" SG_ 1430 ABS_GWNMProxy 1;
BA_ "GenSigStartValueInteger" SG_ 1430 ABS_AutoSarNMReserved4 255;
BA_ "ContentDependant" SG_ 1430 ABS_AutoSarNMReserved4 1;
BA_ "GenSigStartValue" SG_ 1430 ABS_AutoSarNMReserved4 255;
BA_ "U_CX727_MY2021_Tx" SG_ 1430 ABS_AutoSarNMReserved4 1;
BA_ "U_P702_MY2021_Tx" SG_ 1430 ABS_AutoSarNMReserved4 1;
BA_ "GenSigStartValueInteger" SG_ 1430 ABS_AutoSarNMReserved3 255;
BA_ "ContentDependant" SG_ 1430 ABS_AutoSarNMReserved3 1;
BA_ "GenSigStartValue" SG_ 1430 ABS_AutoSarNMReserved3 255;
BA_ "U_CX727_MY2021_Tx" SG_ 1430 ABS_AutoSarNMReserved3 1;
BA_ "U_P702_MY2021_Tx" SG_ 1430 ABS_AutoSarNMReserved3 1;
BA_ "GenSigStartValueInteger" SG_ 1430 ABS_AutoSarNMReserved2 255;
BA_ "ContentDependant" SG_ 1430 ABS_AutoSarNMReserved2 1;
BA_ "GenSigStartValue" SG_ 1430 ABS_AutoSarNMReserved2 255;
BA_ "U_CX727_MY2021_Tx" SG_ 1430 ABS_AutoSarNMReserved2 1;
BA_ "U_P702_MY2021_Tx" SG_ 1430 ABS_AutoSarNMReserved2 1;
BA_ "GenSigStartValueInteger" SG_ 1430 ABS_AutoSarNMReserved1 255;
BA_ "ContentDependant" SG_ 1430 ABS_AutoSarNMReserved1 1;
BA_ "GenSigStartValue" SG_ 1430 ABS_AutoSarNMReserved1 255;
BA_ "U_CX727_MY2021_Tx" SG_ 1430 ABS_AutoSarNMReserved1 1;
BA_ "U_P702_MY2021_Tx" SG_ 1430 ABS_AutoSarNMReserved1 1;
BA_ "GenSigStartValueInteger" SG_ 1430 ABS_AutoSarNMNodeId 150;
BA_ "ContentDependant" SG_ 1430 ABS_AutoSarNMNodeId 1;
BA_ "GenSigStartValue" SG_ 1430 ABS_AutoSarNMNodeId 150;
BA_ "U_CX727_MY2021_Tx" SG_ 1430 ABS_AutoSarNMNodeId 1;
BA_ "U_P702_MY2021_Tx" SG_ 1430 ABS_AutoSarNMNodeId 1;
BA_ "ContentDependant" SG_ 1430 ABS_AutoSarNMControl 1;
BA_ "U_CX727_MY2021_Tx" SG_ 1430 ABS_AutoSarNMControl 1;
BA_ "U_P702_MY2021_Tx" SG_ 1430 ABS_AutoSarNMControl 1;
BA_ "GenSigStartValueInteger" SG_ 1102 SelDrvMdePos12_D_Stat 31;
BA_ "GenSigStartValue" SG_ 1102 SelDrvMdePos12_D_Stat 31;
BA_ "GenSigSendType" SG_ 1102 SelDrvMdePos12_D_Stat 3;
BA_ "U_CX727_MY2021_Tx" SG_ 1102 SelDrvMdePos12_D_Stat 1;
BA_ "U_P702_MY2021_Tx" SG_ 1102 SelDrvMdePos12_D_Stat 1;
BA_ "GenSigStartValueInteger" SG_ 1102 SelDrvMdePos11_D_Stat 31;
BA_ "GenSigStartValue" SG_ 1102 SelDrvMdePos11_D_Stat 31;
BA_ "GenSigSendType" SG_ 1102 SelDrvMdePos11_D_Stat 3;
BA_ "U_CX727_MY2021_Tx" SG_ 1102 SelDrvMdePos11_D_Stat 1;
BA_ "U_P702_MY2021_Tx" SG_ 1102 SelDrvMdePos11_D_Stat 1;
BA_ "GenSigStartValueInteger" SG_ 1102 SelDrvMdePos10_D_Stat 31;
BA_ "GenSigStartValue" SG_ 1102 SelDrvMdePos10_D_Stat 31;
BA_ "GenSigSendType" SG_ 1102 SelDrvMdePos10_D_Stat 3;
BA_ "U_CX727_MY2021_Tx" SG_ 1102 SelDrvMdePos10_D_Stat 1;
BA_ "U_P702_MY2021_Tx" SG_ 1102 SelDrvMdePos10_D_Stat 1;
BA_ "GenSigStartValueInteger" SG_ 1102 SelDrvMdePos09_D_Stat 31;
BA_ "GenSigStartValue" SG_ 1102 SelDrvMdePos09_D_Stat 31;
BA_ "GenSigSendType" SG_ 1102 SelDrvMdePos09_D_Stat 3;
BA_ "U_CX727_MY2021_Tx" SG_ 1102 SelDrvMdePos09_D_Stat 1;
BA_ "U_P702_MY2021_Tx" SG_ 1102 SelDrvMdePos09_D_Stat 1;
BA_ "GenSigStartValueInteger" SG_ 1102 SelDrvMdePos08_D_Stat 31;
BA_ "GenSigStartValue" SG_ 1102 SelDrvMdePos08_D_Stat 31;
BA_ "GenSigSendType" SG_ 1102 SelDrvMdePos08_D_Stat 3;
BA_ "U_CX727_MY2021_Tx" SG_ 1102 SelDrvMdePos08_D_Stat 1;
BA_ "U_P702_MY2021_Tx" SG_ 1102 SelDrvMdePos08_D_Stat 1;
BA_ "GenSigStartValueInteger" SG_ 1102 SelDrvMdePos07_D_Stat 31;
BA_ "GenSigStartValue" SG_ 1102 SelDrvMdePos07_D_Stat 31;
BA_ "GenSigSendType" SG_ 1102 SelDrvMdePos07_D_Stat 3;
BA_ "U_CX727_MY2021_Tx" SG_ 1102 SelDrvMdePos07_D_Stat 1;
BA_ "U_P702_MY2021_Tx" SG_ 1102 SelDrvMdePos07_D_Stat 1;
BA_ "GenSigStartValueInteger" SG_ 1102 SelDrvMdePos06_D_Stat 31;
BA_ "GenSigStartValue" SG_ 1102 SelDrvMdePos06_D_Stat 31;
BA_ "GenSigSendType" SG_ 1102 SelDrvMdePos06_D_Stat 3;
BA_ "U_CX727_MY2021_Tx" SG_ 1102 SelDrvMdePos06_D_Stat 1;
BA_ "U_P702_MY2021_Tx" SG_ 1102 SelDrvMdePos06_D_Stat 1;
BA_ "GenSigStartValueInteger" SG_ 1102 SelDrvMdePos05_D_Stat 31;
BA_ "GenSigStartValue" SG_ 1102 SelDrvMdePos05_D_Stat 31;
BA_ "GenSigSendType" SG_ 1102 SelDrvMdePos05_D_Stat 3;
BA_ "U_CX727_MY2021_Tx" SG_ 1102 SelDrvMdePos05_D_Stat 1;
BA_ "U_P702_MY2021_Tx" SG_ 1102 SelDrvMdePos05_D_Stat 1;
BA_ "GenSigStartValueInteger" SG_ 1102 SelDrvMdePos04_D_Stat 31;
BA_ "GenSigStartValue" SG_ 1102 SelDrvMdePos04_D_Stat 31;
BA_ "GenSigSendType" SG_ 1102 SelDrvMdePos04_D_Stat 3;
BA_ "U_CX727_MY2021_Tx" SG_ 1102 SelDrvMdePos04_D_Stat 1;
BA_ "U_P702_MY2021_Tx" SG_ 1102 SelDrvMdePos04_D_Stat 1;
BA_ "GenSigStartValueInteger" SG_ 1102 SelDrvMdePos03_D_Stat 31;
BA_ "GenSigStartValue" SG_ 1102 SelDrvMdePos03_D_Stat 31;
BA_ "GenSigSendType" SG_ 1102 SelDrvMdePos03_D_Stat 3;
BA_ "U_CX727_MY2021_Tx" SG_ 1102 SelDrvMdePos03_D_Stat 1;
BA_ "U_P702_MY2021_Tx" SG_ 1102 SelDrvMdePos03_D_Stat 1;
BA_ "GenSigStartValueInteger" SG_ 1102 SelDrvMdePos02_D_Stat 31;
BA_ "GenSigStartValue" SG_ 1102 SelDrvMdePos02_D_Stat 31;
BA_ "GenSigSendType" SG_ 1102 SelDrvMdePos02_D_Stat 3;
BA_ "U_CX727_MY2021_Tx" SG_ 1102 SelDrvMdePos02_D_Stat 1;
BA_ "U_P702_MY2021_Tx" SG_ 1102 SelDrvMdePos02_D_Stat 1;
BA_ "GenSigStartValueInteger" SG_ 1102 SelDrvMdePos01_D_Stat 31;
BA_ "GenSigStartValue" SG_ 1102 SelDrvMdePos01_D_Stat 31;
BA_ "GenSigSendType" SG_ 1102 SelDrvMdePos01_D_Stat 3;
BA_ "U_CX727_MY2021_Tx" SG_ 1102 SelDrvMdePos01_D_Stat 1;
BA_ "U_P702_MY2021_Tx" SG_ 1102 SelDrvMdePos01_D_Stat 1;
BA_ "GenSigSendType" SG_ 1056 AutoEpbMsgTxt_D_Rq 3;
BA_ "GenSigSendType" SG_ 1056 AutoEpbDsply_D_Stat 3;
BA_ "GenSigSendType" SG_ 1056 AutoEpbButtnOn_B_Stat 3;
BA_ "GenSigSendType" SG_ 1056 SelDrvMdePos12_B_Avail 3;
BA_ "U_CX727_MY2021_Tx" SG_ 1056 SelDrvMdePos12_B_Avail 1;
BA_ "U_P702_MY2021_Tx" SG_ 1056 SelDrvMdePos12_B_Avail 1;
BA_ "GenSigSendType" SG_ 1056 SelDrvMdePos11_B_Avail 3;
BA_ "U_CX727_MY2021_Tx" SG_ 1056 SelDrvMdePos11_B_Avail 1;
BA_ "U_P702_MY2021_Tx" SG_ 1056 SelDrvMdePos11_B_Avail 1;
BA_ "GenSigSendType" SG_ 1056 SelDrvMdePos10_B_Avail 3;
BA_ "U_CX727_MY2021_Tx" SG_ 1056 SelDrvMdePos10_B_Avail 1;
BA_ "U_P702_MY2021_Tx" SG_ 1056 SelDrvMdePos10_B_Avail 1;
BA_ "GenSigSendType" SG_ 1056 SelDrvMdePos09_B_Avail 3;
BA_ "U_CX727_MY2021_Tx" SG_ 1056 SelDrvMdePos09_B_Avail 1;
BA_ "U_P702_MY2021_Tx" SG_ 1056 SelDrvMdePos09_B_Avail 1;
BA_ "GenSigSendType" SG_ 1056 SelDrvMdePos08_B_Avail 3;
BA_ "U_CX727_MY2021_Tx" SG_ 1056 SelDrvMdePos08_B_Avail 1;
BA_ "U_P702_MY2021_Tx" SG_ 1056 SelDrvMdePos08_B_Avail 1;
BA_ "GenSigSendType" SG_ 1056 SelDrvMdePos07_B_Avail 3;
BA_ "U_CX727_MY2021_Tx" SG_ 1056 SelDrvMdePos07_B_Avail 1;
BA_ "U_P702_MY2021_Tx" SG_ 1056 SelDrvMdePos07_B_Avail 1;
BA_ "GenSigSendType" SG_ 1056 SelDrvMdePos06_B_Avail 3;
BA_ "U_CX727_MY2021_Tx" SG_ 1056 SelDrvMdePos06_B_Avail 1;
BA_ "U_P702_MY2021_Tx" SG_ 1056 SelDrvMdePos06_B_Avail 1;
BA_ "GenSigSendType" SG_ 1056 SelDrvMdePos05_B_Avail 3;
BA_ "U_CX727_MY2021_Tx" SG_ 1056 SelDrvMdePos05_B_Avail 1;
BA_ "U_P702_MY2021_Tx" SG_ 1056 SelDrvMdePos05_B_Avail 1;
BA_ "GenSigSendType" SG_ 1056 SelDrvMdePos04_B_Avail 3;
BA_ "U_CX727_MY2021_Tx" SG_ 1056 SelDrvMdePos04_B_Avail 1;
BA_ "U_P702_MY2021_Tx" SG_ 1056 SelDrvMdePos04_B_Avail 1;
BA_ "GenSigSendType" SG_ 1056 SelDrvMdePos03_B_Avail 3;
BA_ "U_CX727_MY2021_Tx" SG_ 1056 SelDrvMdePos03_B_Avail 1;
BA_ "U_P702_MY2021_Tx" SG_ 1056 SelDrvMdePos03_B_Avail 1;
BA_ "GenSigSendType" SG_ 1056 SelDrvMdePos02_B_Avail 3;
BA_ "U_CX727_MY2021_Tx" SG_ 1056 SelDrvMdePos02_B_Avail 1;
BA_ "U_P702_MY2021_Tx" SG_ 1056 SelDrvMdePos02_B_Avail 1;
BA_ "GenSigSendType" SG_ 1056 SelDrvMdePos01_B_Avail 3;
BA_ "U_CX727_MY2021_Tx" SG_ 1056 SelDrvMdePos01_B_Avail 1;
BA_ "U_P702_MY2021_Tx" SG_ 1056 SelDrvMdePos01_B_Avail 1;
BA_ "GenSigStartValueInteger" SG_ 1056 ActvDrvMde_D2_Stat 31;
BA_ "GenSigStartValue" SG_ 1056 ActvDrvMde_D2_Stat 31;
BA_ "GenSigSendType" SG_ 1056 ActvDrvMde_D2_Stat 3;
BA_ "U_CX727_MY2021_Tx" SG_ 1056 ActvDrvMde_D2_Stat 1;
BA_ "U_P702_MY2021_Tx" SG_ 1056 ActvDrvMde_D2_Stat 1;
BA_ "GenSigStartValueInteger" SG_ 1056 SelDrvMde_D2_Rq 31;
BA_ "GenSigStartValue" SG_ 1056 SelDrvMde_D2_Rq 31;
BA_ "GenSigSendType" SG_ 1056 SelDrvMde_D2_Rq 3;
BA_ "U_CX727_MY2021_Tx" SG_ 1056 SelDrvMde_D2_Rq 1;
BA_ "U_P702_MY2021_Tx" SG_ 1056 SelDrvMde_D2_Rq 1;
BA_ "GenSigSendType" SG_ 1056 SelDrvMdePt_D_Rq 3;
BA_ "U_P702_MY2021_Rx" SG_ 1056 SelDrvMdePt_D_Rq 1;
BA_ "U_T6_MCA_MY2020_Rx" SG_ 1056 SelDrvMdePt_D_Rq 1;
BA_ "U_CX727_MY2021_Tx" SG_ 1056 SelDrvMdePt_D_Rq 1;
BA_ "U_P702_MY2021_Tx" SG_ 1056 SelDrvMdePt_D_Rq 1;
BA_ "GenSigSendType" SG_ 1056 SelDrvMdeMsgTxt_D_Rq 3;
BA_ "U_CX727_MY2021_Tx" SG_ 1056 SelDrvMdeMsgTxt_D_Rq 1;
BA_ "U_P702_MY2021_Tx" SG_ 1056 SelDrvMdeMsgTxt_D_Rq 1;
BA_ "GenSigSendType" SG_ 1056 SelDrvMde_D_Stat 3;
BA_ "U_CX727_MY2021_Tx" SG_ 1056 SelDrvMde_D_Stat 1;
BA_ "U_P702_MY2021_Tx" SG_ 1056 SelDrvMde_D_Stat 1;
BA_ "GenSigStartValueInteger" SG_ 1056 AwdMde_D_RqBrk 5;
BA_ "GenSigStartValue" SG_ 1056 AwdMde_D_RqBrk 5;
BA_ "GenSigSendType" SG_ 1056 AwdMde_D_RqBrk 3;
BA_ "U_CX727_MY2021_Tx" SG_ 1056 AwdMde_D_RqBrk 1;
BA_ "U_P702_MY2021_Tx" SG_ 1056 AwdMde_D_RqBrk 1;
BA_ "U_P702_MY2021_Tx" SG_ 1054 AirDamUp_B_RqBrk 1;
BA_ "U_T6_MCA_MY2020_Rx" SG_ 1054 AirDamUp_B_RqBrk 1;
BA_ "U_P702_MY2021_Rx" SG_ 1054 AirDamUp_B_RqBrk 1;
BA_ "GenSigSendType" SG_ 1054 AirDamUp_B_RqBrk 3;
BA_ "GenSigSendType" SG_ 1054 RbaBrk_D_Stat 3;
BA_ "U_CX727_MY2021_Tx" SG_ 1054 RbaBrk_D_Stat 1;
BA_ "U_P702_MY2021_Tx" SG_ 1054 RbaBrk_D_Stat 1;
BA_ "GenSigSendType" SG_ 1054 SelDrvMdeChassis2_D_Rq 3;
BA_ "U_CX727_MY2021_Rx" SG_ 1054 SelDrvMdeChassis2_D_Rq 1;
BA_ "U_P702_MY2021_Rx" SG_ 1054 SelDrvMdeChassis2_D_Rq 1;
BA_ "U_P702_MY2021_Tx" SG_ 1054 SelDrvMdeChassis2_D_Rq 1;
BA_ "GenSigSendType" SG_ 1054 TrailCtl_D_Stat 3;
BA_ "U_P702_MY2021_Rx" SG_ 1054 TrailCtl_D_Stat 1;
BA_ "U_T6_MCA_MY2020_Rx" SG_ 1054 TrailCtl_D_Stat 1;
BA_ "U_CX727_MY2021_Tx" SG_ 1054 TrailCtl_D_Stat 1;
BA_ "U_P702_MY2021_Tx" SG_ 1054 TrailCtl_D_Stat 1;
BA_ "GenSigSendType" SG_ 1054 TrailCtlMsgTxt_D_Rq 3;
BA_ "U_CX727_MY2021_Tx" SG_ 1054 TrailCtlMsgTxt_D_Rq 1;
BA_ "U_P702_MY2021_Tx" SG_ 1054 TrailCtlMsgTxt_D_Rq 1;
BA_ "GenSigSendType" SG_ 1054 BrkBstrVac_D_Stat 3;
BA_ "U_P702_MY2021_Rx" SG_ 1054 BrkBstrVac_D_Stat 1;
BA_ "U_T6_MCA_MY2020_Rx" SG_ 1054 BrkBstrVac_D_Stat 1;
BA_ "U_CX727_MY2021_Tx" SG_ 1054 BrkBstrVac_D_Stat 1;
BA_ "U_P702_MY2021_Tx" SG_ 1054 BrkBstrVac_D_Stat 1;
BA_ "GenSigSendType" SG_ 1054 DrvSlipCtlOffLamp_D_Rq 3;
BA_ "U_CX727_MY2021_Tx" SG_ 1054 DrvSlipCtlOffLamp_D_Rq 1;
BA_ "U_P702_MY2021_Tx" SG_ 1054 DrvSlipCtlOffLamp_D_Rq 1;
BA_ "GenSigSendType" SG_ 1054 DrvSlipCtlMdeMsg_D_Rq 3;
BA_ "U_CX727_MY2021_Tx" SG_ 1054 DrvSlipCtlMdeMsg_D_Rq 1;
BA_ "U_P702_MY2021_Tx" SG_ 1054 DrvSlipCtlMdeMsg_D_Rq 1;
BA_ "ECGUsedRxSignal" SG_ 1054 DrvSlipCtlMdeMsg_D_Rq 1;
BA_ "GenSigSendType" SG_ 1054 AutoHoldMsgTxt_D_Rq 3;
BA_ "U_CX727_MY2021_Tx" SG_ 1054 AutoHoldMsgTxt_D_Rq 1;
BA_ "U_P702_MY2021_Tx" SG_ 1054 AutoHoldMsgTxt_D_Rq 1;
BA_ "GenSigSendType" SG_ 1054 CtaBrk_D_Stat 3;
BA_ "U_CX727_MY2021_Tx" SG_ 1054 CtaBrk_D_Stat 1;
BA_ "U_P702_MY2021_Tx" SG_ 1054 CtaBrk_D_Stat 1;
BA_ "GenSigStartValueInteger" SG_ 1054 SelDrvMdeAwd_D_Rq 31;
BA_ "GenSigStartValue" SG_ 1054 SelDrvMdeAwd_D_Rq 31;
BA_ "GenSigSendType" SG_ 1054 SelDrvMdeAwd_D_Rq 3;
BA_ "U_P702_MY2021_Rx" SG_ 1054 SelDrvMdeAwd_D_Rq 1;
BA_ "U_P702_MY2021_Tx" SG_ 1054 SelDrvMdeAwd_D_Rq 1;
BA_ "CrossOver_InfoCAN" SG_ 1054 AutoHoldSwMde_B_Ind 1;
BA_ "ContentDependant" SG_ 1054 AutoHoldSwMde_B_Ind 1;
BA_ "GenSigSendType" SG_ 1054 AutoHoldSwMde_B_Ind 3;
BA_ "U_CX727_MY2021_Tx" SG_ 1054 AutoHoldSwMde_B_Ind 1;
BA_ "U_P702_MY2021_Tx" SG_ 1054 AutoHoldSwMde_B_Ind 1;
BA_ "GenSigSendType" SG_ 1054 AutoHoldMde_D_Ind 3;
BA_ "U_CX727_MY2021_Tx" SG_ 1054 AutoHoldMde_D_Ind 1;
BA_ "U_P702_MY2021_Tx" SG_ 1054 AutoHoldMde_D_Ind 1;
BA_ "GenSigSendType" SG_ 1054 SelDrvMdeChassis_D_Rq 3;
BA_ "U_CX727_MY2021_Tx" SG_ 1054 SelDrvMdeChassis_D_Rq 1;
BA_ "U_P702_MY2021_Tx" SG_ 1054 SelDrvMdeChassis_D_Rq 1;
BA_ "GenSigSendType" SG_ 1054 ApaBrk_D_Stat 3;
BA_ "U_P702_MY2021_Rx" SG_ 1054 ApaBrk_D_Stat 1;
BA_ "U_T6_MCA_MY2020_Rx" SG_ 1054 ApaBrk_D_Stat 1;
BA_ "U_CX727_MY2021_Tx" SG_ 1054 ApaBrk_D_Stat 1;
BA_ "U_P702_MY2021_Tx" SG_ 1054 ApaBrk_D_Stat 1;
BA_ "GenSigStartValueInteger" SG_ 1045 VehStab_D_Stat 14;
BA_ "GenSigStartValue" SG_ 1045 VehStab_D_Stat 14;
BA_ "U_P702_MY2021_Rx" SG_ 1045 VehStab_D_Stat 1;
BA_ "U_T6_MCA_MY2020_Rx" SG_ 1045 VehStab_D_Stat 1;
BA_ "U_CX727_MY2021_Tx" SG_ 1045 VehStab_D_Stat 1;
BA_ "U_P702_MY2021_Tx" SG_ 1045 VehStab_D_Stat 1;
BA_ "U_CX727_MY2021_Tx" SG_ 1045 BrkFluidLvl_D_Stat 1;
BA_ "U_P702_MY2021_Tx" SG_ 1045 BrkFluidLvl_D_Stat 1;
BA_ "U_P702_MY2021_Rx" SG_ 1045 LsmcBrkDecel_D_Stat 1;
BA_ "U_P702_MY2021_Tx" SG_ 1045 LsmcBrkDecel_D_Stat 1;
BA_ "CrossOver_InfoCAN" SG_ 1045 VehYawNonLin_W_Rq 1;
BA_ "GenSigStartValueInteger" SG_ 1045 VehYawNonLin_W_Rq 4094;
BA_ "GenSigStartValue" SG_ 1045 VehYawNonLin_W_Rq 4094;
BA_ "U_P702_MY2021_Rx" SG_ 1045 VehYawNonLin_W_Rq 1;
BA_ "U_T6_MCA_MY2020_Rx" SG_ 1045 VehYawNonLin_W_Rq 1;
BA_ "U_CX727_MY2021_Tx" SG_ 1045 VehYawNonLin_W_Rq 1;
BA_ "U_P702_MY2021_Tx" SG_ 1045 VehYawNonLin_W_Rq 1;
BA_ "CrossOver_InfoCAN" SG_ 1045 VehYawLin_W_Rq 1;
BA_ "GenSigStartValueInteger" SG_ 1045 VehYawLin_W_Rq 4094;
BA_ "GenSigStartValue" SG_ 1045 VehYawLin_W_Rq 4094;
BA_ "U_P702_MY2021_Rx" SG_ 1045 VehYawLin_W_Rq 1;
BA_ "U_T6_MCA_MY2020_Rx" SG_ 1045 VehYawLin_W_Rq 1;
BA_ "U_CX727_MY2021_Tx" SG_ 1045 VehYawLin_W_Rq 1;
BA_ "U_P702_MY2021_Tx" SG_ 1045 VehYawLin_W_Rq 1;
BA_ "CrossOver_InfoCAN" SG_ 1045 VehVActlBrk_No_Cs 1;
BA_ "MetaData" SG_ 1045 VehVActlBrk_No_Cs 1;
BA_ "U_P702_MY2021_Rx" SG_ 1045 VehVActlBrk_No_Cs 1;
BA_ "U_T6_MCA_MY2020_Rx" SG_ 1045 VehVActlBrk_No_Cs 1;
BA_ "U_CX727_MY2021_Rx" SG_ 1045 VehVActlBrk_No_Cs 1;
BA_ "U_CX727_MY2021_Tx" SG_ 1045 VehVActlBrk_No_Cs 1;
BA_ "U_P702_MY2021_Tx" SG_ 1045 VehVActlBrk_No_Cs 1;
BA_ "CrossOver_InfoCAN" SG_ 1045 Veh_V_ActlBrk 1;
BA_ "U_P702_MY2021_Rx" SG_ 1045 Veh_V_ActlBrk 1;
BA_ "U_T6_MCA_MY2020_Rx" SG_ 1045 Veh_V_ActlBrk 1;
BA_ "U_CX727_MY2021_Rx" SG_ 1045 Veh_V_ActlBrk 1;
BA_ "U_CX727_MY2021_Tx" SG_ 1045 Veh_V_ActlBrk 1;
BA_ "U_P702_MY2021_Tx" SG_ 1045 Veh_V_ActlBrk 1;
BA_ "CrossOver_InfoCAN" SG_ 1045 VehVActlBrk_No_Cnt 1;
BA_ "MetaData" SG_ 1045 VehVActlBrk_No_Cnt 1;
BA_ "U_P702_MY2021_Rx" SG_ 1045 VehVActlBrk_No_Cnt 1;
BA_ "U_T6_MCA_MY2020_Rx" SG_ 1045 VehVActlBrk_No_Cnt 1;
BA_ "U_CX727_MY2021_Rx" SG_ 1045 VehVActlBrk_No_Cnt 1;
BA_ "U_CX727_MY2021_Tx" SG_ 1045 VehVActlBrk_No_Cnt 1;
BA_ "U_P702_MY2021_Tx" SG_ 1045 VehVActlBrk_No_Cnt 1;
BA_ "CrossOver_InfoCAN" SG_ 1045 VehVActlBrk_D_Qf 1;
BA_ "MetaData" SG_ 1045 VehVActlBrk_D_Qf 1;
BA_ "U_P702_MY2021_Rx" SG_ 1045 VehVActlBrk_D_Qf 1;
BA_ "U_T6_MCA_MY2020_Rx" SG_ 1045 VehVActlBrk_D_Qf 1;
BA_ "U_CX727_MY2021_Rx" SG_ 1045 VehVActlBrk_D_Qf 1;
BA_ "U_CX727_MY2021_Tx" SG_ 1045 VehVActlBrk_D_Qf 1;
BA_ "U_P702_MY2021_Tx" SG_ 1045 VehVActlBrk_D_Qf 1;
BA_ "GenSigStartValueInteger" SG_ 1042 VehRol_An_Dsply 64;
BA_ "U_P702_MY2021_Tx" SG_ 1042 VehRol_An_Dsply 1;
BA_ "GenSigStartValueInteger" SG_ 1042 VehPtch_An_Dsply 64;
BA_ "U_P702_MY2021_Rx" SG_ 1042 VehPtch_An_Dsply 1;
BA_ "U_P702_MY2021_Tx" SG_ 1042 VehPtch_An_Dsply 1;
BA_ "U_P702_MY2021_Tx" SG_ 1042 TrlrBrk_Pc_Rq 1;
BA_ "U_P702_MY2021_Rx" SG_ 535 WhlRr_W_Meas 1;
BA_ "U_T6_MCA_MY2020_Rx" SG_ 535 WhlRr_W_Meas 1;
BA_ "U_CX727_MY2021_Rx" SG_ 535 WhlRr_W_Meas 1;
BA_ "U_CX727_MY2021_Tx" SG_ 535 WhlRr_W_Meas 1;
BA_ "U_P702_MY2021_Tx" SG_ 535 WhlRr_W_Meas 1;
BA_ "U_P702_MY2021_Rx" SG_ 535 WhlRl_W_Meas 1;
BA_ "U_T6_MCA_MY2020_Rx" SG_ 535 WhlRl_W_Meas 1;
BA_ "U_CX727_MY2021_Rx" SG_ 535 WhlRl_W_Meas 1;
BA_ "U_CX727_MY2021_Tx" SG_ 535 WhlRl_W_Meas 1;
BA_ "U_P702_MY2021_Tx" SG_ 535 WhlRl_W_Meas 1;
BA_ "U_P702_MY2021_Rx" SG_ 535 WhlFr_W_Meas 1;
BA_ "U_T6_MCA_MY2020_Rx" SG_ 535 WhlFr_W_Meas 1;
BA_ "U_CX727_MY2021_Rx" SG_ 535 WhlFr_W_Meas 1;
BA_ "U_CX727_MY2021_Tx" SG_ 535 WhlFr_W_Meas 1;
BA_ "U_P702_MY2021_Tx" SG_ 535 WhlFr_W_Meas 1;
BA_ "U_P702_MY2021_Rx" SG_ 535 WhlFl_W_Meas 1;
BA_ "U_T6_MCA_MY2020_Rx" SG_ 535 WhlFl_W_Meas 1;
BA_ "U_CX727_MY2021_Rx" SG_ 535 WhlFl_W_Meas 1;
BA_ "U_CX727_MY2021_Tx" SG_ 535 WhlFl_W_Meas 1;
BA_ "U_P702_MY2021_Tx" SG_ 535 WhlFl_W_Meas 1;
BA_ "U_P702_MY2021_Rx" SG_ 532 RgenTqFalt_B_Actl 1;
BA_ "U_CX727_MY2021_Tx" SG_ 532 RgenTqFalt_B_Actl 1;
BA_ "U_P702_MY2021_Tx" SG_ 532 RgenTqFalt_B_Actl 1;
BA_ "U_P702_MY2021_Rx" SG_ 532 RgenBrkDynoMde_B_Actl 1;
BA_ "U_CX727_MY2021_Tx" SG_ 532 RgenBrkDynoMde_B_Actl 1;
BA_ "U_P702_MY2021_Tx" SG_ 532 RgenBrkDynoMde_B_Actl 1;
BA_ "MetaData" SG_ 532 PrplWhlTqRqMn_No_Cs 1;
BA_ "U_P702_MY2021_Rx" SG_ 532 PrplWhlTqRqMn_No_Cs 1;
BA_ "U_T6_MCA_MY2020_Rx" SG_ 532 PrplWhlTqRqMn_No_Cs 1;
BA_ "U_CX727_MY2021_Tx" SG_ 532 PrplWhlTqRqMn_No_Cs 1;
BA_ "U_P702_MY2021_Tx" SG_ 532 PrplWhlTqRqMn_No_Cs 1;
BA_ "U_P702_MY2021_Rx" SG_ 532 PrplWhlTot_Tq_RqMn 1;
BA_ "U_T6_MCA_MY2020_Rx" SG_ 532 PrplWhlTot_Tq_RqMn 1;
BA_ "U_CX727_MY2021_Tx" SG_ 532 PrplWhlTot_Tq_RqMn 1;
BA_ "U_P702_MY2021_Tx" SG_ 532 PrplWhlTot_Tq_RqMn 1;
BA_ "MetaData" SG_ 532 PrplWhlTqRqMn_No_Cnt 1;
BA_ "U_P702_MY2021_Rx" SG_ 532 PrplWhlTqRqMn_No_Cnt 1;
BA_ "U_T6_MCA_MY2020_Rx" SG_ 532 PrplWhlTqRqMn_No_Cnt 1;
BA_ "U_CX727_MY2021_Tx" SG_ 532 PrplWhlTqRqMn_No_Cnt 1;
BA_ "U_P702_MY2021_Tx" SG_ 532 PrplWhlTqRqMn_No_Cnt 1;
BA_ "GenSigStartValueInteger" SG_ 136 SteWhlBrkOffst_An_Rq 32766;
BA_ "GenSigStartValue" SG_ 136 SteWhlBrkOffst_An_Rq 32765;
BA_ "U_P702_MY2021_Tx" SG_ 136 SteWhlBrkOffst_An_Rq 1;
BA_ "CrossOver_InfoCAN" SG_ 136 SteWhlBrkAnRq_No_Cs 1;
BA_ "MetaData" SG_ 136 SteWhlBrkAnRq_No_Cs 1;
BA_ "U_P702_MY2021_Tx" SG_ 136 SteWhlBrkAnRq_No_Cs 1;
BA_ "CrossOver_InfoCAN" SG_ 136 SteWhlBrkAnRq_No_Cnt 1;
BA_ "MetaData" SG_ 136 SteWhlBrkAnRq_No_Cnt 1;
BA_ "U_P702_MY2021_Tx" SG_ 136 SteWhlBrkAnRq_No_Cnt 1;
BA_ "GenSigStartValueInteger" SG_ 125 VehRolComp_W_Actl 4094;
BA_ "GenSigStartValue" SG_ 125 VehRolComp_W_Actl 4094;
BA_ "U_CX727_MY2021_Tx" SG_ 125 VehRolComp_W_Actl 1;
BA_ "U_P702_MY2021_Tx" SG_ 125 VehRolComp_W_Actl 1;
BA_ "GenSigStartValueInteger" SG_ 125 VehVertComp_A_Actl 1022;
BA_ "GenSigStartValue" SG_ 125 VehVertComp_A_Actl 1022;
BA_ "U_P702_MY2021_Rx" SG_ 125 VehVertComp_A_Actl 1;
BA_ "U_CX727_MY2021_Tx" SG_ 125 VehVertComp_A_Actl 1;
BA_ "U_P702_MY2021_Tx" SG_ 125 VehVertComp_A_Actl 1;
BA_ "MetaData" SG_ 125 BrkTotTqRqArb_No_Cs 1;
BA_ "U_P702_MY2021_Rx" SG_ 125 BrkTotTqRqArb_No_Cs 1;
BA_ "U_T6_MCA_MY2020_Rx" SG_ 125 BrkTotTqRqArb_No_Cs 1;
BA_ "U_CX727_MY2021_Tx" SG_ 125 BrkTotTqRqArb_No_Cs 1;
BA_ "U_P702_MY2021_Tx" SG_ 125 BrkTotTqRqArb_No_Cs 1;
BA_ "MetaData" SG_ 125 BrkTotTqRqArb_No_Cnt 1;
BA_ "U_P702_MY2021_Rx" SG_ 125 BrkTotTqRqArb_No_Cnt 1;
BA_ "U_T6_MCA_MY2020_Rx" SG_ 125 BrkTotTqRqArb_No_Cnt 1;
BA_ "U_CX727_MY2021_Tx" SG_ 125 BrkTotTqRqArb_No_Cnt 1;
BA_ "U_P702_MY2021_Tx" SG_ 125 BrkTotTqRqArb_No_Cnt 1;
BA_ "U_P702_MY2021_Rx" SG_ 125 BrkTot_Tq_RqArb 1;
BA_ "U_T6_MCA_MY2020_Rx" SG_ 125 BrkTot_Tq_RqArb 1;
BA_ "U_CX727_MY2021_Tx" SG_ 125 BrkTot_Tq_RqArb 1;
BA_ "U_P702_MY2021_Tx" SG_ 125 BrkTot_Tq_RqArb 1;
BA_ "ECGUsedRxSignal" SG_ 125 BrkTot_Tq_RqArb 1;
BA_ "U_CX727_MY2021_Rx" SG_ 125 BrkTot_Tq_Actl 1;
BA_ "U_P702_MY2021_Rx" SG_ 125 BrkTot_Tq_Actl 1;
BA_ "U_T6_MCA_MY2020_Rx" SG_ 125 BrkTot_Tq_Actl 1;
BA_ "U_CX727_MY2021_Tx" SG_ 125 BrkTot_Tq_Actl 1;
BA_ "U_P702_MY2021_Tx" SG_ 125 BrkTot_Tq_Actl 1;
BA_ "CrossOver_InfoCAN" SG_ 125 HsaStat_D_Actl 1;
BA_ "U_P702_MY2021_Rx" SG_ 125 HsaStat_D_Actl 1;
BA_ "U_T6_MCA_MY2020_Rx" SG_ 125 HsaStat_D_Actl 1;
BA_ "U_CX727_MY2021_Tx" SG_ 125 HsaStat_D_Actl 1;
BA_ "U_P702_MY2021_Tx" SG_ 125 HsaStat_D_Actl 1;
BA_ "GenSigStartValueInteger" SG_ 119 VehTrvlDir_D_Stat 6;
BA_ "GenSigStartValue" SG_ 119 VehTrvlDir_D_Stat 6;
BA_ "U_P702_MY2021_Tx" SG_ 119 VehTrvlDir_D_Stat 1;
BA_ "U_CX727_MY2021_Rx" SG_ 119 VehOverGnd_V_Est 1;
BA_ "U_P702_MY2021_Rx" SG_ 119 VehOverGnd_V_Est 1;
BA_ "U_CX727_MY2021_Tx" SG_ 119 VehOverGnd_V_Est 1;
BA_ "U_P702_MY2021_Tx" SG_ 119 VehOverGnd_V_Est 1;
BA_ "GenSigStartValueInteger" SG_ 119 VehLongComp_A_Actl 1022;
BA_ "GenSigStartValue" SG_ 119 VehLongComp_A_Actl 1022;
BA_ "U_P702_MY2021_Rx" SG_ 119 VehLongComp_A_Actl 1;
BA_ "U_T6_MCA_MY2020_Rx" SG_ 119 VehLongComp_A_Actl 1;
BA_ "U_CX727_MY2021_Tx" SG_ 119 VehLongComp_A_Actl 1;
BA_ "U_P702_MY2021_Tx" SG_ 119 VehLongComp_A_Actl 1;
BA_ "ECGUsedRxSignal" SG_ 119 VehLongComp_A_Actl 1;
BA_ "GenSigStartValueInteger" SG_ 119 VehLatComp_A_Actl 1022;
BA_ "GenSigStartValue" SG_ 119 VehLatComp_A_Actl 1022;
BA_ "U_P702_MY2021_Rx" SG_ 119 VehLatComp_A_Actl 1;
BA_ "U_CX727_MY2021_Rx" SG_ 119 VehLatComp_A_Actl 1;
BA_ "U_T6_MCA_MY2020_Rx" SG_ 119 VehLatComp_A_Actl 1;
BA_ "U_CX727_MY2021_Tx" SG_ 119 VehLatComp_A_Actl 1;
BA_ "U_P702_MY2021_Tx" SG_ 119 VehLatComp_A_Actl 1;
BA_ "ECGUsedRxSignal" SG_ 119 VehLatComp_A_Actl 1;
BA_ "CrossOver_InfoCAN" SG_ 119 VehYawComp_W_Actl 1;
BA_ "GenSigStartValueInteger" SG_ 119 VehYawComp_W_Actl 4094;
BA_ "GenSigStartValue" SG_ 119 VehYawComp_W_Actl 4094;
BA_ "U_CX727_MY2021_Rx" SG_ 119 VehYawComp_W_Actl 1;
BA_ "U_P702_MY2021_Rx" SG_ 119 VehYawComp_W_Actl 1;
BA_ "U_T6_MCA_MY2020_Rx" SG_ 119 VehYawComp_W_Actl 1;
BA_ "U_CX727_MY2021_Tx" SG_ 119 VehYawComp_W_Actl 1;
BA_ "U_P702_MY2021_Tx" SG_ 119 VehYawComp_W_Actl 1;
BA_ "ECGUsedRxSignal" SG_ 119 VehYawComp_W_Actl 1;
BA_ "GenSigSendType" SG_ 118 BrkCtrFnd_B_Stat 3;
BA_ "U_P702_MY2021_Tx" SG_ 118 BrkCtrFnd_B_Stat 1;
BA_ "U_P702_MY2021_Rx" SG_ 118 AwdLck_Tq_RqMx 1;
BA_ "U_P702_MY2021_Tx" SG_ 118 AwdLck_Tq_RqMx 1;
BA_ "U_P702_MY2021_Rx" SG_ 118 AwdLck_Tq_RqMn 1;
BA_ "U_P702_MY2021_Tx" SG_ 118 AwdLck_Tq_RqMn 1;
BA_ "GenSigSendType" SG_ 118 DrvSte_D_Stat 3;
BA_ "U_CX727_MY2021_Rx" SG_ 118 DrvSte_D_Stat 1;
BA_ "U_P702_MY2021_Rx" SG_ 118 DrvSte_D_Stat 1;
BA_ "U_P702_MY2021_Tx" SG_ 118 DrvSte_D_Stat 1;
BA_ "GenSigStartValueInteger" SG_ 118 DrvSte_Tq_Rq 128;
BA_ "U_CX727_MY2021_Rx" SG_ 118 DrvSte_Tq_Rq 1;
BA_ "U_P702_MY2021_Rx" SG_ 118 DrvSte_Tq_Rq 1;
BA_ "U_P702_MY2021_Tx" SG_ 118 DrvSte_Tq_Rq 1;
BA_ "GenSigSendType" SG_ 118 EmgcyBrkLamp_D_Rq 3;
BA_ "U_CX727_MY2021_Tx" SG_ 118 EmgcyBrkLamp_D_Rq 1;
BA_ "U_P702_MY2021_Tx" SG_ 118 EmgcyBrkLamp_D_Rq 1;
BA_ "GenSigSendType" SG_ 118 StopLamp_B_RqBrk 3;
BA_ "U_CX727_MY2021_Tx" SG_ 118 StopLamp_B_RqBrk 1;
BA_ "U_P702_MY2021_Tx" SG_ 118 StopLamp_B_RqBrk 1;
BA_ "U_P702_MY2021_Rx" SG_ 73 immoSubTarget1Data_T1 1;
BA_ "U_T6_MCA_MY2020_Rx" SG_ 73 immoSubTarget1Data_T1 1;
BA_ "U_CX727_MY2021_Tx" SG_ 73 immoSubTarget1Data_T1 1;
BA_ "U_P702_MY2021_Tx" SG_ 73 immoSubTarget1Data_T1 1;
BA_ "U_P702_MY2021_Rx" SG_ 73 immoSubTarget1Cmd_T1 1;
BA_ "U_T6_MCA_MY2020_Rx" SG_ 73 immoSubTarget1Cmd_T1 1;
BA_ "U_CX727_MY2021_Tx" SG_ 73 immoSubTarget1Cmd_T1 1;
BA_ "U_P702_MY2021_Tx" SG_ 73 immoSubTarget1Cmd_T1 1;
BA_ "GenSigStartValueInteger" SG_ 1440 TCM_GWOnBoardTester 255;
BA_ "ContentDependant" SG_ 1440 TCM_GWOnBoardTester 1;
BA_ "GenSigStartValue" SG_ 1440 TCM_GWOnBoardTester 255;
BA_ "U_P702_MY2021_Tx" SG_ 1440 TCM_GWOnBoardTester 1;
BA_ "U_T6_MCA_MY2020_Tx" SG_ 1440 TCM_GWOnBoardTester 1;
BA_ "GenSigStartValueInteger" SG_ 1440 TCM_GWNMProxy 255;
BA_ "ContentDependant" SG_ 1440 TCM_GWNMProxy 1;
BA_ "GenSigStartValue" SG_ 1440 TCM_GWNMProxy 255;
BA_ "U_P702_MY2021_Tx" SG_ 1440 TCM_GWNMProxy 1;
BA_ "U_T6_MCA_MY2020_Tx" SG_ 1440 TCM_GWNMProxy 1;
BA_ "GenSigStartValueInteger" SG_ 1440 TCM_AutoSarNMReserved4 255;
BA_ "ContentDependant" SG_ 1440 TCM_AutoSarNMReserved4 1;
BA_ "GenSigStartValue" SG_ 1440 TCM_AutoSarNMReserved4 255;
BA_ "U_P702_MY2021_Tx" SG_ 1440 TCM_AutoSarNMReserved4 1;
BA_ "U_T6_MCA_MY2020_Tx" SG_ 1440 TCM_AutoSarNMReserved4 1;
BA_ "GenSigStartValueInteger" SG_ 1440 TCM_AutoSarNMReserved3 255;
BA_ "ContentDependant" SG_ 1440 TCM_AutoSarNMReserved3 1;
BA_ "GenSigStartValue" SG_ 1440 TCM_AutoSarNMReserved3 255;
BA_ "U_P702_MY2021_Tx" SG_ 1440 TCM_AutoSarNMReserved3 1;
BA_ "U_T6_MCA_MY2020_Tx" SG_ 1440 TCM_AutoSarNMReserved3 1;
BA_ "GenSigStartValueInteger" SG_ 1440 TCM_AutoSarNMReserved2 255;
BA_ "ContentDependant" SG_ 1440 TCM_AutoSarNMReserved2 1;
BA_ "GenSigStartValue" SG_ 1440 TCM_AutoSarNMReserved2 255;
BA_ "U_P702_MY2021_Tx" SG_ 1440 TCM_AutoSarNMReserved2 1;
BA_ "U_T6_MCA_MY2020_Tx" SG_ 1440 TCM_AutoSarNMReserved2 1;
BA_ "GenSigStartValueInteger" SG_ 1440 TCM_AutoSarNMReserved1 255;
BA_ "ContentDependant" SG_ 1440 TCM_AutoSarNMReserved1 1;
BA_ "GenSigStartValue" SG_ 1440 TCM_AutoSarNMReserved1 255;
BA_ "U_P702_MY2021_Tx" SG_ 1440 TCM_AutoSarNMReserved1 1;
BA_ "U_T6_MCA_MY2020_Tx" SG_ 1440 TCM_AutoSarNMReserved1 1;
BA_ "GenSigStartValueInteger" SG_ 1440 TCM_AutoSarNMNodeId 160;
BA_ "ContentDependant" SG_ 1440 TCM_AutoSarNMNodeId 1;
BA_ "GenSigStartValue" SG_ 1440 TCM_AutoSarNMNodeId 160;
BA_ "U_P702_MY2021_Tx" SG_ 1440 TCM_AutoSarNMNodeId 1;
BA_ "U_T6_MCA_MY2020_Tx" SG_ 1440 TCM_AutoSarNMNodeId 1;
BA_ "ContentDependant" SG_ 1440 TCM_AutoSarNMControl 1;
BA_ "U_P702_MY2021_Tx" SG_ 1440 TCM_AutoSarNMControl 1;
BA_ "U_T6_MCA_MY2020_Tx" SG_ 1440 TCM_AutoSarNMControl 1;
BA_ "CrossOver_InfoCAN" SG_ 561 TrnMsgTxt2_D_Rq 1;
BA_ "U_P702_MY2021_Tx" SG_ 561 TrnMsgTxt2_D_Rq 1;
BA_ "U_T6_MCA_MY2020_Tx" SG_ 561 TrnMsgTxt2_D_Rq 1;
BA_ "CrossOver_InfoCAN" SG_ 561 TrnMsgTxt_D_Rq 1;
BA_ "U_P702_MY2021_Tx" SG_ 561 TrnMsgTxt_D_Rq 1;
BA_ "U_T6_MCA_MY2020_Tx" SG_ 561 TrnMsgTxt_D_Rq 1;
BA_ "U_P702_MY2021_Tx" SG_ 870 EngMdeMsgTxt_D_Rq 1;
BA_ "U_P702_MY2021_Tx" SG_ 870 EffRgenThres_Pc_Dsply 1;
BA_ "GenSigStartValue" SG_ 870 EffRgenThres_Pc_Dsply 1023;
BA_ "CrossOver_InfoCAN" SG_ 870 EffRgenThres_Pc_Dsply 1;
BA_ "GenSigStartValueInteger" SG_ 870 RngPerChrgInst_L_Dsply 4094;
BA_ "GenSigStartValue" SG_ 870 RngPerChrgInst_L_Dsply 4093;
BA_ "U_P702_MY2021_Tx" SG_ 870 RngPerChrgInst_L_Dsply 1;
BA_ "U_P702_MY2021_Tx" SG_ 869 PwrFlowTxt_D_Dsply 1;
BA_ "U_P702_MY2021_Tx" SG_ 869 EngOnMsg2_D_Dsply 1;
BA_ "U_P702_MY2021_Tx" SG_ 869 EngOnMsg1_D_Dsply 1;
BA_ "U_P702_MY2021_Tx" SG_ 869 FuelMaintMde_D_Dsply 1;
BA_ "CrossOver_InfoCAN" SG_ 869 EffWhlLvl2_Pc_Dsply 1;
BA_ "GenSigStartValueInteger" SG_ 869 EffWhlLvl2_Pc_Dsply 511;
BA_ "U_P702_MY2021_Tx" SG_ 869 EffWhlLvl2_Pc_Dsply 1;
BA_ "CrossOver_InfoCAN" SG_ 869 EffWhlThres_Pc_Dsply 1;
BA_ "U_P702_MY2021_Tx" SG_ 869 EffWhlThres_Pc_Dsply 1;
BA_ "CrossOver_InfoCAN" SG_ 869 EngPwLvl_Pc_Dsply 1;
BA_ "U_P702_MY2021_Tx" SG_ 869 EngPwLvl_Pc_Dsply 1;
BA_ "CrossOver_InfoCAN" SG_ 869 EngActv_B_Dsply 1;
BA_ "U_P702_MY2021_Tx" SG_ 869 EngActv_B_Dsply 1;
BA_ "CrossOver_InfoCAN" SG_ 869 EffWhlThresOn_B_Dsply 1;
BA_ "U_P702_MY2021_Tx" SG_ 869 EffWhlThresOn_B_Dsply 1;
BA_ "GenSigSendType" SG_ 606 ElVehLaterMde_D_Stat 3;
BA_ "U_P702_MY2021_Tx" SG_ 606 ElVehLaterMde_D_Stat 1;
BA_ "GenSigSendType" SG_ 606 ElVehNowMde_D_Stat 3;
BA_ "U_P702_MY2021_Tx" SG_ 606 ElVehNowMde_D_Stat 1;
BA_ "CrossOver_InfoCAN" SG_ 602 HtrnWarnLamp_B_Dsply 1;
BA_ "U_P702_MY2021_Tx" SG_ 602 HtrnWarnLamp_B_Dsply 1;
BA_ "ECGUsedRxSignal" SG_ 602 HtrnWarnLamp_B_Dsply 1;
BA_ "U_P702_MY2021_Tx" SG_ 602 HybPwLimOn_B_Stat 1;
BA_ "CrossOver_InfoCAN" SG_ 602 PwPckTqRdy_B_Dsply 1;
BA_ "U_P702_MY2021_Tx" SG_ 602 PwPckTqRdy_B_Dsply 1;
BA_ "GenSigSendType" SG_ 1152 BattTracDiagClr_B_Stat 3;
BA_ "GenSigSendType" SG_ 1152 EngTeHi_B_Actl 3;
BA_ "U_P702_MY2021_Tx" SG_ 1152 EngTeHi_B_Actl 1;
BA_ "GenSigSendType" SG_ 1152 DcdcOn_B_Rq 3;
BA_ "U_P702_MY2021_Tx" SG_ 1152 DcdcOn_B_Rq 1;
BA_ "GenSigSendType" SG_ 1152 ULoBattSpprtSustn_B_Rq 3;
BA_ "U_P702_MY2021_Tx" SG_ 1152 ULoBattSpprtSustn_B_Rq 1;
BA_ "GenSigStartValueInteger" SG_ 1152 VehElEff_No_Avg 126;
BA_ "GenSigStartValue" SG_ 1152 VehElEff_No_Avg 126;
BA_ "U_P702_MY2021_Tx" SG_ 1152 VehElEff_No_Avg 1;
BA_ "U_P702_MY2021_Tx" SG_ 2030 TesterPhysicalResSOBDMC 1;
BA_ "U_T6_MCA_MY2020_Tx" SG_ 2030 TesterPhysicalResSOBDMC 1;
BA_ "CrossOver_InfoCAN" SG_ 332 UreaLvlQlty_D_RqDsply 1;
BA_ "U_P702_MY2021_Tx" SG_ 332 UreaLvlQlty_D_RqDsply 1;
BA_ "U_T6_MCA_MY2020_Tx" SG_ 332 UreaLvlQlty_D_RqDsply 1;
BA_ "CrossOver_InfoCAN" SG_ 332 UreaLvlTxtWarn_D_Rq 1;
BA_ "U_P702_MY2021_Tx" SG_ 332 UreaLvlTxtWarn_D_Rq 1;
BA_ "U_T6_MCA_MY2020_Tx" SG_ 332 UreaLvlTxtWarn_D_Rq 1;
BA_ "CrossOver_InfoCAN" SG_ 332 UreaQltySysWarn_D_Rq 1;
BA_ "U_P702_MY2021_Tx" SG_ 332 UreaQltySysWarn_D_Rq 1;
BA_ "U_T6_MCA_MY2020_Tx" SG_ 332 UreaQltySysWarn_D_Rq 1;
BA_ "U_P702_MY2021_Tx" SG_ 332 DieslPrtcWarn_D_Rq 1;
BA_ "U_T6_MCA_MY2020_Tx" SG_ 332 DieslPrtcWarn_D_Rq 1;
BA_ "U_P702_MY2021_Tx" SG_ 332 UreaQltyFlg_B_RqDsply 1;
BA_ "U_T6_MCA_MY2020_Tx" SG_ 332 UreaQltyFlg_B_RqDsply 1;
BA_ "ECGUsedRxSignal" SG_ 332 UreaQltyFlg_B_RqDsply 1;
BA_ "U_P702_MY2021_Tx" SG_ 332 UreaLvl_Pc_Actl 1;
BA_ "U_T6_MCA_MY2020_Tx" SG_ 332 UreaLvl_Pc_Actl 1;
BA_ "ECGUsedRxSignal" SG_ 332 UreaLvl_Pc_Actl 1;
BA_ "U_P702_MY2021_Tx" SG_ 332 VehUreaRnge2_L_DsplyMx 1;
BA_ "U_T6_MCA_MY2020_Tx" SG_ 332 VehUreaRnge2_L_DsplyMx 1;
BA_ "ECGUsedRxSignal" SG_ 332 VehUreaRnge2_L_DsplyMx 1;
BA_ "CrossOver_InfoCAN" SG_ 332 UreaQltySys_D_RqDsply 1;
BA_ "U_P702_MY2021_Tx" SG_ 332 UreaQltySys_D_RqDsply 1;
BA_ "U_T6_MCA_MY2020_Tx" SG_ 332 UreaQltySys_D_RqDsply 1;
BA_ "ECGUsedRxSignal" SG_ 332 UreaQltySys_D_RqDsply 1;
BA_ "CrossOver_InfoCAN" SG_ 332 UreaLvlTxt_D_RqDsply 1;
BA_ "U_P702_MY2021_Tx" SG_ 332 UreaLvlTxt_D_RqDsply 1;
BA_ "U_T6_MCA_MY2020_Tx" SG_ 332 UreaLvlTxt_D_RqDsply 1;
BA_ "ECGUsedRxSignal" SG_ 332 UreaLvlTxt_D_RqDsply 1;
BA_ "CrossOver_InfoCAN" SG_ 332 VehUreaWarn_V_DsplyMx 1;
BA_ "U_P702_MY2021_Tx" SG_ 332 VehUreaWarn_V_DsplyMx 1;
BA_ "U_T6_MCA_MY2020_Tx" SG_ 332 VehUreaWarn_V_DsplyMx 1;
BA_ "ECGUsedRxSignal" SG_ 332 VehUreaWarn_V_DsplyMx 1;
BA_ "GenSigSendType" SG_ 1896 TesterPhysicalResABS 3;
BA_ "U_CX727_MY2021_Tx" SG_ 1896 TesterPhysicalResABS 1;
BA_ "U_P702_MY2021_Tx" SG_ 1896 TesterPhysicalResABS 1;
BA_ "GenSigSendType" SG_ 1889 TesterPhysicalReqTCCM 3;
BA_ "U_P702_MY2021_Rx" SG_ 1889 TesterPhysicalReqTCCM 1;
BA_ "GenSigSendType" SG_ 1888 TesterPhysicalReqABS 3;
BA_ "U_CX727_MY2021_Rx" SG_ 1888 TesterPhysicalReqABS 1;
BA_ "U_P702_MY2021_Rx" SG_ 1888 TesterPhysicalReqABS 1;
BA_ "U_CX727_MY2021_Tx" SG_ 1848 TesterPhysicalResPSCM 1;
BA_ "U_P702_MY2021_Tx" SG_ 1848 TesterPhysicalResPSCM 1;
BA_ "GenSigSendType" SG_ 1840 TesterPhysicalReqPSCM 3;
BA_ "U_CX727_MY2021_Rx" SG_ 1840 TesterPhysicalReqPSCM 1;
BA_ "U_P702_MY2021_Rx" SG_ 1840 TesterPhysicalReqPSCM 1;
BA_ "U_P702_MY2021_Tx" SG_ 1713 UUDTABSResponse2 1;
BA_ "U_P702_MY2021_Tx" SG_ 1712 UUDTABSResponse1 1;
BA_ "U_P702_MY2021_Tx" SG_ 2025 TesterPhysicalResTCM 1;
BA_ "U_T6_MCA_MY2020_Tx" SG_ 2025 TesterPhysicalResTCM 1;
BA_ "U_P702_MY2021_Tx" SG_ 2024 TesterPhysicalResPCM 1;
BA_ "U_T6_MCA_MY2020_Tx" SG_ 2024 TesterPhysicalResPCM 1;
BA_ "GenSigSendType" SG_ 2017 TesterPhysicalReqTCM 3;
BA_ "U_P702_MY2021_Rx" SG_ 2017 TesterPhysicalReqTCM 1;
BA_ "U_T6_MCA_MY2020_Rx" SG_ 2017 TesterPhysicalReqTCM 1;
BA_ "GenSigSendType" SG_ 2016 TesterPhysicalReqPCM 3;
BA_ "U_P702_MY2021_Rx" SG_ 2016 TesterPhysicalReqPCM 1;
BA_ "U_T6_MCA_MY2020_Rx" SG_ 2016 TesterPhysicalReqPCM 1;
BA_ "CrossOver_InfoCAN" SG_ 2015 TesterFunctionalReq 1;
BA_ "GenSigSendType" SG_ 2015 TesterFunctionalReq 3;
BA_ "U_CX727_MY2021_Rx" SG_ 2015 TesterFunctionalReq 1;
BA_ "U_P702_MY2021_Rx" SG_ 2015 TesterFunctionalReq 1;
BA_ "U_T6_MCA_MY2020_Rx" SG_ 2015 TesterFunctionalReq 1;
BA_ "ECGUsedRxSignal" SG_ 2015 TesterFunctionalReq 1;
BA_ "GenSigSendType" SG_ 1897 TesterPhysicalResTCCM 3;
BA_ "U_P702_MY2021_Tx" SG_ 1897 TesterPhysicalResTCCM 1;
BA_ "GenSigSendType" SG_ 1814 TesterPhysicalReqGWM_F1 3;
BA_ "ECGUsedRxSignal" SG_ 1814 TesterPhysicalReqGWM_F1 1;
BA_ "U_P702_MY2021_Tx" SG_ 1701 UUDTTCMResponse2 1;
BA_ "U_T6_MCA_MY2020_Tx" SG_ 1701 UUDTTCMResponse2 1;
BA_ "U_P702_MY2021_Tx" SG_ 1700 UUDTTCMResponse1 1;
BA_ "U_T6_MCA_MY2020_Tx" SG_ 1700 UUDTTCMResponse1 1;
BA_ "U_P702_MY2021_Tx" SG_ 1697 UUDTPCMResponse2 1;
BA_ "U_T6_MCA_MY2020_Tx" SG_ 1697 UUDTPCMResponse2 1;
BA_ "U_P702_MY2021_Tx" SG_ 1696 UUDTPCMResponse1 1;
BA_ "U_T6_MCA_MY2020_Tx" SG_ 1696 UUDTPCMResponse1 1;
BA_ "GenSigStartValueInteger" SG_ 1429 PCM_GWOnBoardTester 255;
BA_ "ContentDependant" SG_ 1429 PCM_GWOnBoardTester 1;
BA_ "GenSigStartValue" SG_ 1429 PCM_GWOnBoardTester 255;
BA_ "U_P702_MY2021_Rx" SG_ 1429 PCM_GWOnBoardTester 1;
BA_ "U_T6_MCA_MY2020_Rx" SG_ 1429 PCM_GWOnBoardTester 1;
BA_ "U_P702_MY2021_Tx" SG_ 1429 PCM_GWOnBoardTester 1;
BA_ "U_T6_MCA_MY2020_Tx" SG_ 1429 PCM_GWOnBoardTester 1;
BA_ "GenSigStartValueInteger" SG_ 1429 PCM_GWNMProxy 255;
BA_ "ContentDependant" SG_ 1429 PCM_GWNMProxy 1;
BA_ "GenSigStartValue" SG_ 1429 PCM_GWNMProxy 255;
BA_ "U_P702_MY2021_Rx" SG_ 1429 PCM_GWNMProxy 1;
BA_ "U_T6_MCA_MY2020_Rx" SG_ 1429 PCM_GWNMProxy 1;
BA_ "U_P702_MY2021_Tx" SG_ 1429 PCM_GWNMProxy 1;
BA_ "U_T6_MCA_MY2020_Tx" SG_ 1429 PCM_GWNMProxy 1;
BA_ "GenSigStartValueInteger" SG_ 1429 PCM_AutoSarNMReserved4 255;
BA_ "ContentDependant" SG_ 1429 PCM_AutoSarNMReserved4 1;
BA_ "GenSigStartValue" SG_ 1429 PCM_AutoSarNMReserved4 255;
BA_ "U_P702_MY2021_Rx" SG_ 1429 PCM_AutoSarNMReserved4 1;
BA_ "U_T6_MCA_MY2020_Rx" SG_ 1429 PCM_AutoSarNMReserved4 1;
BA_ "U_P702_MY2021_Tx" SG_ 1429 PCM_AutoSarNMReserved4 1;
BA_ "U_T6_MCA_MY2020_Tx" SG_ 1429 PCM_AutoSarNMReserved4 1;
BA_ "GenSigStartValueInteger" SG_ 1429 PCM_AutoSarNMReserved3 255;
BA_ "ContentDependant" SG_ 1429 PCM_AutoSarNMReserved3 1;
BA_ "GenSigStartValue" SG_ 1429 PCM_AutoSarNMReserved3 255;
BA_ "U_P702_MY2021_Rx" SG_ 1429 PCM_AutoSarNMReserved3 1;
BA_ "U_T6_MCA_MY2020_Rx" SG_ 1429 PCM_AutoSarNMReserved3 1;
BA_ "U_P702_MY2021_Tx" SG_ 1429 PCM_AutoSarNMReserved3 1;
BA_ "U_T6_MCA_MY2020_Tx" SG_ 1429 PCM_AutoSarNMReserved3 1;
BA_ "GenSigStartValueInteger" SG_ 1429 PCM_AutoSarNMReserved2 255;
BA_ "ContentDependant" SG_ 1429 PCM_AutoSarNMReserved2 1;
BA_ "GenSigStartValue" SG_ 1429 PCM_AutoSarNMReserved2 255;
BA_ "U_P702_MY2021_Rx" SG_ 1429 PCM_AutoSarNMReserved2 1;
BA_ "U_T6_MCA_MY2020_Rx" SG_ 1429 PCM_AutoSarNMReserved2 1;
BA_ "U_P702_MY2021_Tx" SG_ 1429 PCM_AutoSarNMReserved2 1;
BA_ "U_T6_MCA_MY2020_Tx" SG_ 1429 PCM_AutoSarNMReserved2 1;
BA_ "GenSigStartValueInteger" SG_ 1429 PCM_AutoSarNMReserved1 255;
BA_ "ContentDependant" SG_ 1429 PCM_AutoSarNMReserved1 1;
BA_ "GenSigStartValue" SG_ 1429 PCM_AutoSarNMReserved1 255;
BA_ "U_P702_MY2021_Rx" SG_ 1429 PCM_AutoSarNMReserved1 1;
BA_ "U_T6_MCA_MY2020_Rx" SG_ 1429 PCM_AutoSarNMReserved1 1;
BA_ "U_P702_MY2021_Tx" SG_ 1429 PCM_AutoSarNMReserved1 1;
BA_ "U_T6_MCA_MY2020_Tx" SG_ 1429 PCM_AutoSarNMReserved1 1;
BA_ "GenSigStartValueInteger" SG_ 1429 PCM_AutoSarNMNodeId 149;
BA_ "ContentDependant" SG_ 1429 PCM_AutoSarNMNodeId 1;
BA_ "GenSigStartValue" SG_ 1429 PCM_AutoSarNMNodeId 149;
BA_ "U_P702_MY2021_Rx" SG_ 1429 PCM_AutoSarNMNodeId 1;
BA_ "U_T6_MCA_MY2020_Rx" SG_ 1429 PCM_AutoSarNMNodeId 1;
BA_ "U_P702_MY2021_Tx" SG_ 1429 PCM_AutoSarNMNodeId 1;
BA_ "U_T6_MCA_MY2020_Tx" SG_ 1429 PCM_AutoSarNMNodeId 1;
BA_ "ContentDependant" SG_ 1429 PCM_AutoSarNMControl 1;
BA_ "U_P702_MY2021_Rx" SG_ 1429 PCM_AutoSarNMControl 1;
BA_ "U_T6_MCA_MY2020_Rx" SG_ 1429 PCM_AutoSarNMControl 1;
BA_ "U_P702_MY2021_Tx" SG_ 1429 PCM_AutoSarNMControl 1;
BA_ "U_T6_MCA_MY2020_Tx" SG_ 1429 PCM_AutoSarNMControl 1;
BA_ "U_P702_MY2021_Tx" SG_ 1098 EdmVeh_V_Dsply 1;
BA_ "U_T6_MCA_MY2020_Tx" SG_ 1098 EdmVeh_V_Dsply 1;
BA_ "GenSigSendType" SG_ 1098 EdmSailMdeOn_B_Stat 3;
BA_ "U_P702_MY2021_Tx" SG_ 1098 EdmSailMdeOn_B_Stat 1;
BA_ "U_T6_MCA_MY2020_Tx" SG_ 1098 EdmSailMdeOn_B_Stat 1;
BA_ "U_P702_MY2021_Tx" SG_ 1098 EdmPrev_Fe_Dsply 1;
BA_ "U_T6_MCA_MY2020_Tx" SG_ 1098 EdmPrev_Fe_Dsply 1;
BA_ "GenSigSendType" SG_ 1098 EdmMsgTxt_D_Rq 3;
BA_ "U_P702_MY2021_Tx" SG_ 1098 EdmMsgTxt_D_Rq 1;
BA_ "U_T6_MCA_MY2020_Tx" SG_ 1098 EdmMsgTxt_D_Rq 1;
BA_ "GenSigSendType" SG_ 1098 EdmLamp_D_Dsply 3;
BA_ "U_P702_MY2021_Tx" SG_ 1098 EdmLamp_D_Dsply 1;
BA_ "U_T6_MCA_MY2020_Tx" SG_ 1098 EdmLamp_D_Dsply 1;
BA_ "U_P702_MY2021_Tx" SG_ 1098 EdmCurrent_Fe_Dsply 1;
BA_ "U_T6_MCA_MY2020_Tx" SG_ 1098 EdmCurrent_Fe_Dsply 1;
BA_ "GenSigSendType" SG_ 1098 EdmCmplnc_B_Dsply 3;
BA_ "U_P702_MY2021_Tx" SG_ 1098 EdmCmplnc_B_Dsply 1;
BA_ "U_T6_MCA_MY2020_Tx" SG_ 1098 EdmCmplnc_B_Dsply 1;
BA_ "U_P702_MY2021_Tx" SG_ 1098 EdmCmplnc_Pc_Dsply 1;
BA_ "U_T6_MCA_MY2020_Tx" SG_ 1098 EdmCmplnc_Pc_Dsply 1;
BA_ "CrossOver_InfoCAN" SG_ 1055 EcoCochInstNeg_B_Dsply 1;
BA_ "U_P702_MY2021_Tx" SG_ 1055 EcoCochInstNeg_B_Dsply 1;
BA_ "U_T6_MCA_MY2020_Tx" SG_ 1055 EcoCochInstNeg_B_Dsply 1;
BA_ "ECGUsedRxSignal" SG_ 1055 EcoCochInstNeg_B_Dsply 1;
BA_ "GenSigStartValueInteger" SG_ 1055 EcoCochShif_Pc_Dsply 255;
BA_ "GenSigStartValue" SG_ 1055 EcoCochShif_Pc_Dsply 255;
BA_ "U_P702_MY2021_Tx" SG_ 1055 EcoCochShif_Pc_Dsply 1;
BA_ "U_T6_MCA_MY2020_Tx" SG_ 1055 EcoCochShif_Pc_Dsply 1;
BA_ "ECGUsedRxSignal" SG_ 1055 EcoCochShif_Pc_Dsply 1;
BA_ "GenSigStartValueInteger" SG_ 1055 EcoCochInst_Pc_Dsply 1000;
BA_ "GenSigStartValue" SG_ 1055 EcoCochInst_Pc_Dsply 100;
BA_ "U_P702_MY2021_Tx" SG_ 1055 EcoCochInst_Pc_Dsply 1;
BA_ "U_T6_MCA_MY2020_Tx" SG_ 1055 EcoCochInst_Pc_Dsply 1;
BA_ "ECGUsedRxSignal" SG_ 1055 EcoCochInst_Pc_Dsply 1;
BA_ "GenSigStartValueInteger" SG_ 1055 EcoCochIdlFuel_Pc_Dsply 255;
BA_ "GenSigStartValue" SG_ 1055 EcoCochIdlFuel_Pc_Dsply 255;
BA_ "U_P702_MY2021_Tx" SG_ 1055 EcoCochIdlFuel_Pc_Dsply 1;
BA_ "U_T6_MCA_MY2020_Tx" SG_ 1055 EcoCochIdlFuel_Pc_Dsply 1;
BA_ "ECGUsedRxSignal" SG_ 1055 EcoCochIdlFuel_Pc_Dsply 1;
BA_ "GenSigStartValueInteger" SG_ 1055 EcoCochDecel_Pc_Dsply 255;
BA_ "GenSigStartValue" SG_ 1055 EcoCochDecel_Pc_Dsply 255;
BA_ "U_P702_MY2021_Tx" SG_ 1055 EcoCochDecel_Pc_Dsply 1;
BA_ "U_T6_MCA_MY2020_Tx" SG_ 1055 EcoCochDecel_Pc_Dsply 1;
BA_ "ECGUsedRxSignal" SG_ 1055 EcoCochDecel_Pc_Dsply 1;
BA_ "GenSigStartValueInteger" SG_ 1055 EcoCochCrus_Pc_Dsply 255;
BA_ "GenSigStartValue" SG_ 1055 EcoCochCrus_Pc_Dsply 255;
BA_ "U_P702_MY2021_Tx" SG_ 1055 EcoCochCrus_Pc_Dsply 1;
BA_ "U_T6_MCA_MY2020_Tx" SG_ 1055 EcoCochCrus_Pc_Dsply 1;
BA_ "ECGUsedRxSignal" SG_ 1055 EcoCochCrus_Pc_Dsply 1;
BA_ "GenSigStartValueInteger" SG_ 1055 EcoCochA_Pc_Dsply 255;
BA_ "GenSigStartValue" SG_ 1055 EcoCochA_Pc_Dsply 255;
BA_ "U_P702_MY2021_Tx" SG_ 1055 EcoCochA_Pc_Dsply 1;
BA_ "U_T6_MCA_MY2020_Tx" SG_ 1055 EcoCochA_Pc_Dsply 1;
BA_ "ECGUsedRxSignal" SG_ 1055 EcoCochA_Pc_Dsply 1;
BA_ "U_P702_MY2021_Tx" SG_ 523 EngAirFiltMsgTxt_D_Rq 1;
BA_ "U_T6_MCA_MY2020_Tx" SG_ 523 EngAirFiltMsgTxt_D_Rq 1;
BA_ "CrossOver_InfoCAN" SG_ 523 WaterInFuel_B_Falt 1;
BA_ "U_P702_MY2021_Tx" SG_ 523 WaterInFuel_B_Falt 1;
BA_ "U_T6_MCA_MY2020_Tx" SG_ 523 WaterInFuel_B_Falt 1;
BA_ "U_P702_MY2021_Tx" SG_ 523 UreaMnAdd_L2_Actl 1;
BA_ "U_T6_MCA_MY2020_Tx" SG_ 523 UreaMnAdd_L2_Actl 1;
BA_ "U_P702_MY2021_Tx" SG_ 523 VehUreaRnge3_L_DsplyMx 1;
BA_ "U_T6_MCA_MY2020_Tx" SG_ 523 VehUreaRnge3_L_DsplyMx 1;
BA_ "ECGUsedRxSignal" SG_ 523 VehUreaRnge3_L_DsplyMx 1;
BA_ "GenSigStartValueInteger" SG_ 523 UreaMxAdd_L2_Actl 510;
BA_ "GenSigStartValue" SG_ 523 UreaMxAdd_L2_Actl 510;
BA_ "U_P702_MY2021_Tx" SG_ 523 UreaMxAdd_L2_Actl 1;
BA_ "U_T6_MCA_MY2020_Tx" SG_ 523 UreaMxAdd_L2_Actl 1;
BA_ "U_P702_MY2021_Tx" SG_ 517 FapLc_B_Err 1;
BA_ "U_T6_MCA_MY2020_Tx" SG_ 517 FapLc_B_Err 1;
BA_ "U_CX727_MY2021_Rx" SG_ 517 BrkTot_Tq_RqFapLc 1;
BA_ "U_P702_MY2021_Rx" SG_ 517 BrkTot_Tq_RqFapLc 1;
BA_ "U_P702_MY2021_Tx" SG_ 517 BrkTot_Tq_RqFapLc 1;
BA_ "U_T6_MCA_MY2020_Tx" SG_ 517 BrkTot_Tq_RqFapLc 1;
BA_ "U_P702_MY2021_Tx" SG_ 517 TrnAin_Pc_RqDrv 1;
BA_ "U_T6_MCA_MY2020_Tx" SG_ 517 TrnAin_Pc_RqDrv 1;
BA_ "U_P702_MY2021_Tx" SG_ 381 EngOilLife_T_Actl 1;
BA_ "U_T6_MCA_MY2020_Tx" SG_ 381 EngOilLife_T_Actl 1;
BA_ "U_P702_MY2021_Tx" SG_ 381 EngOilSrvcMsgTxt_D_Rq 1;
BA_ "U_T6_MCA_MY2020_Tx" SG_ 381 EngOilSrvcMsgTxt_D_Rq 1;
BA_ "ECGUsedRxSignal" SG_ 381 EngOilSrvcMsgTxt_D_Rq 1;
BA_ "U_P702_MY2021_Tx" SG_ 381 DistToNextOilChange 1;
BA_ "U_T6_MCA_MY2020_Tx" SG_ 381 DistToNextOilChange 1;
BA_ "U_P702_MY2021_Tx" SG_ 381 RunDryPrevent_B_Stat 1;
BA_ "U_T6_MCA_MY2020_Tx" SG_ 381 RunDryPrevent_B_Stat 1;
BA_ "CrossOver_InfoCAN" SG_ 381 WaterInFuel 1;
BA_ "U_P702_MY2021_Tx" SG_ 381 WaterInFuel 1;
BA_ "U_T6_MCA_MY2020_Tx" SG_ 381 WaterInFuel 1;
BA_ "ECGUsedRxSignal" SG_ 381 WaterInFuel 1;
BA_ "CrossOver_InfoCAN" SG_ 381 GlowIndication 1;
BA_ "U_P702_MY2021_Tx" SG_ 381 GlowIndication 1;
BA_ "U_T6_MCA_MY2020_Tx" SG_ 381 GlowIndication 1;
BA_ "U_P702_MY2021_Tx" SG_ 373 DieslPrtc2_D_RqDsply 1;
BA_ "U_T6_MCA_MY2020_Tx" SG_ 373 DieslPrtc2_D_RqDsply 1;
BA_ "ECGUsedRxSignal" SG_ 373 DieslPrtc2_D_RqDsply 1;
BA_ "CrossOver_InfoCAN" SG_ 373 DieslPrtcRgen_D_Actl 1;
BA_ "U_P702_MY2021_Rx" SG_ 373 DieslPrtcRgen_D_Actl 1;
BA_ "U_T6_MCA_MY2020_Rx" SG_ 373 DieslPrtcRgen_D_Actl 1;
BA_ "U_P702_MY2021_Tx" SG_ 373 DieslPrtcRgen_D_Actl 1;
BA_ "U_T6_MCA_MY2020_Tx" SG_ 373 DieslPrtcRgen_D_Actl 1;
BA_ "CrossOver_InfoCAN" SG_ 373 EngTeColdPrtct_D_Stats 1;
BA_ "U_P702_MY2021_Tx" SG_ 373 EngTeColdPrtct_D_Stats 1;
BA_ "U_T6_MCA_MY2020_Tx" SG_ 373 EngTeColdPrtct_D_Stats 1;
BA_ "CrossOver_InfoCAN" SG_ 373 EngExhOvrTe_B_RqDsply 1;
BA_ "U_P702_MY2021_Tx" SG_ 373 EngExhOvrTe_B_RqDsply 1;
BA_ "U_T6_MCA_MY2020_Tx" SG_ 373 EngExhOvrTe_B_RqDsply 1;
BA_ "ECGUsedRxSignal" SG_ 373 EngExhOvrTe_B_RqDsply 1;
BA_ "U_P702_MY2021_Tx" SG_ 355 AutoRgenTxt_B_RqDsply 1;
BA_ "U_T6_MCA_MY2020_Tx" SG_ 355 AutoRgenTxt_B_RqDsply 1;
BA_ "ECGUsedRxSignal" SG_ 355 AutoRgenTxt_B_RqDsply 1;
BA_ "CrossOver_InfoCAN" SG_ 355 AccFllwMdeActv_B_Actl 1;
BA_ "U_P702_MY2021_Tx" SG_ 355 AccFllwMdeActv_B_Actl 1;
BA_ "U_T6_MCA_MY2020_Tx" SG_ 355 AccFllwMdeActv_B_Actl 1;
BA_ "CrossOver_InfoCAN" SG_ 355 EngPtoMde_D_Actl 1;
BA_ "U_P702_MY2021_Tx" SG_ 355 EngPtoMde_D_Actl 1;
BA_ "U_T6_MCA_MY2020_Tx" SG_ 355 EngPtoMde_D_Actl 1;
BA_ "CrossOver_InfoCAN" SG_ 355 ManRgenTxt_D_RqDsply 1;
BA_ "U_P702_MY2021_Tx" SG_ 355 ManRgenTxt_D_RqDsply 1;
BA_ "U_T6_MCA_MY2020_Tx" SG_ 355 ManRgenTxt_D_RqDsply 1;
BA_ "ECGUsedRxSignal" SG_ 355 ManRgenTxt_D_RqDsply 1;
BA_ "CrossOver_InfoCAN" SG_ 355 ManRgenSoot_Pc_RqDsply 1;
BA_ "U_P702_MY2021_Tx" SG_ 355 ManRgenSoot_Pc_RqDsply 1;
BA_ "U_T6_MCA_MY2020_Tx" SG_ 355 ManRgenSoot_Pc_RqDsply 1;
BA_ "ECGUsedRxSignal" SG_ 355 ManRgenSoot_Pc_RqDsply 1;
BA_ "U_P702_MY2021_Tx" SG_ 355 DieslMsgTxt_D_Rq 1;
BA_ "U_T6_MCA_MY2020_Tx" SG_ 355 DieslMsgTxt_D_Rq 1;
BA_ "U_P702_MY2021_Rx" SG_ 71 immoTarget1Status 1;
BA_ "U_T6_MCA_MY2020_Rx" SG_ 71 immoTarget1Status 1;
BA_ "U_CX727_MY2021_Rx" SG_ 71 immoTarget1Status 1;
BA_ "U_P702_MY2021_Tx" SG_ 71 immoTarget1Status 1;
BA_ "U_T6_MCA_MY2020_Tx" SG_ 71 immoTarget1Status 1;
BA_ "U_CX727_MY2021_Rx" SG_ 71 immoTarget1Data 1;
BA_ "U_P702_MY2021_Rx" SG_ 71 immoTarget1Data 1;
BA_ "U_P702_MY2021_Tx" SG_ 71 immoTarget1Data 1;
BA_ "U_T6_MCA_MY2020_Tx" SG_ 71 immoTarget1Data 1;
BA_ "U_CX727_MY2021_Rx" SG_ 71 immoTarget1Cmd 1;
BA_ "U_P702_MY2021_Rx" SG_ 71 immoTarget1Cmd 1;
BA_ "U_P702_MY2021_Tx" SG_ 71 immoTarget1Cmd 1;
BA_ "U_T6_MCA_MY2020_Tx" SG_ 71 immoTarget1Cmd 1;
BA_ "GenSigSendType" SG_ 1822 TesterPhysicalResGWM_F1 3;
BA_ "ECGUsedTxSignal" SG_ 1822 TesterPhysicalResGWM_F1 1;
BA_ "GenSigStartValueInteger" SG_ 1438 GWM_GWOnBoardTester 255;
BA_ "ContentDependant" SG_ 1438 GWM_GWOnBoardTester 1;
BA_ "GenSigStartValue" SG_ 1438 GWM_GWOnBoardTester 255;
BA_ "ECGUsedTxSignal" SG_ 1438 GWM_GWOnBoardTester 1;
BA_ "GenSigStartValueInteger" SG_ 1438 GWM_GWNMProxy 255;
BA_ "ContentDependant" SG_ 1438 GWM_GWNMProxy 1;
BA_ "GenSigStartValue" SG_ 1438 GWM_GWNMProxy 255;
BA_ "ECGUsedTxSignal" SG_ 1438 GWM_GWNMProxy 1;
BA_ "GenSigStartValueInteger" SG_ 1438 GWM_AutoSarNMReserved4 255;
BA_ "ContentDependant" SG_ 1438 GWM_AutoSarNMReserved4 1;
BA_ "GenSigStartValue" SG_ 1438 GWM_AutoSarNMReserved4 255;
BA_ "ECGUsedTxSignal" SG_ 1438 GWM_AutoSarNMReserved4 1;
BA_ "GenSigStartValueInteger" SG_ 1438 GWM_AutoSarNMReserved3 255;
BA_ "ContentDependant" SG_ 1438 GWM_AutoSarNMReserved3 1;
BA_ "GenSigStartValue" SG_ 1438 GWM_AutoSarNMReserved3 255;
BA_ "ECGUsedTxSignal" SG_ 1438 GWM_AutoSarNMReserved3 1;
BA_ "GenSigStartValueInteger" SG_ 1438 GWM_AutoSarNMReserved2 255;
BA_ "ContentDependant" SG_ 1438 GWM_AutoSarNMReserved2 1;
BA_ "GenSigStartValue" SG_ 1438 GWM_AutoSarNMReserved2 255;
BA_ "ECGUsedTxSignal" SG_ 1438 GWM_AutoSarNMReserved2 1;
BA_ "GenSigStartValueInteger" SG_ 1438 GWM_AutoSarNMReserved1 255;
BA_ "ContentDependant" SG_ 1438 GWM_AutoSarNMReserved1 1;
BA_ "GenSigStartValue" SG_ 1438 GWM_AutoSarNMReserved1 255;
BA_ "ECGUsedTxSignal" SG_ 1438 GWM_AutoSarNMReserved1 1;
BA_ "GenSigStartValueInteger" SG_ 1438 GWM_AutoSarNMNodeId 158;
BA_ "ContentDependant" SG_ 1438 GWM_AutoSarNMNodeId 1;
BA_ "GenSigStartValue" SG_ 1438 GWM_AutoSarNMNodeId 158;
BA_ "ECGUsedTxSignal" SG_ 1438 GWM_AutoSarNMNodeId 1;
BA_ "ContentDependant" SG_ 1438 GWM_AutoSarNMControl 1;
BA_ "ECGUsedTxSignal" SG_ 1438 GWM_AutoSarNMControl 1;
BA_ "CrossOver_InfoCAN" SG_ 1006 PersIndexIpmb_D_Actl 1;
BA_ "GenSigStartValueInteger" SG_ 1006 PersIndexIpmb_D_Actl 4;
BA_ "GenSigStartValue" SG_ 1006 PersIndexIpmb_D_Actl 4;
BA_ "GenSigSendType" SG_ 1006 PersIndexIpmb_D_Actl 3;
BA_ "CrossOver_InfoCAN" SG_ 1006 FeatNoIpmbActl 1;
BA_ "GenSigSendType" SG_ 1006 FeatNoIpmbActl 3;
BA_ "CrossOver_InfoCAN" SG_ 1006 FeatConfigIpmbActl 1;
BA_ "GenSigSendType" SG_ 1006 FeatConfigIpmbActl 3;
BA_ "GenSigSendType" SG_ 820 AhbStatGfhbFdbk_D_Actl 3;
BA_ "U_P702_MY2021_Tx" SG_ 820 AhbStatGfhbFdbk_D_Actl 1;
BA_ "GenSigSendType" SG_ 820 HeadLghtDrvSide_B_Stat 3;
BA_ "U_P702_MY2021_Tx" SG_ 820 HeadLghtDrvSide_B_Stat 1;
BA_ "CrossOver_InfoCAN" SG_ 820 HeadLghtHiOn_B_StatHcm 1;
BA_ "GenSigSendType" SG_ 820 HeadLghtHiOn_B_StatHcm 3;
BA_ "U_P702_MY2021_Tx" SG_ 820 HeadLghtHiOn_B_StatHcm 1;
BA_ "CrossOver_InfoCAN" SG_ 820 Adaptive_Hdlmp_Fault 1;
BA_ "GenSigSendType" SG_ 820 Adaptive_Hdlmp_Fault 3;
BA_ "U_P702_MY2021_Tx" SG_ 820 Adaptive_Hdlmp_Fault 1;
BA_ "GenSigStartValueInteger" SG_ 137 SteWhlOffstRq_D_Stat 2;
BA_ "GenSigStartValue" SG_ 137 SteWhlOffstRq_D_Stat 2;
BA_ "U_P702_MY2021_Rx" SG_ 137 SteWhlOffstRq_D_Stat 1;
BA_ "GenSigStartValueInteger" SG_ 137 SteWhlOffst_An_TotActl 32766;
BA_ "GenSigStartValue" SG_ 137 SteWhlOffst_An_TotActl 32765;
BA_ "U_P702_MY2021_Rx" SG_ 137 SteWhlOffst_An_TotActl 1;
BA_ "GenSigStartValueInteger" SG_ 137 SteWhlBrkOffst_An_Actl 32766;
BA_ "GenSigStartValue" SG_ 137 SteWhlBrkOffst_An_Actl 32765;
BA_ "U_P702_MY2021_Rx" SG_ 137 SteWhlBrkOffst_An_Actl 1;
BA_ "CrossOver_InfoCAN" SG_ 137 SteWhlBrkAnActl_No_Cs 1;
BA_ "MetaData" SG_ 137 SteWhlBrkAnActl_No_Cs 1;
BA_ "U_P702_MY2021_Rx" SG_ 137 SteWhlBrkAnActl_No_Cs 1;
BA_ "CrossOver_InfoCAN" SG_ 137 SteWhlBrkAnActl_No_Cnt 1;
BA_ "MetaData" SG_ 137 SteWhlBrkAnActl_No_Cnt 1;
BA_ "U_P702_MY2021_Rx" SG_ 137 SteWhlBrkAnActl_No_Cnt 1;
BA_ "U_CX727_MY2021_Rx" SG_ 129 SelDrvMdeSwtch_D_Stat4 1;
BA_ "U_P702_MY2021_Rx" SG_ 129 SelDrvMdeSwtch_D_Stat4 1;
BA_ "WakeupSignal" SG_ 129 SteWhlSwtchView_B_Stat 1;
BA_ "WakeupSignal" SG_ 129 SteWhlSwtchSet_B_Stat 1;
BA_ "WakeupSignal" SG_ 129 SteWhlSwtchPhon_B_Stat 1;
BA_ "WakeupSignal" SG_ 129 SteWhlSwtchNav_B_Stat 1;
BA_ "WakeupSignal" SG_ 129 SteWhlSwtchMed_B_Stat 1;
BA_ "WakeupSignal" SG_ 129 SteWhlSwtchIod_B_Stat 1;
BA_ "WakeupSignal" SG_ 129 SteWhlSwtchHud_B_Stat 1;
BA_ "WakeupSignal" SG_ 129 SteWhlSwtchBack_B_Stat 1;
BA_ "WakeupSignal" SG_ 129 SteWhlSwtchMenu_B_Stat 1;
BA_ "WakeupSignal" SG_ 129 SteWhlSwtchUp_B_Stat 1;
BA_ "WakeupSignal" SG_ 129 SteWhlSwtchRght_B_Stat 1;
BA_ "WakeupSignal" SG_ 129 SteWhlSwtchOk_B_Stat 1;
BA_ "WakeupSignal" SG_ 129 SteWhlSwtchLeft_B_Stat 1;
BA_ "WakeupSignal" SG_ 129 SteWhlSwtchDown_B_Stat 1;
BA_ "U_CX727_MY2021_Rx" SG_ 1108 RCMSerialNoByte8 1;
BA_ "U_P702_MY2021_Rx" SG_ 1108 RCMSerialNoByte8 1;
BA_ "U_CX727_MY2021_Rx" SG_ 1108 RCMSerialNoByte7 1;
BA_ "U_P702_MY2021_Rx" SG_ 1108 RCMSerialNoByte7 1;
BA_ "U_CX727_MY2021_Rx" SG_ 1108 RCMSerialNoByte6 1;
BA_ "U_P702_MY2021_Rx" SG_ 1108 RCMSerialNoByte6 1;
BA_ "U_CX727_MY2021_Rx" SG_ 1108 RCMSerialNoByte5 1;
BA_ "U_P702_MY2021_Rx" SG_ 1108 RCMSerialNoByte5 1;
BA_ "U_CX727_MY2021_Rx" SG_ 1108 RCMSerialNoByte4 1;
BA_ "U_P702_MY2021_Rx" SG_ 1108 RCMSerialNoByte4 1;
BA_ "U_CX727_MY2021_Rx" SG_ 1108 RCMSerialNoByte3 1;
BA_ "U_P702_MY2021_Rx" SG_ 1108 RCMSerialNoByte3 1;
BA_ "U_CX727_MY2021_Rx" SG_ 1108 RCMSerialNoByte2 1;
BA_ "U_P702_MY2021_Rx" SG_ 1108 RCMSerialNoByte2 1;
BA_ "U_CX727_MY2021_Rx" SG_ 1108 RCMSerialNoByte1 1;
BA_ "U_P702_MY2021_Rx" SG_ 1108 RCMSerialNoByte1 1;
BA_ "GenSigStartValueInteger" SG_ 261 ChrgStatDsply_D_Rq 1;
BA_ "GenSigStartValue" SG_ 261 ChrgStatDsply_D_Rq 1;
BA_ "U_P702_MY2021_Rx" SG_ 1146 TrlrAidSwtch_D_RqDrv 1;
BA_ "GenSigStartValueInteger" SG_ 1146 TrlrAidCtl_U_RqDrv 4094;
BA_ "GenSigStartValue" SG_ 1146 TrlrAidCtl_U_RqDrv 4093;
BA_ "U_P702_MY2021_Rx" SG_ 1146 TrlrAidCtl_U_RqDrv 1;
BA_ "U_P702_MY2021_Rx" SG_ 533 TrlrAidMde_D_Rq 1;
BA_ "CrossOver_InfoCAN" SG_ 533 OnbChrgGoTOn_D_Rq 1;
BA_ "GenSigStartValueInteger" SG_ 533 OnbChrgGoTOn_D_Rq 2;
BA_ "GenSigStartValue" SG_ 533 OnbChrgGoTOn_D_Rq 2;
BA_ "CrossOver_InfoCAN" SG_ 533 OnbChrgGoTMnte_D_Rq 1;
BA_ "MetaData" SG_ 533 OnbChrgGoTMnte_D_Rq 1;
BA_ "GenSigStartValueInteger" SG_ 533 OnbChrgGoTHr_T_Rq 30;
BA_ "GenSigStartValue" SG_ 533 OnbChrgGoTHr_T_Rq 30;
BA_ "CrossOver_InfoCAN" SG_ 533 OnbChrgGoTElement_D_Rq 1;
BA_ "MetaData" SG_ 533 OnbChrgGoTElement_D_Rq 1;
BA_ "CrossOver_InfoCAN" SG_ 533 OnbChrgGoTDelete_B_Rq 1;
BA_ "CrossOver_InfoCAN" SG_ 533 OnbChrgClearAll_B_Rq 1;
BA_ "ECGUsedTxSignal" SG_ 533 OnbChrgClearAll_B_Rq 1;
BA_ "CrossOver_InfoCAN" SG_ 533 OnbChrgGoTUpdate_B_Rq 1;
BA_ "U_P702_MY2021_Rx" SG_ 1041 ElCmpr_Pw_Actl 1;
BA_ "U_P702_MY2021_Rx" SG_ 1067 BattULoAuxIsol_D_Rq 1;
BA_ "GenSigStartValue" SG_ 1067 BattULoAuxIsol_D_Rq 2;
BA_ "U_P702_MY2021_Rx" SG_ 1067 BattULoAux_U_Rq 1;
BA_ "GenSigStartValue" SG_ 1067 BattULoAux_U_Rq 3296;
BA_ "GenSigStartValueInteger" SG_ 1067 BattULoAuxSoc_Pc_Actl 95;
BA_ "GenSigStartValue" SG_ 1067 BattULoAuxSoc_Pc_Actl 95;
BA_ "U_P702_MY2021_Rx" SG_ 1067 BattULoAuxSoc_Pc_Actl 1;
BA_ "GenSigStartValueInteger" SG_ 1067 BattULoAux_I_Actl 2048;
BA_ "U_P702_MY2021_Rx" SG_ 1067 BattULoAux_I_Actl 1;
BA_ "U_P702_MY2021_Rx" SG_ 1067 BattULoAux_D_Qlty 1;
BA_ "U_P702_MY2021_Rx" SG_ 1067 BattULoCrnkStrt_U_Pred 1;
BA_ "U_P702_MY2021_Rx" SG_ 1067 BattULoCrnkBelt_U_Pred 1;
BA_ "GenSigStartValueInteger" SG_ 1067 BattULoAux_U_Actl 203;
BA_ "GenSigStartValue" SG_ 1067 BattULoAux_U_Actl 203;
BA_ "U_P702_MY2021_Rx" SG_ 1067 BattULoAux_U_Actl 1;
BA_ "U_P702_MY2021_Rx" SG_ 1067 BattULoAux_B_Falt 1;
BA_ "U_T6_MCA_MY2020_Rx" SG_ 139 AfsPw_B_Rq 1;
BA_ "U_P702_MY2021_Rx" SG_ 139 AfsPw_B_Rq 1;
BA_ "U_P702_MY2021_Rx" SG_ 139 ActvFrontSteLck_D_Stat 1;
BA_ "U_T6_MCA_MY2020_Rx" SG_ 139 ActvFrontSteLck_D_Stat 1;
BA_ "U_P702_MY2021_Rx" SG_ 139 SelDrvMdeAdptSte_D_Stat 1;
BA_ "U_CX727_MY2021_Rx" SG_ 1121 SelDrvMdeSwtch_No_Actl 1;
BA_ "U_P702_MY2021_Rx" SG_ 1121 SelDrvMdeSwtch_No_Actl 1;
BA_ "U_CX727_MY2021_Rx" SG_ 1121 SelDrvMdeSwtch_D_Stat 1;
BA_ "U_P702_MY2021_Rx" SG_ 1121 SelDrvMdeSwtch_D_Stat 1;
BA_ "U_CX727_MY2021_Rx" SG_ 1121 SelDrvMdeCnt_D_Stat 1;
BA_ "U_P702_MY2021_Rx" SG_ 1121 SelDrvMdeCnt_D_Stat 1;
BA_ "CrossOver_InfoCAN" SG_ 1120 DrvSlipCtlMde_B_Rq3 1;
BA_ "U_P702_MY2021_Rx" SG_ 1120 DrvSlipCtlMde_B_Rq3 1;
BA_ "U_P702_MY2021_Rx" SG_ 1120 HybMdeSwtch_B_Rq 1;
BA_ "GenSigStartValueInteger" SG_ 1120 RearDiffLck_D_RqDrv 2;
BA_ "GenSigStartValue" SG_ 1120 RearDiffLck_D_RqDrv 2;
BA_ "U_P702_MY2021_Rx" SG_ 1120 RearDiffLck_D_RqDrv 1;
BA_ "GenSigStartValueInteger" SG_ 1120 AwdMde_D_RqDrv 5;
BA_ "GenSigStartValue" SG_ 1120 AwdMde_D_RqDrv 5;
BA_ "U_P702_MY2021_Rx" SG_ 1120 AwdMde_D_RqDrv 1;
BA_ "U_P702_MY2021_Rx" SG_ 1120 HdcSwtchPos_B_Actl 1;
BA_ "GenSigStartValueInteger" SG_ 1137 RngPerChrgAvg_L_Dsply 4094;
BA_ "GenSigStartValue" SG_ 1137 RngPerChrgAvg_L_Dsply 4093;
BA_ "U_P702_MY2021_Tx" SG_ 1137 RngPerChrgAvg_L_Dsply 1;
BA_ "GenSigStartValueInteger" SG_ 1255 BalrRight4Prev3Y_L_Actl 64;
BA_ "GenSigStartValueInteger" SG_ 1255 BalrRight4Prev3X_L_Actl 64;
BA_ "GenSigStartValueInteger" SG_ 1255 BalrRight4Prev2Y_L_Actl 64;
BA_ "GenSigStartValueInteger" SG_ 1255 BalrRight4Prev2X_L_Actl 64;
BA_ "GenSigStartValueInteger" SG_ 1255 BalrRight4Prev1Y_L_Actl 64;
BA_ "GenSigStartValueInteger" SG_ 1255 BalrRight4Prev1X_L_Actl 64;
BA_ "GenSigStartValueInteger" SG_ 1255 BalrRight4CurntY_L_Actl 64;
BA_ "GenSigStartValueInteger" SG_ 1255 BalrRight4CurntX_L_Actl 64;
BA_ "GenSigSendType" SG_ 1254 BalrRight3Threat_D_Stat 3;
BA_ "GenSigStartValueInteger" SG_ 1254 BalrRight3Prev3Y_L_Actl 64;
BA_ "GenSigStartValueInteger" SG_ 1254 BalrRight3Prev3X_L_Actl 64;
BA_ "GenSigStartValueInteger" SG_ 1254 BalrRight3Prev2Y_L_Actl 64;
BA_ "GenSigStartValueInteger" SG_ 1254 BalrRight3Prev2X_L_Actl 64;
BA_ "GenSigStartValueInteger" SG_ 1254 BalrRight3Prev1Y_L_Actl 64;
BA_ "GenSigStartValueInteger" SG_ 1254 BalrRight3Prev1X_L_Actl 64;
BA_ "GenSigSendType" SG_ 1254 BalrRight3Fast_B_Stat 3;
BA_ "GenSigSendType" SG_ 1254 BalrRight3Dsply_B_Stat 3;
BA_ "GenSigStartValueInteger" SG_ 1254 BalrRight3CurntY_L_Actl 64;
BA_ "GenSigStartValueInteger" SG_ 1254 BalrRight3CurntX_L_Actl 64;
BA_ "GenSigStartValueInteger" SG_ 1253 BalrRight2Prev3Y_L_Actl 64;
BA_ "GenSigStartValueInteger" SG_ 1253 BalrRight2Prev3X_L_Actl 64;
BA_ "GenSigSendType" SG_ 1253 BalrRight2Threat_D_Stat 3;
BA_ "GenSigStartValueInteger" SG_ 1253 BalrRight2Prev2Y_L_Actl 64;
BA_ "GenSigStartValueInteger" SG_ 1253 BalrRight2Prev2X_L_Actl 64;
BA_ "GenSigStartValueInteger" SG_ 1253 BalrRight2Prev1Y_L_Actl 64;
BA_ "GenSigStartValueInteger" SG_ 1253 BalrRight2Prev1X_L_Actl 64;
BA_ "GenSigSendType" SG_ 1253 BalrRight2Fast_B_Stat 3;
BA_ "GenSigSendType" SG_ 1253 BalrRight2Dsply_B_Stat 3;
BA_ "GenSigStartValueInteger" SG_ 1253 BalrRight2CurntY_L_Actl 64;
BA_ "GenSigStartValueInteger" SG_ 1253 BalrRight2CurntX_L_Actl 64;
BA_ "GenSigStartValueInteger" SG_ 1252 BalrRight1Prev3Y_L_Actl 64;
BA_ "GenSigStartValueInteger" SG_ 1252 BalrRight1Prev3X_L_Actl 64;
BA_ "GenSigSendType" SG_ 1252 BalrRight1Threat_D_Stat 3;
BA_ "GenSigStartValueInteger" SG_ 1252 BalrRight1Prev2Y_L_Actl 64;
BA_ "GenSigStartValueInteger" SG_ 1252 BalrRight1Prev2X_L_Actl 64;
BA_ "GenSigStartValueInteger" SG_ 1252 BalrRight1Prev1Y_L_Actl 64;
BA_ "GenSigStartValueInteger" SG_ 1252 BalrRight1Prev1X_L_Actl 64;
BA_ "GenSigSendType" SG_ 1252 BalrRight1Fast_B_Stat 3;
BA_ "GenSigSendType" SG_ 1252 BalrRight1Dsply_B_Stat 3;
BA_ "GenSigStartValueInteger" SG_ 1252 BalrRight1CurntY_L_Actl 64;
BA_ "GenSigStartValueInteger" SG_ 1252 BalrRight1CurntX_L_Actl 64;
BA_ "GenSigStartValueInteger" SG_ 1251 BalrLeft4Prev3Y_L_Actl 64;
BA_ "GenSigStartValueInteger" SG_ 1251 BalrLeft4Prev3X_L_Actl 64;
BA_ "GenSigStartValueInteger" SG_ 1251 BalrLeft4Prev2Y_L_Actl 64;
BA_ "GenSigStartValueInteger" SG_ 1251 BalrLeft4Prev2X_L_Actl 64;
BA_ "GenSigStartValueInteger" SG_ 1251 BalrLeft4Prev1Y_L_Actl 64;
BA_ "GenSigStartValueInteger" SG_ 1251 BalrLeft4Prev1X_L_Actl 64;
BA_ "GenSigStartValueInteger" SG_ 1251 BalrLeft4CurntY_L_Actl 64;
BA_ "GenSigStartValueInteger" SG_ 1251 BalrLeft4CurntX_L_Actl 64;
BA_ "GenSigStartValueInteger" SG_ 1250 BalrLeft3Prev3Y_L_Actl 64;
BA_ "GenSigStartValueInteger" SG_ 1250 BalrLeft3Prev3X_L_Actl 64;
BA_ "GenSigStartValueInteger" SG_ 1250 BalrLeft3Prev2Y_L_Actl 64;
BA_ "GenSigStartValueInteger" SG_ 1250 BalrLeft3Prev2X_L_Actl 64;
BA_ "GenSigStartValueInteger" SG_ 1250 BalrLeft3Prev1Y_L_Actl 64;
BA_ "GenSigStartValueInteger" SG_ 1250 BalrLeft3Prev1X_L_Actl 64;
BA_ "GenSigStartValueInteger" SG_ 1250 BalrLeft3CurntY_L_Actl 64;
BA_ "GenSigStartValueInteger" SG_ 1250 BalrLeft3CurntX_L_Actl 64;
BA_ "GenSigStartValueInteger" SG_ 1249 BalrLeft2Prev3Y_L_Actl 64;
BA_ "GenSigStartValueInteger" SG_ 1249 BalrLeft2Prev3X_L_Actl 64;
BA_ "GenSigStartValueInteger" SG_ 1249 BalrLeft2Prev2Y_L_Actl 64;
BA_ "GenSigStartValueInteger" SG_ 1249 BalrLeft2Prev2X_L_Actl 64;
BA_ "GenSigStartValueInteger" SG_ 1249 BalrLeft2Prev1Y_L_Actl 64;
BA_ "GenSigStartValueInteger" SG_ 1249 BalrLeft2Prev1X_L_Actl 64;
BA_ "GenSigStartValueInteger" SG_ 1249 BalrLeft2CurntY_L_Actl 64;
BA_ "GenSigStartValueInteger" SG_ 1249 BalrLeft2CurntX_L_Actl 64;
BA_ "GenSigSendType" SG_ 1248 BalrLeft1Threat_D_Stat 3;
BA_ "GenSigStartValueInteger" SG_ 1248 BalrLeft1Prev3Y_L_Actl 64;
BA_ "GenSigStartValueInteger" SG_ 1248 BalrLeft1Prev3X_L_Actl 64;
BA_ "GenSigStartValueInteger" SG_ 1248 BalrLeft1Prev2Y_L_Actl 64;
BA_ "GenSigStartValueInteger" SG_ 1248 BalrLeft1Prev2X_L_Actl 64;
BA_ "GenSigStartValueInteger" SG_ 1248 BalrLeft1Prev1Y_L_Actl 64;
BA_ "GenSigStartValueInteger" SG_ 1248 BalrLeft1Prev1X_L_Actl 64;
BA_ "GenSigSendType" SG_ 1248 BalrLeft1Fast_B_Stat 3;
BA_ "GenSigSendType" SG_ 1248 BalrLeft1Dsply_B_Stat 3;
BA_ "GenSigStartValueInteger" SG_ 1248 BalrLeft1CurntY_L_Actl 64;
BA_ "GenSigStartValueInteger" SG_ 1248 BalrLeft1CurntX_L_Actl 64;
BA_ "U_P702_MY2021_Rx" SG_ 1113 TrlrTrgtAcquire_D_Stat 1;
BA_ "U_P702_MY2021_Rx" SG_ 1113 TrlrRvrse_D_Stat 1;
BA_ "U_P702_MY2021_Rx" SG_ 1113 TrlrAid_D2_Stat 1;
BA_ "U_P702_MY2021_Rx" SG_ 1113 TrlrAidTrgtId_No_Actl 1;
BA_ "GenSigStartValueInteger" SG_ 1113 TrlrAid_An3_Actl 720;
BA_ "U_P702_MY2021_Rx" SG_ 1113 TrlrAid_An3_Actl 1;
BA_ "GenSigStartValueInteger" SG_ 1113 TrlrAid_AnRate2_Actl 400;
BA_ "U_P702_MY2021_Rx" SG_ 1113 TrlrAid_AnRate2_Actl 1;
BA_ "GenSigStartValueInteger" SG_ 1113 HitchToVehAxle_L_Calc 255;
BA_ "GenSigStartValue" SG_ 1113 HitchToVehAxle_L_Calc 255;
BA_ "U_P702_MY2021_Rx" SG_ 1113 HitchToVehAxle_L_Calc 1;
BA_ "GenSigSendType" SG_ 1105 TrlrAidSwtchLamp_B_Rq 3;
BA_ "GenSigSendType" SG_ 1105 TrlrHitchMsgTxt_D_Rq 3;
BA_ "GenSigSendType" SG_ 1105 TrlrHitchIcon_D_Rq 3;
BA_ "GenSigSendType" SG_ 1105 TrlrHitchChime_D_Rq 3;
BA_ "GenSigSendType" SG_ 1105 TrlrAidEnbl_D_RqAdas 3;
BA_ "U_P702_MY2021_Rx" SG_ 1105 TrlrAidEnbl_D_RqAdas 1;
BA_ "GenSigSendType" SG_ 1105 TrlrRvrseMsgTxt_D2_Rq 3;
BA_ "U_P702_MY2021_Rx" SG_ 1105 TrlrRvrseMsgTxt_D2_Rq 1;
BA_ "GenSigSendType" SG_ 1105 TrlrRvrseEnbl_D2_Stat 3;
BA_ "U_P702_MY2021_Rx" SG_ 1105 TrlrRvrseEnbl_D2_Stat 1;
BA_ "GenSigSendType" SG_ 1105 RbaMsg_D_Rq 3;
BA_ "WakeupSignal" SG_ 1105 BrkDecel_B_RqRba 1;
BA_ "CrossOver_InfoCAN" SG_ 1105 BrkDecel_B_RqRba 1;
BA_ "GenSigSendType" SG_ 1105 BrkDecel_B_RqRba 3;
BA_ "U_P702_MY2021_Rx" SG_ 1105 BrkDecel_B_RqRba 1;
BA_ "WakeupSignal" SG_ 1105 BrkEnbl_B_RqRba 1;
BA_ "CrossOver_InfoCAN" SG_ 1105 BrkEnbl_B_RqRba 1;
BA_ "GenSigSendType" SG_ 1105 BrkEnbl_B_RqRba 3;
BA_ "U_P702_MY2021_Rx" SG_ 1105 BrkEnbl_B_RqRba 1;
BA_ "GenSigStartValueInteger" SG_ 1105 Rba_D_Stat 1;
BA_ "GenSigStartValue" SG_ 1105 Rba_D_Stat 1;
BA_ "GenSigSendType" SG_ 1105 Rba_D_Stat 3;
BA_ "GenSigSendType" SG_ 1105 RbaAlrt_D_Dsply 3;
BA_ "GenSigSendType" SG_ 1105 RbaMnu_D_Rq 3;
BA_ "GenSigSendType" SG_ 1105 CamraFrntStat_D_Stat 3;
BA_ "GenSigSendType" SG_ 1105 TrlrHitchLamp_D_Rq2 3;
BA_ "GenSigSendType" SG_ 938 SidePrkSnsR2_D_Stat 3;
BA_ "GenSigSendType" SG_ 938 SidePrkSnsR1_D_Stat 3;
BA_ "GenSigSendType" SG_ 938 SidePrkSnsL2_D_Stat 3;
BA_ "CrossOver_InfoCAN" SG_ 938 ApaMde_D_Stat 1;
BA_ "GenSigSendType" SG_ 938 ApaMde_D_Stat 3;
BA_ "CrossOver_InfoCAN" SG_ 938 ApaActvSd_D_Actl 1;
BA_ "GenSigStartValueInteger" SG_ 938 ApaActvSd_D_Actl 1;
BA_ "GenSigStartValue" SG_ 938 ApaActvSd_D_Actl 1;
BA_ "GenSigSendType" SG_ 938 ApaActvSd_D_Actl 3;
BA_ "CrossOver_InfoCAN" SG_ 938 PrkAidSwtch_B_Stat 1;
BA_ "GenSigSendType" SG_ 938 PrkAidSwtch_B_Stat 3;
BA_ "CrossOver_InfoCAN" SG_ 938 ApaMde_D_Avail 1;
BA_ "GenSigSendType" SG_ 938 ApaMde_D_Avail 3;
BA_ "CrossOver_InfoCAN" SG_ 938 PrkAidSnsFrCrnr_D_Stat 1;
BA_ "GenSigSendType" SG_ 938 PrkAidSnsFrCrnr_D_Stat 3;
BA_ "CrossOver_InfoCAN" SG_ 938 PrkAidSnsFrCntr_D_Stat 1;
BA_ "GenSigSendType" SG_ 938 PrkAidSnsFrCntr_D_Stat 3;
BA_ "CrossOver_InfoCAN" SG_ 938 PrkAidSnsFlCrnr_D_Stat 1;
BA_ "GenSigSendType" SG_ 938 PrkAidSnsFlCrnr_D_Stat 3;
BA_ "CrossOver_InfoCAN" SG_ 938 PrkAidSnsFlCntr_D_Stat 1;
BA_ "GenSigSendType" SG_ 938 PrkAidSnsFlCntr_D_Stat 3;
BA_ "GenSigSendType" SG_ 938 PrkBrkEl_B_RqFap 3;
BA_ "U_CX727_MY2021_Rx" SG_ 938 PrkBrkEl_B_RqFap 1;
BA_ "U_P702_MY2021_Rx" SG_ 938 PrkBrkEl_B_RqFap 1;
BA_ "CrossOver_InfoCAN" SG_ 938 RpaChime_D_Rq 1;
BA_ "GenSigSendType" SG_ 938 RpaChime_D_Rq 3;
BA_ "CrossOver_InfoCAN" SG_ 938 FpaChime_D_Rq 1;
BA_ "GenSigSendType" SG_ 938 FpaChime_D_Rq 3;
BA_ "CrossOver_InfoCAN" SG_ 938 PrkAidMsgTxt_D_Rq 1;
BA_ "GenSigSendType" SG_ 938 PrkAidMsgTxt_D_Rq 3;
BA_ "U_P702_MY2021_Rx" SG_ 938 PrkAidMsgTxt_D_Rq 1;
BA_ "GenSigSendType" SG_ 938 SidePrkSnsL1_D_Stat 3;
BA_ "CrossOver_InfoCAN" SG_ 938 PrkAidAudioMute_B_Rq 1;
BA_ "GenSigSendType" SG_ 938 PrkAidAudioMute_B_Rq 3;
BA_ "GenSigSendType" SG_ 939 ApaBrk_D_Rq 3;
BA_ "GenSigSendType" SG_ 939 SidePrkSnsR4_D_Stat 3;
BA_ "GenSigSendType" SG_ 939 SidePrkSnsR3_D_Stat 3;
BA_ "GenSigSendType" SG_ 939 SidePrkSnsL4_D_Stat 3;
BA_ "GenSigSendType" SG_ 939 SidePrkSnsL3_D_Stat 3;
BA_ "CrossOver_InfoCAN" SG_ 939 PrkAidChime_D_Stat 1;
BA_ "GenSigSendType" SG_ 939 PrkAidChime_D_Stat 3;
BA_ "CrossOver_InfoCAN" SG_ 939 PrkAidSnsRlCntr_D_Stat 1;
BA_ "GenSigSendType" SG_ 939 PrkAidSnsRlCntr_D_Stat 3;
BA_ "CrossOver_InfoCAN" SG_ 939 PrkAidSnsRrCrnr_D_Stat 1;
BA_ "GenSigSendType" SG_ 939 PrkAidSnsRrCrnr_D_Stat 3;
BA_ "CrossOver_InfoCAN" SG_ 939 PrkAidSnsRrCntr_D_Stat 1;
BA_ "GenSigSendType" SG_ 939 PrkAidSnsRrCntr_D_Stat 3;
BA_ "CrossOver_InfoCAN" SG_ 939 PrkAidSnsRlCrnr_D_Stat 1;
BA_ "GenSigSendType" SG_ 939 PrkAidSnsRlCrnr_D_Stat 3;
BA_ "CrossOver_InfoCAN" SG_ 939 PrkAidRear_D_Stat 1;
BA_ "GenSigSendType" SG_ 939 PrkAidRear_D_Stat 3;
BA_ "CrossOver_InfoCAN" SG_ 939 PrkAidFront_D_Stat 1;
BA_ "GenSigSendType" SG_ 939 PrkAidFront_D_Stat 3;
BA_ "CrossOver_InfoCAN" SG_ 939 PrkAid_D_Falt 1;
BA_ "GenSigSendType" SG_ 939 PrkAid_D_Falt 3;
BA_ "GenSigSendType" SG_ 939 ApaLongCtrlEnbl_D_Rq 3;
BA_ "U_P702_MY2021_Rx" SG_ 939 ApaLongCtrlEnbl_D_Rq 1;
BA_ "U_T6_MCA_MY2020_Rx" SG_ 939 ApaLongCtrlEnbl_D_Rq 1;
BA_ "U_CX727_MY2021_Rx" SG_ 939 ApaLongCtrlEnbl_D_Rq 1;
BA_ "GenSigStartValueInteger" SG_ 939 ApaBrk_A_Rq 255;
BA_ "U_P702_MY2021_Rx" SG_ 939 ApaBrk_A_Rq 1;
BA_ "U_T6_MCA_MY2020_Rx" SG_ 939 ApaBrk_A_Rq 1;
BA_ "U_CX727_MY2021_Rx" SG_ 939 ApaBrk_A_Rq 1;
BA_ "GenSigSendType" SG_ 939 PrkAidLamp_D_Rq 3;
BA_ "U_P702_MY2021_Rx" SG_ 937 Veh_V_RqFap 1;
BA_ "U_T6_MCA_MY2020_Rx" SG_ 937 Veh_V_RqFap 1;
BA_ "MetaData" SG_ 937 TrnRngDRqFap_No_Cs 1;
BA_ "U_P702_MY2021_Rx" SG_ 937 TrnRngDRqFap_No_Cs 1;
BA_ "U_T6_MCA_MY2020_Rx" SG_ 937 TrnRngDRqFap_No_Cs 1;
BA_ "MetaData" SG_ 937 TrnRngDRqFap_No_Cnt 1;
BA_ "U_P702_MY2021_Rx" SG_ 937 TrnRngDRqFap_No_Cnt 1;
BA_ "U_T6_MCA_MY2020_Rx" SG_ 937 TrnRngDRqFap_No_Cnt 1;
BA_ "U_P702_MY2021_Rx" SG_ 937 TrnRng_D_RqFap 1;
BA_ "U_T6_MCA_MY2020_Rx" SG_ 937 TrnRng_D_RqFap 1;
BA_ "GenSigStartValueInteger" SG_ 937 FapLcDistToObj_L_Actl 254;
BA_ "GenSigStartValue" SG_ 937 FapLcDistToObj_L_Actl 254;
BA_ "U_P702_MY2021_Rx" SG_ 937 FapLcDistToObj_L_Actl 1;
BA_ "U_T6_MCA_MY2020_Rx" SG_ 937 FapLcDistToObj_L_Actl 1;
BA_ "U_P702_MY2021_Rx" SG_ 936 ApaSys_D_Stat 1;
BA_ "U_T6_MCA_MY2020_Rx" SG_ 936 ApaSys_D_Stat 1;
BA_ "U_CX727_MY2021_Rx" SG_ 936 EPASExtAngleStatReq 1;
BA_ "U_P702_MY2021_Rx" SG_ 936 EPASExtAngleStatReq 1;
BA_ "U_CX727_MY2021_Rx" SG_ 936 ExtSteeringAngleReq2 1;
BA_ "U_P702_MY2021_Rx" SG_ 936 ExtSteeringAngleReq2 1;
BA_ "GenSigStartValueInteger" SG_ 877 RngImpctDrv_L_Dsply 255;
BA_ "U_P702_MY2021_Tx" SG_ 877 RngImpctDrv_L_Dsply 1;
BA_ "GenSigStartValueInteger" SG_ 877 RngImpctClim_L_Dsply 255;
BA_ "U_P702_MY2021_Tx" SG_ 877 RngImpctClim_L_Dsply 1;
BA_ "GenSigStartValueInteger" SG_ 877 VehElEffAvg_No_Dsply 126;
BA_ "GenSigStartValue" SG_ 877 VehElEffAvg_No_Dsply 126;
BA_ "U_P702_MY2021_Tx" SG_ 877 VehElEffAvg_No_Dsply 1;
BA_ "CrossOver_InfoCAN" SG_ 877 PwFlwFuelDrv_D_Dsply 1;
BA_ "GenSigSendType" SG_ 877 PwFlwFuelDrv_D_Dsply 3;
BA_ "U_P702_MY2021_Tx" SG_ 877 PwFlwFuelDrv_D_Dsply 1;
BA_ "CrossOver_InfoCAN" SG_ 877 PwFlwFuelClimt_B_Dsply 1;
BA_ "GenSigSendType" SG_ 877 PwFlwFuelClimt_B_Dsply 3;
BA_ "U_P702_MY2021_Tx" SG_ 877 PwFlwFuelClimt_B_Dsply 1;
BA_ "CrossOver_InfoCAN" SG_ 877 PwFlwFuelBatt_B_Dsply 1;
BA_ "GenSigSendType" SG_ 877 PwFlwFuelBatt_B_Dsply 3;
BA_ "U_P702_MY2021_Tx" SG_ 877 PwFlwFuelBatt_B_Dsply 1;
BA_ "CrossOver_InfoCAN" SG_ 877 PwFlwBattClimt_B_Dsply 1;
BA_ "GenSigSendType" SG_ 877 PwFlwBattClimt_B_Dsply 3;
BA_ "U_P702_MY2021_Tx" SG_ 877 PwFlwBattClimt_B_Dsply 1;
BA_ "CrossOver_InfoCAN" SG_ 877 PwFlwBatt_D_Dsply 1;
BA_ "GenSigSendType" SG_ 877 PwFlwBatt_D_Dsply 3;
BA_ "U_P702_MY2021_Tx" SG_ 877 PwFlwBatt_D_Dsply 1;
BA_ "U_P702_MY2021_Rx" SG_ 589 BattTrac2_Pw_LimChrg 1;
BA_ "U_P702_MY2021_Rx" SG_ 589 BattTrac2_Pw_LimDchrg 1;
BA_ "U_P702_MY2021_Rx" SG_ 589 BattTrac2_Pw_DchrgInst 1;
BA_ "U_P702_MY2021_Rx" SG_ 589 BattTrac2_Pw_ChrgInst 1;
BA_ "GenSigStartValueInteger" SG_ 588 BattTracSoc2_Pc_Actl 16382;
BA_ "GenSigStartValue" SG_ 588 BattTracSoc2_Pc_Actl 16382;
BA_ "U_P702_MY2021_Rx" SG_ 588 BattTracSoc2_Pc_Actl 1;
BA_ "GenSigStartValueInteger" SG_ 588 BattTrac_Te_Actl 150;
BA_ "GenSigStartValue" SG_ 588 BattTrac_Te_Actl 150;
BA_ "U_P702_MY2021_Rx" SG_ 588 BattTrac_Te_Actl 1;
BA_ "CrossOver_InfoCAN" SG_ 588 BattTracDiagClr_B_Rq 1;
BA_ "GenSigStartValueInteger" SG_ 587 BattTracClnt_Te_Actl 164;
BA_ "GenSigStartValue" SG_ 587 BattTracClnt_Te_Actl 164;
BA_ "CrossOver_InfoCAN" SG_ 587 BattTracWarnLamp_B_Rq 1;
BA_ "CrossOver_InfoCAN" SG_ 587 BattTracSrvcRqd_B_Rq 1;
BA_ "GenSigStartValueInteger" SG_ 587 BattTracSoc_Pc_MxPrtct 700;
BA_ "GenSigStartValue" SG_ 587 BattTracSoc_Pc_MxPrtct 700;
BA_ "U_P702_MY2021_Rx" SG_ 587 BattTracSoc_Pc_MxPrtct 1;
BA_ "GenSigStartValueInteger" SG_ 587 BattTracSoc_Pc_MnPrtct 300;
BA_ "GenSigStartValue" SG_ 587 BattTracSoc_Pc_MnPrtct 30;
BA_ "U_P702_MY2021_Rx" SG_ 587 BattTracSoc_Pc_MnPrtct 1;
BA_ "GenSigStartValueInteger" SG_ 587 BattTracSoc_Pc_LimLo 400;
BA_ "GenSigStartValue" SG_ 587 BattTracSoc_Pc_LimLo 400;
BA_ "U_P702_MY2021_Rx" SG_ 587 BattTracSoc_Pc_LimLo 1;
BA_ "GenSigStartValueInteger" SG_ 587 BattTracSoc_Pc_LimHi 600;
BA_ "GenSigStartValue" SG_ 587 BattTracSoc_Pc_LimHi 600;
BA_ "U_P702_MY2021_Rx" SG_ 587 BattTracSoc_Pc_LimHi 1;
BA_ "CrossOver_InfoCAN" SG_ 389 HtrnOvrTeLamp_B_Dsply 1;
BA_ "U_P702_MY2021_Rx" SG_ 389 HtrnAin_UHi_Actl 1;
BA_ "ECGUsedRxSignal" SG_ 389 HtrnAin_UHi_Actl 1;
BA_ "CrossOver_InfoCAN" SG_ 389 HtrnSrvcRqd_B_Dsply 1;
BA_ "U_P702_MY2021_Rx" SG_ 389 HtrnHvilOpen_B_Actl 1;
BA_ "ECGUsedRxSignal" SG_ 389 HtrnHvilOpen_B_Actl 1;
BA_ "GenSigStartValueInteger" SG_ 389 BattTrac_I_EstVsc 15000;
BA_ "GenSigStartValueInteger" SG_ 122 BattTrac_U_LimLo 88;
BA_ "GenSigStartValue" SG_ 122 BattTrac_U_LimLo 88;
BA_ "U_P702_MY2021_Rx" SG_ 122 BattTrac_U_LimLo 1;
BA_ "GenSigStartValueInteger" SG_ 122 BattTrac_U_LimHi 163;
BA_ "GenSigStartValue" SG_ 122 BattTrac_U_LimHi 163;
BA_ "U_P702_MY2021_Rx" SG_ 122 BattTrac_U_LimHi 1;
BA_ "CrossOver_InfoCAN" SG_ 122 VehStrtInhbt_B_RqBatt 1;
BA_ "U_P702_MY2021_Rx" SG_ 122 VehStrtInhbt_B_RqBatt 1;
BA_ "U_P702_MY2021_Rx" SG_ 122 BattTracOffFst_D_Actl 1;
BA_ "CrossOver_InfoCAN" SG_ 122 BattTracOff_B_Actl 1;
BA_ "U_P702_MY2021_Rx" SG_ 122 BattTracOff_B_Actl 1;
BA_ "GenSigStartValueInteger" SG_ 122 BattTrac_U_Actl 1022;
BA_ "GenSigStartValue" SG_ 122 BattTrac_U_Actl 1022;
BA_ "U_P702_MY2021_Rx" SG_ 122 BattTrac_U_Actl 1;
BA_ "GenSigStartValueInteger" SG_ 122 BattTrac_I_Actl 15000;
BA_ "U_P702_MY2021_Rx" SG_ 122 BattTrac_I_Actl 1;
BA_ "CrossOver_InfoCAN" SG_ 1091 ParkLampTrlrOut_B_Stat 1;
BA_ "CrossOver_InfoCAN" SG_ 1091 TrlrLampCtl_D_Stat 1;
BA_ "CrossOver_InfoCAN" SG_ 1091 TrlrBattChrg_D_Stat 1;
BA_ "CrossOver_InfoCAN" SG_ 1091 StopLampTrlrOut_B_Stat 1;
BA_ "CrossOver_InfoCAN" SG_ 1091 TurnLampTrlrRr_B_Stat 1;
BA_ "CrossOver_InfoCAN" SG_ 1091 TurnLampTrlrRl_B_Stat 1;
BA_ "CrossOver_InfoCAN" SG_ 1091 TrlrLampCnnct_B_Actl 1;
BA_ "U_P702_MY2021_Rx" SG_ 1091 TrlrLampCnnct_B_Actl 1;
BA_ "U_CX727_MY2021_Rx" SG_ 1091 TrlrLampCnnct_B_Actl 1;
BA_ "U_T6_MCA_MY2020_Rx" SG_ 1091 TrlrLampCnnct_B_Actl 1;
BA_ "WakeupSignal" SG_ 131 HeadLghtHiCtrl_D_RqAhb 1;
BA_ "U_P702_MY2021_Rx" SG_ 131 HeadLghtHiCtrl_D_RqAhb 1;
BA_ "GenSigStartValueInteger" SG_ 131 WiprFrontSwtch_D_Stat 9;
BA_ "GenSigStartValue" SG_ 131 WiprFrontSwtch_D_Stat 9;
BA_ "WakeupSignal" SG_ 131 HeadLghtHiOn_B_StatAhb 1;
BA_ "CrossOver_InfoCAN" SG_ 131 HeadLghtHiOn_B_StatAhb 1;
BA_ "WakeupSignal" SG_ 131 HeadLghtHiFlash_D_Stat 1;
BA_ "GenSigStartValueInteger" SG_ 131 WiprFront_D_Stat 15;
BA_ "GenSigStartValue" SG_ 131 WiprFront_D_Stat 15;
BA_ "U_P702_MY2021_Rx" SG_ 131 WiprFront_D_Stat 1;
BA_ "U_T6_MCA_MY2020_Rx" SG_ 131 WiprFront_D_Stat 1;
BA_ "U_CX727_MY2021_Rx" SG_ 131 WiprFront_D_Stat 1;
BA_ "WakeupSignal" SG_ 131 TurnLghtSwtch_D_Stat 1;
BA_ "CrossOver_InfoCAN" SG_ 131 TurnLghtSwtch_D_Stat 1;
BA_ "U_CX727_MY2021_Rx" SG_ 131 TurnLghtSwtch_D_Stat 1;
BA_ "U_P702_MY2021_Rx" SG_ 131 TurnLghtSwtch_D_Stat 1;
BA_ "GenSigStartValueInteger" SG_ 131 LghtAmb_D_Sns 7;
BA_ "GenSigStartValue" SG_ 131 LghtAmb_D_Sns 7;
BA_ "U_P702_MY2021_Rx" SG_ 131 LghtAmb_D_Sns 1;
BA_ "U_P702_MY2021_Rx" SG_ 131 AslButtnOnOffPress 1;
BA_ "U_T6_MCA_MY2020_Rx" SG_ 131 AslButtnOnOffPress 1;
BA_ "U_P702_MY2021_Rx" SG_ 131 AslButtnOnOffCnclPress 1;
BA_ "U_T6_MCA_MY2020_Rx" SG_ 131 AslButtnOnOffCnclPress 1;
BA_ "U_P702_MY2021_Rx" SG_ 131 CcButtnOnPress 1;
BA_ "U_T6_MCA_MY2020_Rx" SG_ 131 CcButtnOnPress 1;
BA_ "U_P702_MY2021_Rx" SG_ 131 CcButtnOnOffPress 1;
BA_ "U_T6_MCA_MY2020_Rx" SG_ 131 CcButtnOnOffPress 1;
BA_ "U_P702_MY2021_Rx" SG_ 131 CcButtnOnOffCnclPress 1;
BA_ "U_T6_MCA_MY2020_Rx" SG_ 131 CcButtnOnOffCnclPress 1;
BA_ "U_P702_MY2021_Rx" SG_ 131 CcButtnOffPress 1;
BA_ "U_T6_MCA_MY2020_Rx" SG_ 131 CcButtnOffPress 1;
BA_ "U_P702_MY2021_Rx" SG_ 131 CcAsllButtnResPress 1;
BA_ "U_T6_MCA_MY2020_Rx" SG_ 131 CcAsllButtnResPress 1;
BA_ "U_P702_MY2021_Rx" SG_ 131 CcAslButtnSetIncPress 1;
BA_ "U_T6_MCA_MY2020_Rx" SG_ 131 CcAslButtnSetIncPress 1;
BA_ "U_P702_MY2021_Rx" SG_ 131 CcAslButtnSetDecPress 1;
BA_ "U_T6_MCA_MY2020_Rx" SG_ 131 CcAslButtnSetDecPress 1;
BA_ "U_P702_MY2021_Rx" SG_ 131 CcAslButtnResIncPress 1;
BA_ "U_T6_MCA_MY2020_Rx" SG_ 131 CcAslButtnResIncPress 1;
BA_ "U_P702_MY2021_Rx" SG_ 131 CcAslButtnOnPress 1;
BA_ "U_T6_MCA_MY2020_Rx" SG_ 131 CcAslButtnOnPress 1;
BA_ "U_P702_MY2021_Rx" SG_ 131 CcAslButtnIndxIncPress 1;
BA_ "U_T6_MCA_MY2020_Rx" SG_ 131 CcAslButtnIndxIncPress 1;
BA_ "U_P702_MY2021_Rx" SG_ 131 CcAslButtnIndxDecPress 1;
BA_ "U_T6_MCA_MY2020_Rx" SG_ 131 CcAslButtnIndxDecPress 1;
BA_ "U_P702_MY2021_Rx" SG_ 131 CcAslButtnDeny_B_Actl 1;
BA_ "U_T6_MCA_MY2020_Rx" SG_ 131 CcAslButtnDeny_B_Actl 1;
BA_ "U_P702_MY2021_Rx" SG_ 131 CcAslButtnCnclResPress 1;
BA_ "U_T6_MCA_MY2020_Rx" SG_ 131 CcAslButtnCnclResPress 1;
BA_ "U_P702_MY2021_Rx" SG_ 131 CcAslButtnCnclPress 1;
BA_ "U_T6_MCA_MY2020_Rx" SG_ 131 CcAslButtnCnclPress 1;
BA_ "WakeupSignal" SG_ 787 DrLckCnt_No_ActlTgate 1;
BA_ "WakeupSignal" SG_ 787 DrTgateChime2_D_Rq 1;
BA_ "WakeupSignal" SG_ 787 DrTGate_D_Rq 1;
BA_ "U_P702_MY2021_Rx" SG_ 787 DrTGate_D_Rq 1;
BA_ "U_T6_MCA_MY2020_Rx" SG_ 787 DrTGate_D_Rq 1;
BA_ "WakeupSignal" SG_ 787 PwLftgtIntSw_B_Stat 1;
BA_ "CrossOver_InfoCAN" SG_ 787 Power_Liftgate_Mode_Stt 1;
BA_ "U_P702_MY2021_Rx" SG_ 953 BattRgenLoDChrg_D_Rq 1;
BA_ "U_P702_MY2021_Rx" SG_ 953 BattRgenLoChrg_D_Rq 1;
BA_ "GenSigStartValueInteger" SG_ 953 WakeAlarm3_D_Stat 3;
BA_ "GenSigStartValue" SG_ 953 WakeAlarm3_D_Stat 3;
BA_ "GenSigStartValueInteger" SG_ 953 WakeAlarm2_D_Stat 3;
BA_ "GenSigStartValue" SG_ 953 WakeAlarm2_D_Stat 3;
BA_ "GenSigStartValueInteger" SG_ 953 WakeAlarm1_D_Stat 3;
BA_ "GenSigStartValue" SG_ 953 WakeAlarm1_D_Stat 3;
BA_ "U_P702_MY2021_Rx" SG_ 953 WakeAlarm1_D_Stat 1;
BA_ "U_T6_MCA_MY2020_Rx" SG_ 953 WakeAlarm1_D_Stat 1;
BA_ "GenSigStartValueInteger" SG_ 953 WakeAlarm0_D_Stat 3;
BA_ "GenSigStartValue" SG_ 953 WakeAlarm0_D_Stat 3;
BA_ "GenSigStartValueInteger" SG_ 968 SlMde_D_Rq 2;
BA_ "GenSigStartValue" SG_ 968 SlMde_D_Rq 2;
BA_ "U_P702_MY2021_Rx" SG_ 968 SlMde_D_Rq 1;
BA_ "U_T6_MCA_MY2020_Rx" SG_ 968 SlMde_D_Rq 1;
BA_ "GenSigStartValueInteger" SG_ 968 IsaOffst_D_Rq 14;
BA_ "GenSigStartValue" SG_ 968 IsaOffst_D_Rq 14;
BA_ "U_P702_MY2021_Rx" SG_ 968 IsaOffst_D_Rq 1;
BA_ "U_T6_MCA_MY2020_Rx" SG_ 968 IsaOffst_D_Rq 1;
BA_ "WakeupSignal" SG_ 819 Memory_3_SwPsngr_Stat 1;
BA_ "WakeupSignal" SG_ 819 Memory_2_SwPsngr_Stat 1;
BA_ "WakeupSignal" SG_ 819 Memory_1_SwPsngr_Stat 1;
BA_ "U_P702_MY2021_Rx" SG_ 819 WndwPsngrSide_D_Stat 1;
BA_ "U_T6_MCA_MY2020_Rx" SG_ 819 WndwPsngrSide_D_Stat 1;
BA_ "WakeupSignal" SG_ 819 Pasngr_Lock_Sw_Stat 1;
BA_ "WakeupSignal" SG_ 819 Pasngr_Lock_Sw_Cnt 1;
BA_ "MetaData" SG_ 819 Pasngr_Lock_Sw_Cnt 1;
BA_ "WakeupSignal" SG_ 819 ChildLckFdbckRp_B_Stat 1;
BA_ "WakeupSignal" SG_ 818 ChildLckPw_N_Cnt 1;
BA_ "U_P702_MY2021_Rx" SG_ 818 WndwDrvSide_D_Stat 1;
BA_ "U_T6_MCA_MY2020_Rx" SG_ 818 WndwDrvSide_D_Stat 1;
BA_ "WakeupSignal" SG_ 818 KeyCylSwDrvDr_D_Stat 1;
BA_ "WakeupSignal" SG_ 818 Driver_Lock_Sw_Stat 1;
BA_ "WakeupSignal" SG_ 818 Driver_Lock_Sw_Cnt 1;
BA_ "MetaData" SG_ 818 Driver_Lock_Sw_Cnt 1;
BA_ "WakeupSignal" SG_ 818 ChildLckPw_D_Rq 1;
BA_ "WakeupSignal" SG_ 818 ChildLckFdbckRd_B_Stat 1;
BA_ "CrossOver_InfoCAN" SG_ 818 RvrseMirrorChime_B_Rq 1;
BA_ "CrossOver_InfoCAN" SG_ 559 EhData2_No_Actl 1;
BA_ "U_P702_MY2021_Rx" SG_ 559 EhData2_No_Actl 1;
BA_ "U_T6_MCA_MY2020_Rx" SG_ 559 EhData2_No_Actl 1;
BA_ "CrossOver_InfoCAN" SG_ 558 EhData1_No_Actl 1;
BA_ "U_P702_MY2021_Rx" SG_ 558 EhData1_No_Actl 1;
BA_ "U_T6_MCA_MY2020_Rx" SG_ 558 EhData1_No_Actl 1;
BA_ "WakeupSignal" SG_ 909 IgnPsswrdDsply_B_Rq 1;
BA_ "WakeupSignal" SG_ 909 ElPwPoint_D_Rq 1;
BA_ "CrossOver_InfoCAN" SG_ 909 SecurityMsgTxt_D_Rq 1;
BA_ "GenSigStartValueInteger" SG_ 909 HeadLghtHiPrmsn_D_Stat 3;
BA_ "GenSigStartValue" SG_ 909 HeadLghtHiPrmsn_D_Stat 3;
BA_ "U_P702_MY2021_Rx" SG_ 909 HeadLghtHiPrmsn_D_Stat 1;
BA_ "CrossOver_InfoCAN" SG_ 909 SteWhlLckMsgTxt_D_Rq 1;
BA_ "WakeupSignal" SG_ 909 immoMsgTxt_D_Rq 1;
BA_ "CrossOver_InfoCAN" SG_ 909 immoMsgTxt_D_Rq 1;
BA_ "CrossOver_InfoCAN" SG_ 909 PEBackupSlot_Stats 1;
BA_ "CrossOver_InfoCAN" SG_ 909 KeyMykeyTot_No_Cnt 1;
BA_ "MetaData" SG_ 909 KeyMykeyTot_No_Cnt 1;
BA_ "CrossOver_InfoCAN" SG_ 909 Keycode_Status 1;
BA_ "CrossOver_InfoCAN" SG_ 909 KeyAdmnTot_No_Cnt 1;
BA_ "MetaData" SG_ 909 KeyAdmnTot_No_Cnt 1;
BA_ "WakeupSignal" SG_ 963 ImpactEvntFdbck_D_Stat 1;
BA_ "CrossOver_InfoCAN" SG_ 963 ImpactEvntFdbck_D_Stat 1;
BA_ "CrossOver_InfoCAN" SG_ 963 HeadLampLoOut_B_Stat 1;
BA_ "CrossOver_InfoCAN" SG_ 963 CrnrLghtRight_Pc_Rq 1;
BA_ "U_P702_MY2021_Rx" SG_ 963 CrnrLghtRight_Pc_Rq 1;
BA_ "CrossOver_InfoCAN" SG_ 963 CrnrLghtLeft_Pc_Rq 1;
BA_ "U_P702_MY2021_Rx" SG_ 963 CrnrLghtLeft_Pc_Rq 1;
BA_ "CrossOver_InfoCAN" SG_ 963 HeadLghtHiFdbck_D_Stat 1;
BA_ "CrossOver_InfoCAN" SG_ 963 TrnNotInPrkChime_B_Rq 1;
BA_ "CrossOver_InfoCAN" SG_ 963 PrkLightChime_B_Rq 1;
BA_ "WakeupSignal" SG_ 963 KeyInIgnWarn_B_Cmd 1;
BA_ "CrossOver_InfoCAN" SG_ 963 KeyInIgnWarn_B_Cmd 1;
BA_ "WakeupSignal" SG_ 963 HomeSafeLtChime_B_Rq 1;
BA_ "CrossOver_InfoCAN" SG_ 963 HomeSafeLtChime_B_Rq 1;
BA_ "WakeupSignal" SG_ 963 StopLghtOn_B_Stat 1;
BA_ "CrossOver_InfoCAN" SG_ 963 StopLghtOn_B_Stat 1;
BA_ "U_P702_MY2021_Rx" SG_ 963 StopLghtOn_B_Stat 1;
BA_ "CrossOver_InfoCAN" SG_ 963 RvrseLghtOn_B_Stat 1;
BA_ "WakeupSignal" SG_ 963 PrkLght_D_Stat 1;
BA_ "CrossOver_InfoCAN" SG_ 963 PrkLght_D_Stat 1;
BA_ "WakeupSignal" SG_ 963 HeadLghtSwtch_D_Stat 1;
BA_ "CrossOver_InfoCAN" SG_ 963 HeadLghtSwtch_D_Stat 1;
BA_ "GenSigStartValueInteger" SG_ 963 HeadLghtSwtch_D_Stat 2;
BA_ "GenSigStartValue" SG_ 963 HeadLghtSwtch_D_Stat 2;
BA_ "U_P702_MY2021_Rx" SG_ 963 HeadLghtSwtch_D_Stat 1;
BA_ "CrossOver_InfoCAN" SG_ 963 HeadLampLoFrOn_B_Stat 1;
BA_ "GenSigStartValueInteger" SG_ 963 HeadLampLoFrOn_B_Stat 1;
BA_ "GenSigStartValue" SG_ 963 HeadLampLoFrOn_B_Stat 1;
BA_ "U_P702_MY2021_Rx" SG_ 963 HeadLampLoFrOn_B_Stat 1;
BA_ "CrossOver_InfoCAN" SG_ 963 HeadLampLoFlOn_B_Stat 1;
BA_ "GenSigStartValueInteger" SG_ 963 HeadLampLoFlOn_B_Stat 1;
BA_ "GenSigStartValue" SG_ 963 HeadLampLoFlOn_B_Stat 1;
BA_ "U_P702_MY2021_Rx" SG_ 963 HeadLampLoFlOn_B_Stat 1;
BA_ "CrossOver_InfoCAN" SG_ 963 HeadLampLoActv_B_Stat 1;
BA_ "GenSigStartValueInteger" SG_ 963 HeadLampLoActv_B_Stat 1;
BA_ "GenSigStartValue" SG_ 963 HeadLampLoActv_B_Stat 1;
BA_ "U_P702_MY2021_Rx" SG_ 963 HeadLampLoActv_B_Stat 1;
BA_ "U_T6_MCA_MY2020_Rx" SG_ 963 HeadLampLoActv_B_Stat 1;
BA_ "WakeupSignal" SG_ 963 Headlamp_On_Wrning_Cmd 1;
BA_ "CrossOver_InfoCAN" SG_ 963 Headlamp_On_Wrning_Cmd 1;
BA_ "CrossOver_InfoCAN" SG_ 963 Park_Brake_Chime_Rqst 1;
BA_ "WakeupSignal" SG_ 963 HeadLghtHiOn_B_Stat 1;
BA_ "CrossOver_InfoCAN" SG_ 963 HeadLghtHiOn_B_Stat 1;
BA_ "U_P702_MY2021_Rx" SG_ 963 HeadLghtHiOn_B_Stat 1;
BA_ "U_T6_MCA_MY2020_Rx" SG_ 963 HeadLghtHiOn_B_Stat 1;
BA_ "CrossOver_InfoCAN" SG_ 963 BrkWarnInd_B_Rq 1;
BA_ "CrossOver_InfoCAN" SG_ 963 Brk_Fluid_Lvl_Low 1;
BA_ "CrossOver_InfoCAN" SG_ 963 ReducedGuard_D_Stat 1;
BA_ "WakeupSignal" SG_ 963 Perimeter_Alarm_Status 1;
BA_ "CrossOver_InfoCAN" SG_ 963 Perimeter_Alarm_Status 1;
BA_ "WakeupSignal" SG_ 963 Courtesy_BSave_Stat 1;
BA_ "CrossOver_InfoCAN" SG_ 963 Courtesy_BSave_Stat 1;
BA_ "GenSigStartValueInteger" SG_ 963 Courtesy_BSave_Stat 1;
BA_ "GenSigStartValue" SG_ 963 Courtesy_BSave_Stat 1;
BA_ "WakeupSignal" SG_ 963 WndwGlbl_D_Cmd 1;
BA_ "CrossOver_InfoCAN" SG_ 963 WndwGlbl_D_Cmd 1;
BA_ "WakeupSignal" SG_ 963 PudLamp_D_Rq 1;
BA_ "CrossOver_InfoCAN" SG_ 963 PudLamp_D_Rq 1;
BA_ "CrossOver_InfoCAN" SG_ 963 DayRnngLampOn_B_Stat 1;
BA_ "U_P702_MY2021_Rx" SG_ 963 DayRnngLampOn_B_Stat 1;
BA_ "WakeupSignal" SG_ 963 PerimeterAlarmChimeRq 1;
BA_ "CrossOver_InfoCAN" SG_ 963 PerimeterAlarmChimeRq 1;
BA_ "CrossOver_InfoCAN" SG_ 76 FirstRowBuckleMid 1;
BA_ "GenSigStartValueInteger" SG_ 76 FirstRowBuckleMid 3;
BA_ "GenSigStartValue" SG_ 76 FirstRowBuckleMid 3;
BA_ "CrossOver_InfoCAN" SG_ 76 SecondRowBucklePsngr 1;
BA_ "GenSigStartValueInteger" SG_ 76 SecondRowBucklePsngr 3;
BA_ "GenSigStartValue" SG_ 76 SecondRowBucklePsngr 3;
BA_ "CrossOver_InfoCAN" SG_ 76 SecondRowBuckleMid 1;
BA_ "GenSigStartValueInteger" SG_ 76 SecondRowBuckleMid 3;
BA_ "GenSigStartValue" SG_ 76 SecondRowBuckleMid 3;
BA_ "CrossOver_InfoCAN" SG_ 76 SecondRowBuckleDriver 1;
BA_ "GenSigStartValueInteger" SG_ 76 SecondRowBuckleDriver 3;
BA_ "GenSigStartValue" SG_ 76 SecondRowBuckleDriver 3;
BA_ "CrossOver_InfoCAN" SG_ 76 FirstRowBuckleDriver 1;
BA_ "GenSigStartValueInteger" SG_ 76 FirstRowBuckleDriver 3;
BA_ "GenSigStartValue" SG_ 76 FirstRowBuckleDriver 3;
BA_ "U_P702_MY2021_Rx" SG_ 76 FirstRowBuckleDriver 1;
BA_ "U_T6_MCA_MY2020_Rx" SG_ 76 FirstRowBuckleDriver 1;
BA_ "U_CX727_MY2021_Rx" SG_ 76 FirstRowBuckleDriver 1;
BA_ "CrossOver_InfoCAN" SG_ 76 RILReq 1;
BA_ "CrossOver_InfoCAN" SG_ 76 FirstRowBucklePsngr 1;
BA_ "GenSigStartValueInteger" SG_ 76 FirstRowBucklePsngr 3;
BA_ "GenSigStartValue" SG_ 76 FirstRowBucklePsngr 3;
BA_ "WakeupSignal" SG_ 76 RstrnImpactEvntStatus 1;
BA_ "CrossOver_InfoCAN" SG_ 76 RstrnImpactEvntStatus 1;
BA_ "U_P702_MY2021_Rx" SG_ 76 RstrnImpactEvntStatus 1;
BA_ "U_T6_MCA_MY2020_Rx" SG_ 76 RstrnImpactEvntStatus 1;
BA_ "U_CX727_MY2021_Rx" SG_ 76 RstrnImpactEvntStatus 1;
BA_ "CrossOver_InfoCAN" SG_ 76 PsngrFrntDetct_D_Actl 1;
BA_ "GenSigStartValueInteger" SG_ 76 PsngrFrntDetct_D_Actl 3;
BA_ "GenSigStartValue" SG_ 76 PsngrFrntDetct_D_Actl 3;
BA_ "CrossOver_InfoCAN" SG_ 76 EDRTriggerEvntSync 1;
BA_ "CrossOver_InfoCAN" SG_ 76 PassRstrnInd_Req 1;
BA_ "GenSigStartValueInteger" SG_ 76 PassRstrnInd_Req 3;
BA_ "GenSigStartValue" SG_ 76 PassRstrnInd_Req 3;
BA_ "U_P702_MY2021_Rx" SG_ 65 immoControlData_T1 1;
BA_ "U_T6_MCA_MY2020_Rx" SG_ 65 immoControlData_T1 1;
BA_ "U_P702_MY2021_Rx" SG_ 65 immoControlCmd_T1 1;
BA_ "U_T6_MCA_MY2020_Rx" SG_ 65 immoControlCmd_T1 1;
BA_ "CrossOver_InfoCAN" SG_ 1076 HILL_DESC_SW 1;
BA_ "U_P702_MY2021_Rx" SG_ 1076 HILL_DESC_SW 1;
BA_ "U_T6_MCA_MY2020_Rx" SG_ 1076 HILL_DESC_SW 1;
BA_ "U_P702_MY2021_Rx" SG_ 1076 AutoRgen_D_Rq 1;
BA_ "U_T6_MCA_MY2020_Rx" SG_ 1076 AutoRgen_D_Rq 1;
BA_ "GenSigStartValueInteger" SG_ 1076 W2S_LAMP_OK 1;
BA_ "GenSigStartValue" SG_ 1076 W2S_LAMP_OK 1;
BA_ "CrossOver_InfoCAN" SG_ 1076 OdoTripRx_B_Actl 1;
BA_ "U_P702_MY2021_Rx" SG_ 1076 OdoTripRx_B_Actl 1;
BA_ "U_T6_MCA_MY2020_Rx" SG_ 1076 OdoTripRx_B_Actl 1;
BA_ "CrossOver_InfoCAN" SG_ 1076 Veh_V_CompLimMx 1;
BA_ "GenSigStartValueInteger" SG_ 1076 Veh_V_CompLimMx 4095;
BA_ "GenSigStartValue" SG_ 1076 Veh_V_CompLimMx 4093;
BA_ "U_P702_MY2021_Rx" SG_ 1076 Veh_V_CompLimMx 1;
BA_ "U_T6_MCA_MY2020_Rx" SG_ 1076 Veh_V_CompLimMx 1;
BA_ "CrossOver_InfoCAN" SG_ 1076 DrvSlipCtlMde_B_RqMyKey 1;
BA_ "CrossOver_InfoCAN" SG_ 1076 FuelLvlWarn_D_Actl 1;
BA_ "CrossOver_InfoCAN" SG_ 1076 FuelSecndActv_B_Actl 1;
BA_ "CrossOver_InfoCAN" SG_ 1076 FuelLvlPssvSide_No_Raw 1;
BA_ "U_P702_MY2021_Rx" SG_ 1076 FuelLvlPssvSide_No_Raw 1;
BA_ "U_T6_MCA_MY2020_Rx" SG_ 1076 FuelLvlPssvSide_No_Raw 1;
BA_ "CrossOver_InfoCAN" SG_ 1076 FUEL_SENSOR_NUM 1;
BA_ "U_P702_MY2021_Rx" SG_ 1076 FUEL_SENSOR_NUM 1;
BA_ "U_T6_MCA_MY2020_Rx" SG_ 1076 FUEL_SENSOR_NUM 1;
BA_ "CrossOver_InfoCAN" SG_ 1076 FuelLvlActvSide_No_Raw 1;
BA_ "U_P702_MY2021_Rx" SG_ 1076 FuelLvlActvSide_No_Raw 1;
BA_ "U_T6_MCA_MY2020_Rx" SG_ 1076 FuelLvlActvSide_No_Raw 1;
BA_ "CrossOver_InfoCAN" SG_ 1076 FuelLvl_Pc_Dsply 1;
BA_ "U_P702_MY2021_Rx" SG_ 1076 FuelLvl_Pc_Dsply 1;
BA_ "U_T6_MCA_MY2020_Rx" SG_ 1076 FuelLvl_Pc_Dsply 1;
BA_ "CrossOver_InfoCAN" SG_ 1076 DISPLAY_SPEED_SCALING 1;
BA_ "U_P702_MY2021_Rx" SG_ 1076 DISPLAY_SPEED_SCALING 1;
BA_ "U_T6_MCA_MY2020_Rx" SG_ 1076 DISPLAY_SPEED_SCALING 1;
BA_ "CrossOver_InfoCAN" SG_ 1076 DISPLAY_SPEED_OFFSET 1;
BA_ "U_P702_MY2021_Rx" SG_ 1076 DISPLAY_SPEED_OFFSET 1;
BA_ "U_T6_MCA_MY2020_Rx" SG_ 1076 DISPLAY_SPEED_OFFSET 1;
BA_ "U_P702_MY2021_Rx" SG_ 578 PtLatchActv_B_RqBcm 1;
BA_ "U_T6_MCA_MY2020_Rx" SG_ 578 PtLatchActv_B_RqBcm 1;
BA_ "U_P702_MY2021_Rx" SG_ 578 immoSecureIdleMode 1;
BA_ "U_T6_MCA_MY2020_Rx" SG_ 578 immoSecureIdleMode 1;
BA_ "WakeupSignal" SG_ 578 ReFuelSwtchStat_D_Actl 1;
BA_ "U_P702_MY2021_Rx" SG_ 578 FuelPumpPwr_D_Stat 1;
BA_ "U_T6_MCA_MY2020_Rx" SG_ 578 FuelPumpPwr_D_Stat 1;
BA_ "GenSigStartValueInteger" SG_ 578 BattULo_U_Actl 255;
BA_ "GenSigStartValue" SG_ 578 BattULo_U_Actl 255;
BA_ "U_P702_MY2021_Rx" SG_ 578 BattULo_U_Actl 1;
BA_ "U_T6_MCA_MY2020_Rx" SG_ 578 BattULo_U_Actl 1;
BA_ "U_CX727_MY2021_Rx" SG_ 578 BattULo_U_Actl 1;
BA_ "CrossOver_InfoCAN" SG_ 578 PrkLckCtl_B_Enbl 1;
BA_ "WakeupSignal" SG_ 578 PrkLckCtlMsgTxt_D_Rq 1;
BA_ "CrossOver_InfoCAN" SG_ 578 PrkLckCtlMsgTxt_D_Rq 1;
BA_ "WakeupSignal" SG_ 578 PrkLckCtlAvail_T_Stat 1;
BA_ "CrossOver_InfoCAN" SG_ 578 PrkLckCtlAvail_T_Stat 1;
BA_ "U_P702_MY2021_Rx" SG_ 578 BrkTrnShifLck_B_Stat 1;
BA_ "U_T6_MCA_MY2020_Rx" SG_ 578 BrkTrnShifLck_B_Stat 1;
BA_ "U_P702_MY2021_Rx" SG_ 578 DriverCrankingReq 1;
BA_ "U_T6_MCA_MY2020_Rx" SG_ 578 DriverCrankingReq 1;
BA_ "U_P702_MY2021_Rx" SG_ 578 EngOff_T_Actl 1;
BA_ "U_T6_MCA_MY2020_Rx" SG_ 578 EngOff_T_Actl 1;
BA_ "U_CX727_MY2021_Rx" SG_ 578 EngOff_T_Actl 1;
BA_ "U_P702_MY2021_Rx" SG_ 578 DcacElPw_D_Rq 1;
BA_ "U_T6_MCA_MY2020_Rx" SG_ 578 DcacElPw_D_Rq 1;
BA_ "GenSigStartValueInteger" SG_ 578 BattULo_I_Actl 16383;
BA_ "GenSigStartValue" SG_ 578 BattULo_I_Actl 16383;
BA_ "U_P702_MY2021_Rx" SG_ 578 BattULo_I_Actl 1;
BA_ "U_T6_MCA_MY2020_Rx" SG_ 578 BattULo_I_Actl 1;
BA_ "GenSigStartValueInteger" SG_ 1084 BattULoChrg_URate_RqMx 5;
BA_ "GenSigStartValue" SG_ 1084 BattULoChrg_URate_RqMx 5;
BA_ "U_P702_MY2021_Rx" SG_ 1084 BattULoChrg_URate_RqMx 1;
BA_ "U_T6_MCA_MY2020_Rx" SG_ 1084 BattULoChrg_URate_RqMx 1;
BA_ "GenSigStartValueInteger" SG_ 1084 BattULoChrg_U_RqMx 34;
BA_ "GenSigStartValue" SG_ 1084 BattULoChrg_U_RqMx 34;
BA_ "U_P702_MY2021_Rx" SG_ 1084 BattULoChrg_U_RqMx 1;
BA_ "U_T6_MCA_MY2020_Rx" SG_ 1084 BattULoChrg_U_RqMx 1;
BA_ "U_P702_MY2021_Rx" SG_ 1084 BattULoChrg_U_RqMn 1;
BA_ "U_T6_MCA_MY2020_Rx" SG_ 1084 BattULoChrg_U_RqMn 1;
BA_ "U_P702_MY2021_Rx" SG_ 1084 BattULoState_D_Qlty 1;
BA_ "U_T6_MCA_MY2020_Rx" SG_ 1084 BattULoState_D_Qlty 1;
BA_ "U_P702_MY2021_Rx" SG_ 1084 BSFault 1;
BA_ "U_T6_MCA_MY2020_Rx" SG_ 1084 BSFault 1;
BA_ "GenSigStartValueInteger" SG_ 1084 BattULo2_Te_Actl 127;
BA_ "GenSigStartValue" SG_ 1084 BattULo2_Te_Actl 127;
BA_ "U_P702_MY2021_Rx" SG_ 1084 BattULo2_Te_Actl 1;
BA_ "U_T6_MCA_MY2020_Rx" SG_ 1084 BattULo2_Te_Actl 1;
BA_ "U_P702_MY2021_Rx" SG_ 1084 BSBattSOC 1;
BA_ "U_T6_MCA_MY2020_Rx" SG_ 1084 BSBattSOC 1;
BA_ "GenSigStartValueInteger" SG_ 1084 BSBattQDeltaRideAh 12800;
BA_ "U_P702_MY2021_Rx" SG_ 1084 BSBattQDeltaRideAh 1;
BA_ "U_T6_MCA_MY2020_Rx" SG_ 1084 BSBattQDeltaRideAh 1;
BA_ "U_P702_MY2021_Rx" SG_ 1084 BSBattQCapAh 1;
BA_ "U_T6_MCA_MY2020_Rx" SG_ 1084 BSBattQCapAh 1;
BA_ "U_P702_MY2021_Rx" SG_ 1068 EngStrtInhbt_B_RqBatt 1;
BA_ "U_T6_MCA_MY2020_Rx" SG_ 1068 EngStrtInhbt_B_RqBatt 1;
BA_ "U_P702_MY2021_Rx" SG_ 1068 BattULoChrg_D_Rq 1;
BA_ "U_T6_MCA_MY2020_Rx" SG_ 1068 BattULoChrg_D_Rq 1;
BA_ "WakeupSignal" SG_ 1068 PwSysULoFalt_D_Stat 1;
BA_ "CrossOver_InfoCAN" SG_ 1068 PwSysULoFalt_D_Stat 1;
BA_ "CrossOver_InfoCAN" SG_ 1068 Shed_T_Eng_Off_B 1;
BA_ "WakeupSignal" SG_ 1068 Shed_Feature_Group_ID 1;
BA_ "U_P702_MY2021_Rx" SG_ 1068 Shed_Feature_Group_ID 1;
BA_ "U_T6_MCA_MY2020_Rx" SG_ 1068 Shed_Feature_Group_ID 1;
BA_ "CrossOver_InfoCAN" SG_ 1068 Shed_Drain_Eng_Off_B 1;
BA_ "WakeupSignal" SG_ 1068 Shed_Level_Req 1;
BA_ "CrossOver_InfoCAN" SG_ 1068 Shed_Level_Req 1;
BA_ "U_P702_MY2021_Rx" SG_ 1068 Shed_Level_Req 1;
BA_ "U_T6_MCA_MY2020_Rx" SG_ 1068 Shed_Level_Req 1;
BA_ "U_P702_MY2021_Rx" SG_ 1068 ULoRgenTestMde_B_Rq 1;
BA_ "U_T6_MCA_MY2020_Rx" SG_ 1068 ULoRgenTestMde_B_Rq 1;
BA_ "U_P702_MY2021_Rx" SG_ 1068 ChargeMode 1;
BA_ "U_T6_MCA_MY2020_Rx" SG_ 1068 ChargeMode 1;
BA_ "CrossOver_InfoCAN" SG_ 1068 Batt_Lo_SoC_B 1;
BA_ "U_P702_MY2021_Rx" SG_ 1068 PeriodicElLoad_B_Stat 1;
BA_ "U_T6_MCA_MY2020_Rx" SG_ 1068 PeriodicElLoad_B_Stat 1;
BA_ "CrossOver_InfoCAN" SG_ 1068 Batt_Crit_SoC_B 1;
BA_ "GenSigStartValueInteger" SG_ 146 VehVert2_A_Actl 8190;
BA_ "GenSigStartValue" SG_ 146 VehVert2_A_Actl 8190;
BA_ "U_P702_MY2021_Rx" SG_ 146 VehVert2_A_Actl 1;
BA_ "U_T6_MCA_MY2020_Rx" SG_ 146 VehVert2_A_Actl 1;
BA_ "U_CX727_MY2021_Rx" SG_ 146 VehVert2_A_Actl 1;
BA_ "MetaData" SG_ 146 VehLatLongVertA_No_Cs 1;
BA_ "U_CX727_MY2021_Rx" SG_ 146 VehLatLongVertA_No_Cs 1;
BA_ "U_P702_MY2021_Rx" SG_ 146 VehLatLongVertA_No_Cs 1;
BA_ "MetaData" SG_ 146 VehLatLongVert_No_Cnt 1;
BA_ "U_CX727_MY2021_Rx" SG_ 146 VehLatLongVert_No_Cnt 1;
BA_ "U_P702_MY2021_Rx" SG_ 146 VehLatLongVert_No_Cnt 1;
BA_ "GenSigStartValueInteger" SG_ 146 VehLong2_A_Actl 8190;
BA_ "GenSigStartValue" SG_ 146 VehLong2_A_Actl 8190;
BA_ "U_P702_MY2021_Rx" SG_ 146 VehLong2_A_Actl 1;
BA_ "U_T6_MCA_MY2020_Rx" SG_ 146 VehLong2_A_Actl 1;
BA_ "U_CX727_MY2021_Rx" SG_ 146 VehLong2_A_Actl 1;
BA_ "GenSigStartValueInteger" SG_ 146 VehLat2_A_Actl 8190;
BA_ "GenSigStartValue" SG_ 146 VehLat2_A_Actl 8190;
BA_ "U_P702_MY2021_Rx" SG_ 146 VehLat2_A_Actl 1;
BA_ "U_T6_MCA_MY2020_Rx" SG_ 146 VehLat2_A_Actl 1;
BA_ "U_CX727_MY2021_Rx" SG_ 146 VehLat2_A_Actl 1;
BA_ "GenSigStartValueInteger" SG_ 146 VehVertAActl_D_Qf 1;
BA_ "MetaData" SG_ 146 VehVertAActl_D_Qf 1;
BA_ "GenSigStartValue" SG_ 146 VehVertAActl_D_Qf 1;
BA_ "U_CX727_MY2021_Rx" SG_ 146 VehVertAActl_D_Qf 1;
BA_ "U_P702_MY2021_Rx" SG_ 146 VehVertAActl_D_Qf 1;
BA_ "GenSigStartValueInteger" SG_ 146 VehLongAActl_D_Qf 1;
BA_ "MetaData" SG_ 146 VehLongAActl_D_Qf 1;
BA_ "GenSigStartValue" SG_ 146 VehLongAActl_D_Qf 1;
BA_ "U_P702_MY2021_Rx" SG_ 146 VehLongAActl_D_Qf 1;
BA_ "U_T6_MCA_MY2020_Rx" SG_ 146 VehLongAActl_D_Qf 1;
BA_ "U_CX727_MY2021_Rx" SG_ 146 VehLongAActl_D_Qf 1;
BA_ "GenSigStartValueInteger" SG_ 146 VehLatAActl_D_Qf 1;
BA_ "MetaData" SG_ 146 VehLatAActl_D_Qf 1;
BA_ "GenSigStartValue" SG_ 146 VehLatAActl_D_Qf 1;
BA_ "U_CX727_MY2021_Rx" SG_ 146 VehLatAActl_D_Qf 1;
BA_ "U_P702_MY2021_Rx" SG_ 146 VehLatAActl_D_Qf 1;
BA_ "GenSigSendType" SG_ 1900 TesterPhysicalResCCM 3;
BA_ "GenSigSendType" SG_ 1806 TesterPhysicalResIPMA 3;
BA_ "CrossOver_InfoCAN" SG_ 997 PersIndexCcm_D_Actl 1;
BA_ "GenSigStartValueInteger" SG_ 997 PersIndexCcm_D_Actl 4;
BA_ "GenSigStartValue" SG_ 997 PersIndexCcm_D_Actl 4;
BA_ "GenSigSendType" SG_ 997 PersIndexCcm_D_Actl 3;
BA_ "CrossOver_InfoCAN" SG_ 997 FeatNoCcmActl 1;
BA_ "GenSigSendType" SG_ 997 FeatNoCcmActl 3;
BA_ "CrossOver_InfoCAN" SG_ 997 FeatConfigCcmActl 1;
BA_ "GenSigSendType" SG_ 997 FeatConfigCcmActl 3;
BA_ "GenSigStartValueInteger" SG_ 983 CmbbObjRelLong_V_Actl 1022;
BA_ "U_CX727_MY2021_Rx" SG_ 983 CmbbObjRelLong_V_Actl 1;
BA_ "U_P702_MY2021_Rx" SG_ 983 CmbbObjRelLong_V_Actl 1;
BA_ "GenSigStartValueInteger" SG_ 983 CmbbObjRelLat_V_Actl 510;
BA_ "GenSigStartValue" SG_ 983 CmbbObjRelLat_V_Actl 510;
BA_ "U_CX727_MY2021_Rx" SG_ 983 CmbbObjRelLat_V_Actl 1;
BA_ "U_P702_MY2021_Rx" SG_ 983 CmbbObjRelLat_V_Actl 1;
BA_ "GenSigStartValueInteger" SG_ 983 CmbbObjDistLong_L_Actl 1022;
BA_ "GenSigStartValue" SG_ 983 CmbbObjDistLong_L_Actl 1022;
BA_ "U_CX727_MY2021_Rx" SG_ 983 CmbbObjDistLong_L_Actl 1;
BA_ "U_P702_MY2021_Rx" SG_ 983 CmbbObjDistLong_L_Actl 1;
BA_ "GenSigStartValueInteger" SG_ 983 CmbbObjDistLat_L_Actl 510;
BA_ "GenSigStartValue" SG_ 983 CmbbObjDistLat_L_Actl 510;
BA_ "U_CX727_MY2021_Rx" SG_ 983 CmbbObjDistLat_L_Actl 1;
BA_ "U_P702_MY2021_Rx" SG_ 983 CmbbObjDistLat_L_Actl 1;
BA_ "U_CX727_MY2021_Rx" SG_ 983 CmbbObjConfdnc_D_Stat 1;
BA_ "U_P702_MY2021_Rx" SG_ 983 CmbbObjConfdnc_D_Stat 1;
BA_ "GenSigStartValueInteger" SG_ 983 CmbbObjColl_T_Actl 126;
BA_ "GenSigStartValue" SG_ 983 CmbbObjColl_T_Actl 125;
BA_ "U_CX727_MY2021_Rx" SG_ 983 CmbbObjColl_T_Actl 1;
BA_ "U_P702_MY2021_Rx" SG_ 983 CmbbObjColl_T_Actl 1;
BA_ "U_CX727_MY2021_Rx" SG_ 983 CmbbObjClass_D_Stat 1;
BA_ "U_P702_MY2021_Rx" SG_ 983 CmbbObjClass_D_Stat 1;
BA_ "U_CX727_MY2021_Rx" SG_ 983 EsaEnbl_D2_Rq 1;
BA_ "U_P702_MY2021_Rx" SG_ 983 EsaEnbl_D2_Rq 1;
BA_ "U_P702_MY2021_Rx" SG_ 980 AdbBrdr1DistRigh_D_Stat 1;
BA_ "U_P702_MY2021_Rx" SG_ 980 AdbBrdr1DistLeft_D_Stat 1;
BA_ "U_P702_MY2021_Rx" SG_ 980 AdbMde1_D_Rq 1;
BA_ "U_P702_MY2021_Rx" SG_ 980 AdbIntns1_D_Rq 1;
BA_ "GenSigStartValueInteger" SG_ 980 AdbBrdr1Up_An_Rq 510;
BA_ "GenSigStartValue" SG_ 980 AdbBrdr1Up_An_Rq 509;
BA_ "U_P702_MY2021_Rx" SG_ 980 AdbBrdr1Up_An_Rq 1;
BA_ "GenSigStartValueInteger" SG_ 980 AdbBrdr1Right_An_Rq 2046;
BA_ "GenSigStartValue" SG_ 980 AdbBrdr1Right_An_Rq 2046;
BA_ "U_P702_MY2021_Rx" SG_ 980 AdbBrdr1Right_An_Rq 1;
BA_ "GenSigStartValueInteger" SG_ 980 AdbBrdr1Low_An_Rq 510;
BA_ "GenSigStartValue" SG_ 980 AdbBrdr1Low_An_Rq 509;
BA_ "U_P702_MY2021_Rx" SG_ 980 AdbBrdr1Low_An_Rq 1;
BA_ "GenSigStartValueInteger" SG_ 980 AdbBrdr1Left_An_Rq 2046;
BA_ "GenSigStartValue" SG_ 980 AdbBrdr1Left_An_Rq 2046;
BA_ "U_P702_MY2021_Rx" SG_ 980 AdbBrdr1Left_An_Rq 1;
BA_ "U_P702_MY2021_Rx" SG_ 980 AdbBrdr1CritRigh_T_Stat 1;
BA_ "U_P702_MY2021_Rx" SG_ 980 AdbBrdr1CritLeft_T_Stat 1;
BA_ "U_P702_MY2021_Rx" SG_ 979 LatCtlRng_L_Max 1;
BA_ "U_CX727_MY2021_Rx" SG_ 979 LatCtlRng_L_Max 1;
BA_ "U_CX727_MY2021_Rx" SG_ 979 HandsOffCnfm_B_Rq 1;
BA_ "U_P702_MY2021_Rx" SG_ 979 HandsOffCnfm_B_Rq 1;
BA_ "U_CX727_MY2021_Rx" SG_ 979 LatCtl_D_Rq 1;
BA_ "U_P702_MY2021_Rx" SG_ 979 LatCtl_D_Rq 1;
BA_ "U_CX727_MY2021_Rx" SG_ 979 LatCtlRampType_D_Rq 1;
BA_ "U_P702_MY2021_Rx" SG_ 979 LatCtlRampType_D_Rq 1;
BA_ "U_CX727_MY2021_Rx" SG_ 979 LatCtlPrecision_D_Rq 1;
BA_ "U_P702_MY2021_Rx" SG_ 979 LatCtlPrecision_D_Rq 1;
BA_ "GenSigStartValueInteger" SG_ 979 LatCtlPathOffst_L_Actl 512;
BA_ "U_CX727_MY2021_Rx" SG_ 979 LatCtlPathOffst_L_Actl 1;
BA_ "U_P702_MY2021_Rx" SG_ 979 LatCtlPathOffst_L_Actl 1;
BA_ "GenSigStartValueInteger" SG_ 979 LatCtlPath_An_Actl 1000;
BA_ "U_CX727_MY2021_Rx" SG_ 979 LatCtlPath_An_Actl 1;
BA_ "U_P702_MY2021_Rx" SG_ 979 LatCtlPath_An_Actl 1;
BA_ "GenSigStartValueInteger" SG_ 979 LatCtlCurv_NoRate_Actl 4096;
BA_ "U_CX727_MY2021_Rx" SG_ 979 LatCtlCurv_NoRate_Actl 1;
BA_ "U_P702_MY2021_Rx" SG_ 979 LatCtlCurv_NoRate_Actl 1;
BA_ "GenSigStartValueInteger" SG_ 979 LatCtlCurv_No_Actl 1000;
BA_ "U_CX727_MY2021_Rx" SG_ 979 LatCtlCurv_No_Actl 1;
BA_ "U_P702_MY2021_Rx" SG_ 979 LatCtlCurv_No_Actl 1;
BA_ "GenSigStartValueInteger" SG_ 976 SrpHghtRight_L_Actl 256;
BA_ "GenSigStartValueInteger" SG_ 976 SrpHghtLeft_L_Actl 256;
BA_ "GenSigSendType" SG_ 973 TsrVl2PrmntMsgTxt_D_Rq 3;
BA_ "GenSigSendType" SG_ 973 TsrVl1PrmntMsgTxt_D_Rq 3;
BA_ "GenSigStartValueInteger" SG_ 973 TsrVl2RstrcMsgTxt2_D_Rq 1;
BA_ "GenSigStartValue" SG_ 973 TsrVl2RstrcMsgTxt2_D_Rq 1;
BA_ "GenSigSendType" SG_ 973 TsrVl2RstrcMsgTxt2_D_Rq 3;
BA_ "GenSigStartValueInteger" SG_ 973 TsrVl1RstrcMsgTxt2_D_Rq 1;
BA_ "GenSigStartValue" SG_ 973 TsrVl1RstrcMsgTxt2_D_Rq 1;
BA_ "GenSigSendType" SG_ 973 TsrVl1RstrcMsgTxt2_D_Rq 3;
BA_ "GenSigSendType" SG_ 973 TsrOvtkMsgTxt2_D_Rq 3;
BA_ "GenSigSendType" SG_ 973 WwaWarn_B_Rq 3;
BA_ "CrossOver_InfoCAN" SG_ 973 TsrVlUnitMsgTxt_D_Rq 1;
BA_ "GenSigStartValueInteger" SG_ 973 TsrVlUnitMsgTxt_D_Rq 2;
BA_ "GenSigStartValue" SG_ 973 TsrVlUnitMsgTxt_D_Rq 2;
BA_ "GenSigSendType" SG_ 973 TsrVlUnitMsgTxt_D_Rq 3;
BA_ "CrossOver_InfoCAN" SG_ 973 TsrVLim2MsgTxt_D_Rq 1;
BA_ "GenSigStartValueInteger" SG_ 973 TsrVLim2MsgTxt_D_Rq 255;
BA_ "GenSigStartValue" SG_ 973 TsrVLim2MsgTxt_D_Rq 255;
BA_ "GenSigSendType" SG_ 973 TsrVLim2MsgTxt_D_Rq 3;
BA_ "CrossOver_InfoCAN" SG_ 973 TsrVLim1MsgTxt_D_Rq 1;
BA_ "GenSigStartValueInteger" SG_ 973 TsrVLim1MsgTxt_D_Rq 255;
BA_ "GenSigStartValue" SG_ 973 TsrVLim1MsgTxt_D_Rq 255;
BA_ "GenSigSendType" SG_ 973 TsrVLim1MsgTxt_D_Rq 3;
BA_ "CrossOver_InfoCAN" SG_ 973 TsrVl2StatMsgTxt_D_Rq 1;
BA_ "GenSigSendType" SG_ 973 TsrVl2StatMsgTxt_D_Rq 3;
BA_ "CrossOver_InfoCAN" SG_ 973 TsrVl2RstrcMsgTxt_D_Rq 1;
BA_ "GenSigSendType" SG_ 973 TsrVl2RstrcMsgTxt_D_Rq 3;
BA_ "CrossOver_InfoCAN" SG_ 973 TsrVl1StatMsgTxt_D_Rq 1;
BA_ "GenSigSendType" SG_ 973 TsrVl1StatMsgTxt_D_Rq 3;
BA_ "CrossOver_InfoCAN" SG_ 973 TsrVl1RstrcMsgTxt_D_Rq 1;
BA_ "GenSigSendType" SG_ 973 TsrVl1RstrcMsgTxt_D_Rq 3;
BA_ "CrossOver_InfoCAN" SG_ 973 TsrStatMsgTxt_D_Rq 1;
BA_ "GenSigSendType" SG_ 973 TsrStatMsgTxt_D_Rq 3;
BA_ "CrossOver_InfoCAN" SG_ 973 TsrOvtkStatMsgTxt_D_Rq 1;
BA_ "GenSigSendType" SG_ 973 TsrOvtkStatMsgTxt_D_Rq 3;
BA_ "CrossOver_InfoCAN" SG_ 973 TsrOvtkMsgTxt_D_Rq 1;
BA_ "GenSigStartValueInteger" SG_ 973 TsrOvtkMsgTxt_D_Rq 1;
BA_ "GenSigStartValue" SG_ 973 TsrOvtkMsgTxt_D_Rq 1;
BA_ "GenSigSendType" SG_ 973 TsrOvtkMsgTxt_D_Rq 3;
BA_ "CrossOver_InfoCAN" SG_ 973 TsrOswWarnMsgTxt_D_Rq 1;
BA_ "GenSigStartValueInteger" SG_ 973 TsrOswWarnMsgTxt_D_Rq 1;
BA_ "GenSigStartValue" SG_ 973 TsrOswWarnMsgTxt_D_Rq 1;
BA_ "GenSigSendType" SG_ 973 TsrOswWarnMsgTxt_D_Rq 3;
BA_ "CrossOver_InfoCAN" SG_ 973 TsrMsgTxt_D_Rq 1;
BA_ "GenSigStartValueInteger" SG_ 973 TsrMsgTxt_D_Rq 1;
BA_ "GenSigStartValue" SG_ 973 TsrMsgTxt_D_Rq 1;
BA_ "GenSigSendType" SG_ 973 TsrMsgTxt_D_Rq 3;
BA_ "U_P702_MY2021_Rx" SG_ 970 LkaDrvOvrrd_D_Rq 1;
BA_ "U_CX727_MY2021_Rx" SG_ 970 LkaActvStats_D2_Req 1;
BA_ "U_P702_MY2021_Rx" SG_ 970 LkaActvStats_D2_Req 1;
BA_ "GenSigStartValueInteger" SG_ 970 LaRefAng_No_Req 2048;
BA_ "U_CX727_MY2021_Rx" SG_ 970 LaRefAng_No_Req 1;
BA_ "U_P702_MY2021_Rx" SG_ 970 LaRefAng_No_Req 1;
BA_ "U_CX727_MY2021_Rx" SG_ 970 LaRampType_B_Req 1;
BA_ "U_P702_MY2021_Rx" SG_ 970 LaRampType_B_Req 1;
BA_ "GenSigStartValueInteger" SG_ 970 LaCurvature_No_Calc 2048;
BA_ "U_CX727_MY2021_Rx" SG_ 970 LaCurvature_No_Calc 1;
BA_ "U_P702_MY2021_Rx" SG_ 970 LaCurvature_No_Calc 1;
BA_ "U_CX727_MY2021_Rx" SG_ 970 LdwActvStats_D_Req 1;
BA_ "U_P702_MY2021_Rx" SG_ 970 LdwActvStats_D_Req 1;
BA_ "CrossOver_InfoCAN" SG_ 970 LdwActvIntns_D_Req 1;
BA_ "U_CX727_MY2021_Rx" SG_ 970 LdwActvIntns_D_Req 1;
BA_ "U_P702_MY2021_Rx" SG_ 970 LdwActvIntns_D_Req 1;
BA_ "U_P702_MY2021_Rx" SG_ 962 AdbBrdr3DistRigh_D_Stat 1;
BA_ "GenSigSendType" SG_ 962 AdbBrdr3DistRigh_D_Stat 3;
BA_ "U_P702_MY2021_Rx" SG_ 962 AdbBrdr3DistLeft_D_Stat 1;
BA_ "GenSigSendType" SG_ 962 AdbBrdr3DistLeft_D_Stat 3;
BA_ "GenSigSendType" SG_ 962 AdbMde3_D_Rq 3;
BA_ "U_P702_MY2021_Rx" SG_ 962 AdbMde3_D_Rq 1;
BA_ "GenSigSendType" SG_ 962 AdbIntns3_D_Rq 3;
BA_ "U_P702_MY2021_Rx" SG_ 962 AdbIntns3_D_Rq 1;
BA_ "GenSigStartValueInteger" SG_ 962 AdbBrdr3Up_An_Rq 510;
BA_ "GenSigStartValue" SG_ 962 AdbBrdr3Up_An_Rq 509;
BA_ "U_P702_MY2021_Rx" SG_ 962 AdbBrdr3Up_An_Rq 1;
BA_ "GenSigStartValueInteger" SG_ 962 AdbBrdr3Right_An_Rq 2046;
BA_ "GenSigStartValue" SG_ 962 AdbBrdr3Right_An_Rq 2046;
BA_ "U_P702_MY2021_Rx" SG_ 962 AdbBrdr3Right_An_Rq 1;
BA_ "GenSigStartValueInteger" SG_ 962 AdbBrdr3Low_An_Rq 510;
BA_ "GenSigStartValue" SG_ 962 AdbBrdr3Low_An_Rq 509;
BA_ "U_P702_MY2021_Rx" SG_ 962 AdbBrdr3Low_An_Rq 1;
BA_ "GenSigStartValueInteger" SG_ 962 AdbBrdr3Left_An_Rq 2046;
BA_ "GenSigStartValue" SG_ 962 AdbBrdr3Left_An_Rq 2046;
BA_ "U_P702_MY2021_Rx" SG_ 962 AdbBrdr3Left_An_Rq 1;
BA_ "U_P702_MY2021_Rx" SG_ 962 AdbBrdr3CritRigh_T_Stat 1;
BA_ "U_P702_MY2021_Rx" SG_ 962 AdbBrdr3CritLeft_T_Stat 1;
BA_ "U_P702_MY2021_Rx" SG_ 961 AdbBrdr2DistRigh_D_Stat 1;
BA_ "GenSigSendType" SG_ 961 AdbBrdr2DistRigh_D_Stat 3;
BA_ "U_P702_MY2021_Rx" SG_ 961 AdbBrdr2DistLeft_D_Stat 1;
BA_ "GenSigSendType" SG_ 961 AdbBrdr2DistLeft_D_Stat 3;
BA_ "GenSigSendType" SG_ 961 AdbMde2_D_Rq 3;
BA_ "U_P702_MY2021_Rx" SG_ 961 AdbMde2_D_Rq 1;
BA_ "GenSigSendType" SG_ 961 AdbIntns2_D_Rq 3;
BA_ "U_P702_MY2021_Rx" SG_ 961 AdbIntns2_D_Rq 1;
BA_ "GenSigStartValueInteger" SG_ 961 AdbBrdr2Up_An_Rq 510;
BA_ "GenSigStartValue" SG_ 961 AdbBrdr2Up_An_Rq 509;
BA_ "U_P702_MY2021_Rx" SG_ 961 AdbBrdr2Up_An_Rq 1;
BA_ "GenSigStartValueInteger" SG_ 961 AdbBrdr2Right_An_Rq 2046;
BA_ "GenSigStartValue" SG_ 961 AdbBrdr2Right_An_Rq 2046;
BA_ "U_P702_MY2021_Rx" SG_ 961 AdbBrdr2Right_An_Rq 1;
BA_ "GenSigStartValueInteger" SG_ 961 AdbBrdr2Low_An_Rq 510;
BA_ "GenSigStartValue" SG_ 961 AdbBrdr2Low_An_Rq 509;
BA_ "U_P702_MY2021_Rx" SG_ 961 AdbBrdr2Low_An_Rq 1;
BA_ "GenSigStartValueInteger" SG_ 961 AdbBrdr2Left_An_Rq 2046;
BA_ "GenSigStartValue" SG_ 961 AdbBrdr2Left_An_Rq 2046;
BA_ "U_P702_MY2021_Rx" SG_ 961 AdbBrdr2Left_An_Rq 1;
BA_ "U_P702_MY2021_Rx" SG_ 961 AdbBrdr2CritRigh_T_Stat 1;
BA_ "U_P702_MY2021_Rx" SG_ 961 AdbBrdr2CritLeft_T_Stat 1;
BA_ "GenSigStartValueInteger" SG_ 1441 TCCM_GWOnBoardTester 255;
BA_ "ContentDependant" SG_ 1441 TCCM_GWOnBoardTester 1;
BA_ "GenSigStartValue" SG_ 1441 TCCM_GWOnBoardTester 255;
BA_ "U_P702_MY2021_Tx" SG_ 1441 TCCM_GWOnBoardTester 1;
BA_ "GenSigStartValueInteger" SG_ 1441 TCCM_GWNMProxy 255;
BA_ "ContentDependant" SG_ 1441 TCCM_GWNMProxy 1;
BA_ "GenSigStartValue" SG_ 1441 TCCM_GWNMProxy 255;
BA_ "U_P702_MY2021_Tx" SG_ 1441 TCCM_GWNMProxy 1;
BA_ "GenSigStartValueInteger" SG_ 1441 TCCM_AutoSarNMReserved4 255;
BA_ "ContentDependant" SG_ 1441 TCCM_AutoSarNMReserved4 1;
BA_ "GenSigStartValue" SG_ 1441 TCCM_AutoSarNMReserved4 255;
BA_ "U_P702_MY2021_Tx" SG_ 1441 TCCM_AutoSarNMReserved4 1;
BA_ "GenSigStartValueInteger" SG_ 1441 TCCM_AutoSarNMReserved3 255;
BA_ "ContentDependant" SG_ 1441 TCCM_AutoSarNMReserved3 1;
BA_ "GenSigStartValue" SG_ 1441 TCCM_AutoSarNMReserved3 255;
BA_ "U_P702_MY2021_Tx" SG_ 1441 TCCM_AutoSarNMReserved3 1;
BA_ "GenSigStartValueInteger" SG_ 1441 TCCM_AutoSarNMReserved2 255;
BA_ "ContentDependant" SG_ 1441 TCCM_AutoSarNMReserved2 1;
BA_ "GenSigStartValue" SG_ 1441 TCCM_AutoSarNMReserved2 255;
BA_ "U_P702_MY2021_Tx" SG_ 1441 TCCM_AutoSarNMReserved2 1;
BA_ "GenSigStartValueInteger" SG_ 1441 TCCM_AutoSarNMReserved1 255;
BA_ "ContentDependant" SG_ 1441 TCCM_AutoSarNMReserved1 1;
BA_ "GenSigStartValue" SG_ 1441 TCCM_AutoSarNMReserved1 255;
BA_ "U_P702_MY2021_Tx" SG_ 1441 TCCM_AutoSarNMReserved1 1;
BA_ "GenSigStartValueInteger" SG_ 1441 TCCM_AutoSarNMNodeId 161;
BA_ "ContentDependant" SG_ 1441 TCCM_AutoSarNMNodeId 1;
BA_ "GenSigStartValue" SG_ 1441 TCCM_AutoSarNMNodeId 161;
BA_ "U_P702_MY2021_Tx" SG_ 1441 TCCM_AutoSarNMNodeId 1;
BA_ "ContentDependant" SG_ 1441 TCCM_AutoSarNMControl 1;
BA_ "U_P702_MY2021_Tx" SG_ 1441 TCCM_AutoSarNMControl 1;
BA_ "GenSigSendType" SG_ 1787 TesterPhysicalResSODCMD 3;
BA_ "GenSigSendType" SG_ 1779 TesterPhysicalReqSODCMD 3;
BA_ "GenSigSendType" SG_ 1786 TesterPhysicalResSODCMC 3;
BA_ "GenSigSendType" SG_ 1778 TesterPhysicalReqSODCMC 3;
BA_ "CrossOver_InfoCAN" SG_ 1153 TerrMde_D_RqDrv 1;
BA_ "GenSigSendType" SG_ 930 BalrWndwRight_B_Stat 3;
BA_ "GenSigSendType" SG_ 930 BalrSnsRight_D_Falt 3;
BA_ "GenSigSendType" SG_ 930 WndwPsngrRear_D_RqBalrr 3;
BA_ "GenSigSendType" SG_ 930 WndwPsngr_D_RqBalrr 3;
BA_ "GenSigSendType" SG_ 930 WndwDrvRear_D_RqBalrr 3;
BA_ "GenSigSendType" SG_ 930 WndwDrv_D_RqBalrr 3;
BA_ "GenSigStartValueInteger" SG_ 930 BalrRight_D_Stat 2;
BA_ "GenSigStartValue" SG_ 930 BalrRight_D_Stat 2;
BA_ "GenSigSendType" SG_ 930 BalrRight_D_Stat 3;
BA_ "GenSigSendType" SG_ 930 BalrMdeSelRight_B_Stat 3;
BA_ "GenSigStartValueInteger" SG_ 930 BalrMdeRight_D_Stat 1;
BA_ "GenSigStartValue" SG_ 930 BalrMdeRight_D_Stat 1;
BA_ "GenSigSendType" SG_ 930 BalrMdeRight_D_Stat 3;
BA_ "GenSigSendType" SG_ 930 BalrLckRight_B_Stat 3;
BA_ "GenSigSendType" SG_ 930 BalrChimeRight_D_Rq 3;
BA_ "GenSigSendType" SG_ 930 CamraRearOn_B_RqBalrr 3;
BA_ "GenSigSendType" SG_ 930 DrLckCnt_No_ActlBalrr 3;
BA_ "GenSigSendType" SG_ 930 DrLckActv_B_RqBalrr 3;
BA_ "GenSigSendType" SG_ 929 BalrChimeLeft_D_Rq 3;
BA_ "GenSigStartValueInteger" SG_ 929 BalrLeft_D_Stat 2;
BA_ "GenSigStartValue" SG_ 929 BalrLeft_D_Stat 2;
BA_ "GenSigSendType" SG_ 929 BalrLeft_D_Stat 3;
BA_ "GenSigSendType" SG_ 929 BalrWndwLeft_B_Stat 3;
BA_ "GenSigSendType" SG_ 929 WndwPsngrRear_D_RqBalrl 3;
BA_ "GenSigSendType" SG_ 929 WndwPsngr_D_RqBalrl 3;
BA_ "GenSigSendType" SG_ 929 WndwDrvRear_D_RqBalrl 3;
BA_ "GenSigSendType" SG_ 929 WndwDrv_D_RqBalrl 3;
BA_ "GenSigSendType" SG_ 929 BalrSnsLeft_D_Falt 3;
BA_ "GenSigSendType" SG_ 929 BalrMdeSelLeft_B_Stat 3;
BA_ "GenSigStartValueInteger" SG_ 929 BalrMdeLeft_D_Stat 1;
BA_ "GenSigStartValue" SG_ 929 BalrMdeLeft_D_Stat 1;
BA_ "GenSigSendType" SG_ 929 BalrMdeLeft_D_Stat 3;
BA_ "GenSigSendType" SG_ 929 BalrLckLeft_B_Stat 3;
BA_ "GenSigSendType" SG_ 929 CamraRearOn_B_RqBalrl 3;
BA_ "GenSigSendType" SG_ 929 DrLckCnt_No_ActlBalrl 3;
BA_ "GenSigSendType" SG_ 929 DrLckActv_B_RqBalrl 3;
BA_ "CrossOver_InfoCAN" SG_ 402 ApaMdeStat_D_RqDrv 1;
BA_ "CrossOver_InfoCAN" SG_ 402 CamraZoomMan_D_Rq 1;
BA_ "CrossOver_InfoCAN" SG_ 402 CamraOvrlStat_D_Rq 1;
BA_ "CrossOver_InfoCAN" SG_ 402 CamraOvrlDyn_D_Rq 1;
BA_ "CrossOver_InfoCAN" SG_ 402 CamAutoTowbarZoom 1;
BA_ "CrossOver_InfoCAN" SG_ 402 DistanceBarSetting 1;
BA_ "GenSigStartValue" SG_ 924 DcacOut_Pw_Mx 2046;
BA_ "U_P702_MY2021_Rx" SG_ 924 DcacOut_Pw_Mx 1;
BA_ "GenSigStartValue" SG_ 924 DcacOut2_Pw_Actl 8190;
BA_ "U_P702_MY2021_Rx" SG_ 924 DcacOut2_Pw_Actl 1;
BA_ "GenSigStartValue" SG_ 924 DcacOut1_Pw_Actl 8190;
BA_ "U_P702_MY2021_Rx" SG_ 924 DcacOut1_Pw_Actl 1;
BA_ "GenSigStartValue" SG_ 924 DcacIn_Pw_Mx 2046;
BA_ "U_P702_MY2021_Rx" SG_ 924 DcacIn_Pw_Mx 1;
BA_ "GenSigStartValue" SG_ 923 DcacIn_U2_Actl 4094;
BA_ "GenSigStartValue" SG_ 923 DcacIn_U_Actl 4094;
BA_ "U_P702_MY2021_Rx" SG_ 923 DcacIn_U_Actl 1;
BA_ "GenSigStartValue" SG_ 923 DcacIn_I_Actl 2046;
BA_ "U_P702_MY2021_Rx" SG_ 923 DcacIn_I_Actl 1;
BA_ "GenSigStartValue" SG_ 923 Dcac_Te_Actl 254;
BA_ "U_P702_MY2021_Rx" SG_ 923 Dcac_Te_Actl 1;
BA_ "GenSigSendType" SG_ 1998 TesterPhysicalResSODR 3;
BA_ "GenSigSendType" SG_ 1996 TesterPhysicalResSODL 3;
BA_ "GenSigSendType" SG_ 1988 TesterPhysicalReqSODL 3;
BA_ "U_P702_MY2021_Rx" SG_ 922 DcacRdy_D_Stat 1;
BA_ "GenSigStartValue" SG_ 922 DcacPlugPrsnt_B_Stat 1;
BA_ "U_P702_MY2021_Rx" SG_ 922 DcacPlugPrsnt_B_Stat 1;
VAL_ 274923520 DriverDoorOpened 1 "Opened" 0 "Closed" ;
VAL_ 270581760 RightBlinker 1 "Active" 0 "Inactive" ;
VAL_ 270581760 LeftBlinker 1 "Active" 0 "Inactive" ;
VAL_ 270581760 BlinkerLight 1 "Active" 0 "Inactive" ;
VAL_ 271368192 GearShifter 3 "Park" 0 "Drive/Low" ;
VAL_ 271360000 CruiseControlActive 1 "Active" 0 "Inactive" ;
VAL_ 276135936 CruiseButtons 6 "Cancel" 5 "Main" 3 "Set" 2 "Resume" 1 "None" ;
VAL_ 276127744 LKAGapButton 2 "???" 1 "??" 0 "None" ;
VAL_ 275955897 BSM_Indicator_Light 0 "Disabled" 1 "Enabled";
